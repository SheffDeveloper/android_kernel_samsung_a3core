/dts-v1/;

/ {
	model = "Spreadtrum M168 Board";
	compatible = "sprd,m168\0sprd,sc9863a";
	sprd,sc-id = "sp9863a m168 go";
	sprd,board_id = < 0x1901 >;

	fragment {
		target-path = [ 2f 00 ];

		__overlay__ {

			lcds {

				lcd_nt36525b_txd_mipi_hdp {
					sprd,dsi-work-mode = < 0x01 >;
					sprd,dsi-lane-number = < 0x04 >;
					sprd,dsi-color-format = "rgb888";
					sprd,phy-bit-clock = < 0xa1220 >;
					sprd,phy-escape-clock = < 0x4e20 >;
					sprd,width-mm = < 0x44 >;
					sprd,height-mm = < 0x97 >;
					sprd,esd-check-enable = < 0x01 >;
					sprd,esd-check-mode = < 0x01 >;
					sprd,esd-check-period = < 0x7d0 >;
					sprd,esd-check-register = < 0x0a >;
					sprd,esd-check-value = < 0x9c >;
					sprd,reset-on-sequence = < 0x00 0x05 0x01 0x05 0x00 0x05 0x01 0x14 >;
					sprd,reset-off-sequence = < 0x00 0x05 >;
					sprd,use-dcs-write;
					sprd,initial-command = [ 15 00 00 02 ff 23 15 00 00 02 fb 01 15 00 00 02 00 80 15 00 00 02 07 00 15 00 00 02 08 02 15 00 00 02 09 00 15 00 00 02 10 80 15 00 00 02 11 00 15 00 00 02 12 b4 15 00 00 02 15 e9 15 00 00 02 16 0b 15 00 00 02 30 f6 15 00 00 02 31 e6 15 00 00 02 32 d6 15 00 00 02 33 ce 15 00 00 02 34 c8 15 00 00 02 35 c4 15 00 00 02 36 c2 15 00 00 02 37 c0 15 00 00 02 38 be 15 00 00 02 39 bc 15 00 00 02 3a ba 15 00 00 02 3b b8 15 00 00 02 3c b6 15 00 00 02 3d b4 15 00 00 02 3f b2 15 00 00 02 40 b0 15 00 00 02 41 ae 15 00 00 02 45 e8 15 00 00 02 46 d8 15 00 00 02 47 c4 15 00 00 02 48 c0 15 00 00 02 49 be 15 00 00 02 4a bc 15 00 00 02 4b ba 15 00 00 02 4c b8 15 00 00 02 4d b6 15 00 00 02 4e b4 15 00 00 02 4f b2 15 00 00 02 50 b0 15 00 00 02 51 ae 15 00 00 02 52 ac 15 00 00 02 53 aa 15 00 00 02 54 a8 15 00 00 02 ff 10 15 00 00 02 fb 01 39 00 00 03 68 03 01 39 00 00 03 51 00 00 15 00 00 02 53 2c 15 00 00 02 55 01 05 64 00 01 11 05 14 00 01 29 15 14 00 02 35 00 ];
					sprd,sleep-in-command = [ 05 14 00 01 28 05 64 00 01 10 ];
					sprd,sleep-out-command = [ 05 64 00 01 11 05 14 00 01 29 ];
					sprd,cabc-ui-mode = [ 15 00 00 02 55 01 ];
					sprd,cabc-mov-mode = [ 15 00 00 02 55 02 ];
					sprd,cabc-off-mode = [ 15 00 00 02 55 00 ];
					phandle = < 0x27 >;

					oled-backlight {
						default-brightness-level = < 0x65 >;
						sprd,max-level = < 0xfff >;
						brightness-levels = [ 39 00 00 03 51 0f ff ];
					};

					display-timings {
						native-mode = < 0x01 >;

						timing0 {
							clock-frequency = < 0x5b8d800 >;
							hactive = < 0x2d0 >;
							vactive = < 0x640 >;
							hback-porch = < 0x3c >;
							hfront-porch = < 0x43 >;
							vback-porch = < 0xfc >;
							vfront-porch = < 0x0c >;
							hsync-len = < 0x07 >;
							vsync-len = < 0x02 >;
							phandle = < 0x01 >;
						};
					};
				};

				lcd_icnl9911c_truly_mipi_hdp {
					sprd,dsi-work-mode = < 0x01 >;
					sprd,dsi-lane-number = < 0x04 >;
					sprd,dsi-color-format = "rgb888";
					sprd,phy-bit-clock = < 0xa1220 >;
					sprd,phy-escape-clock = < 0x4e20 >;
					sprd,width-mm = < 0x44 >;
					sprd,height-mm = < 0x97 >;
					sprd,esd-check-enable = < 0x01 >;
					sprd,esd-check-mode = < 0x01 >;
					sprd,esd-check-period = < 0x7d0 >;
					sprd,reset-on-sequence = < 0x00 0x05 0x01 0x05 0x00 0x05 0x01 0x1e >;
					sprd,reset-off-sequence = < 0x00 0x05 >;
					sprd,use-dcs-write;
					sprd,pre-write = [ 29 00 00 03 f0 5a 59 29 00 00 03 f1 a5 a6 ];
					sprd,initial-command = [ 29 00 00 03 f0 5a 59 29 00 00 03 f1 a5 a6 29 00 00 1f b0 87 86 85 84 88 89 00 00 33 33 33 33 00 05 05 80 05 00 0f 05 04 03 02 01 02 03 04 00 00 00 29 00 00 1e b1 53 43 85 00 00 05 05 80 05 00 04 08 54 00 00 00 44 40 02 01 40 02 01 40 02 01 40 02 01 29 00 00 1d b5 08 00 00 c0 04 06 c1 c1 0c 0c 0e 0e 10 10 12 12 00 03 03 03 03 03 ff ff fc 00 00 00 29 00 00 1d b4 09 00 00 c0 05 07 c1 c1 0d 0d 0f 0f 11 11 13 13 00 03 03 03 03 03 ff ff fc 00 00 00 29 00 00 19 b8 00 00 00 00 00 00 00 00 00 00 00 00 00 00 00 00 00 00 00 00 00 00 00 00 29 00 00 0e bb 01 05 09 11 0d 19 1d 55 25 69 00 21 25 29 00 00 0f bc 00 00 00 00 02 20 ff 00 03 13 01 73 33 00 29 00 00 0b bd e9 02 4e cf 72 a4 08 44 ae 15 29 00 00 0b be 72 72 50 32 0c 77 43 07 0e 0e 29 00 00 09 bf 07 25 07 25 7f 00 11 04 29 00 00 0a c0 10 ff ff ff ff ff 00 ff 00 29 00 00 14 c1 c0 20 20 7c 04 58 5c 04 2a 40 36 00 07 c0 10 ff 98 01 c0 29 00 00 0a c2 cc 01 10 00 01 30 02 21 43 29 00 00 0b c3 06 00 ff 00 ff 00 00 81 01 00 29 00 00 0b c4 84 01 2b 41 00 3c 00 03 03 2e 29 00 00 0c c5 03 1c c0 c0 40 10 42 44 0a 09 14 29 00 00 0b c6 88 16 20 28 29 33 64 34 08 04 29 00 00 02 cb 00 29 00 00 06 d0 80 0d ff 0f 63 29 00 00 02 d2 42 29 00 00 04 fa 45 93 01 39 00 00 18 e1 df ff ef fe ff ff f0 ae 35 35 35 51 35 35 f4 35 32 5b 84 ae 00 0b e4 39 00 00 1b e0 30 01 a0 98 01 1f 22 62 df a0 04 cc 01 ff f8 f8 fa fd f9 f8 f8 f8 fc fc f0 ff 39 00 00 03 ea 46 50 29 00 00 03 f0 a5 a6 29 00 00 03 f1 5a 59 39 00 00 03 51 00 00 15 00 00 02 53 2c 15 00 00 02 55 01 15 00 00 02 35 00 05 64 00 01 11 05 14 00 01 29 15 00 00 02 26 01 ];
					sprd,sleep-in-command = < 0x15000002 0x26080514 0x12805 0x64000110 >;
					sprd,sleep-out-command = < 0x5640001 0x11051400 0x1291500 0x22601 >;
					sprd,cabc-ui-mode = < 0x39000003 0xf05a5939 0x3f1 0xa5a63900 0x1be030 0x1a09801 0x1f2262df 0xa004cc01 0xfff8f8fa 0xfdf9f8f8 0xf8fcfcf0 0xff390000 0x18e1dfff 0xeffeffff 0xf0ae3535 0x35513535 0xf435325b 0x84ae000b 0xe4390000 0x3ea4650 0x39000003 0xf15a5939 0x3f0 0xa5a61500 0x25501 >;
					sprd,cabc-mov-mode = < 0x39000003 0xf05a5939 0x3f1 0xa5a63900 0x1be030 0x1a09801 0x1f2262df 0xa004cc01 0xfffcfcf0 0xfdfffcf8 0xfcf2fcf0 0xff390000 0x18e1cccc 0xcccccdde 0xe0ccd0d0 0xd0d0d0d0 0xd0d073ee 0x6dee000b 0xe4390000 0x3ea4650 0x39000003 0xf15a5939 0x3f0 0xa5a61500 0x25503 >;
					sprd,cabc-off-mode = [ 15 00 00 02 55 00 ];
					phandle = < 0x28 >;

					oled-backlight {
						default-brightness-level = < 0x65 >;
						sprd,max-level = < 0xfff >;
						brightness-levels = [ 39 00 00 03 51 0f ff ];
					};

					display-timings {
						native-mode = < 0x02 >;

						timing0 {
							clock-frequency = < 0x5b8d800 >;
							hactive = < 0x2d0 >;
							vactive = < 0x640 >;
							hback-porch = < 0x58 >;
							hfront-porch = < 0x5c >;
							vback-porch = < 0x20 >;
							vfront-porch = < 0x7c >;
							hsync-len = < 0x04 >;
							vsync-len = < 0x04 >;
							phandle = < 0x02 >;
						};
					};
				};

				lcd_gc7202_hlt_mipi_hdp {
					sprd,dsi-work-mode = < 0x01 >;
					sprd,dsi-lane-number = < 0x04 >;
					sprd,dsi-color-format = "rgb888";
					sprd,phy-bit-clock = < 0xa5488 >;
					sprd,phy-escape-clock = < 0x4e20 >;
					sprd,width-mm = < 0x44 >;
					sprd,height-mm = < 0x97 >;
					sprd,esd-check-enable = < 0x01 >;
					sprd,esd-check-mode = < 0x01 >;
					sprd,esd-check-period = < 0x7d0 >;
					sprd,esd-check-reg-count = < 0x01 >;
					sprd,esd-check-register = [ dd ];
					sprd,esd-check-value-len = < 0x01 >;
					sprd,esd-check-value = [ 9c ];
					sprd,reset-on-sequence = < 0x01 0x05 0x00 0x0a 0x01 0x0a 0x00 0x0a 0x01 0x0a 0x00 0x0a 0x01 0x0a 0x00 0x0a 0x01 0x19 >;
					sprd,reset-off-sequence = < 0x01 0x46 0x00 0x0a >;
					sprd,use-dcs-write;
					sprd,bta-enable = < 0x00 >;
					sprd,bta-check-register = < 0xdd >;
					sprd,initial-command = [ 29 00 00 04 ff 55 aa 66 29 00 00 02 ff 20 29 00 00 02 fb 00 29 00 00 02 ff 21 29 00 00 02 fb 00 29 00 00 02 ff 22 29 00 00 02 fb 00 29 00 00 02 ff 23 29 00 00 02 fb 00 29 00 00 02 ff 24 29 00 00 02 fb 00 29 00 00 02 ff 26 29 00 00 02 fb 00 29 00 00 02 ff 27 29 00 00 02 fb 00 29 00 00 02 ff a3 29 00 00 02 fb 00 29 00 00 02 ff b3 29 00 00 02 fb 00 29 00 00 02 ff c3 29 00 00 02 fb 00 29 00 00 02 ff 22 29 00 00 02 e4 01 29 00 00 02 01 06 29 00 00 02 02 40 29 00 00 02 25 08 29 00 00 02 26 00 29 00 00 02 2e 6f 29 00 00 02 2f 00 29 00 00 02 36 09 29 00 00 02 37 00 29 00 00 02 3f 6f 29 00 00 02 40 00 29 00 00 02 0e 33 29 00 00 02 dc 00 29 00 00 02 08 40 29 00 00 02 ff 21 29 00 00 02 01 25 29 00 00 02 02 05 29 00 00 02 03 1a 29 00 00 02 04 25 29 00 00 02 05 25 29 00 00 02 06 01 29 00 00 02 07 0f 29 00 00 02 08 0d 29 00 00 02 09 0b 29 00 00 02 0a 09 29 00 00 02 0b 23 29 00 00 02 0c 23 29 00 00 02 0d 25 29 00 00 02 0e 25 29 00 00 02 0f 25 29 00 00 02 10 25 29 00 00 02 11 25 29 00 00 02 12 25 29 00 00 02 13 25 29 00 00 02 14 25 29 00 00 02 15 25 29 00 00 02 16 25 29 00 00 02 17 25 29 00 00 02 18 04 29 00 00 02 19 1a 29 00 00 02 1a 25 29 00 00 02 1b 25 29 00 00 02 1c 00 29 00 00 02 1d 0e 29 00 00 02 1e 0c 29 00 00 02 1f 0a 29 00 00 02 20 08 29 00 00 02 21 23 29 00 00 02 22 23 29 00 00 02 23 25 29 00 00 02 24 25 29 00 00 02 25 25 29 00 00 02 26 25 29 00 00 02 27 25 29 00 00 02 28 25 29 00 00 02 29 25 29 00 00 02 2a 25 29 00 00 02 2b 25 29 00 00 02 2d 25 29 00 00 02 2e 00 29 00 00 02 88 a7 29 00 00 02 89 20 29 00 00 02 8a 33 29 00 00 02 94 a7 29 00 00 02 95 20 29 00 00 02 96 33 29 00 00 02 45 33 29 00 00 02 46 53 29 00 00 02 47 02 29 00 00 02 48 01 29 00 00 02 4c 53 29 00 00 02 4d 01 29 00 00 02 4e 02 29 00 00 02 5e 41 29 00 00 02 5f 21 29 00 00 02 60 22 29 00 00 02 64 41 29 00 00 02 65 22 29 00 00 02 66 21 29 00 00 02 7e 03 29 00 00 02 7f 21 29 00 00 02 80 01 29 00 00 02 81 1a 29 00 00 02 82 50 29 00 00 02 83 04 29 00 00 02 87 00 29 00 00 02 8b 21 29 00 00 02 8c 1a 29 00 00 02 8d 01 29 00 00 02 8e 50 29 00 00 02 8f 04 29 00 00 02 93 00 29 00 00 02 76 40 29 00 00 02 77 40 29 00 00 02 7a 44 29 00 00 02 7b 44 29 00 00 02 af 40 29 00 00 02 b0 40 29 00 00 02 c2 85 29 00 00 02 c6 56 29 00 00 02 d1 13 29 00 00 02 49 55 29 00 00 02 4a 55 29 00 00 02 4f 55 29 00 00 02 50 55 29 00 00 02 61 55 29 00 00 02 62 55 29 00 00 02 67 55 29 00 00 02 68 55 29 00 00 02 84 55 29 00 00 02 85 55 29 00 00 02 90 55 29 00 00 02 91 55 29 00 00 02 ff b3 29 00 00 02 4a 00 29 00 00 02 7d 28 29 00 00 02 5b 00 29 00 00 02 48 23 29 00 00 02 7c 88 29 00 00 02 3e 03 29 00 00 02 82 10 29 00 00 02 3f 3f 29 00 00 02 5e 10 29 00 00 02 58 84 29 00 00 02 53 1a 29 00 00 02 ff 20 29 00 00 02 29 01 29 00 00 02 2d 1f 29 00 00 02 02 2b 29 00 00 02 03 2b 29 00 00 02 04 45 29 00 00 02 05 45 29 00 00 02 0a 1b 29 00 00 02 0b 1b 29 00 00 02 0c 4b 29 00 00 02 0d 4b 29 00 00 02 77 74 29 00 00 02 78 74 29 00 00 02 a5 00 29 00 00 02 a6 ff 29 00 00 02 a9 00 29 00 00 02 aa ff 29 00 00 02 ad 00 29 00 00 02 ae ff 29 00 00 02 b1 00 29 00 00 02 b2 ff 29 00 00 02 c3 00 29 00 00 02 c4 5f 29 00 00 02 c5 00 29 00 00 02 c6 5f 29 00 00 02 b3 00 29 00 00 02 b4 20 29 00 00 02 b5 00 29 00 00 02 b6 dc 29 00 00 02 c7 00 29 00 00 02 c8 93 29 00 00 02 c9 00 29 00 00 02 ca 93 29 00 00 02 b7 00 29 00 00 02 b8 20 29 00 00 02 b9 01 29 00 00 02 ba 90 29 00 00 02 cb 00 29 00 00 02 cc 90 29 00 00 02 bb 00 29 00 00 02 bc 16 29 00 00 02 bd 00 29 00 00 02 be 12 29 00 00 02 d5 0e 29 00 00 02 7e 01 29 00 00 02 7f 00 29 00 00 02 80 01 29 00 00 02 81 00 29 00 00 02 82 00 29 00 00 02 83 04 29 00 00 02 84 04 29 00 00 02 85 01 29 00 00 02 86 8b 29 00 00 02 87 01 29 00 00 02 88 8b 29 00 00 02 8a 03 29 00 00 02 8b 03 29 00 00 02 18 44 29 00 00 02 17 51 29 00 00 02 12 a1 29 00 00 02 15 4c 29 00 00 02 a3 44 29 00 00 02 a7 44 29 00 00 02 d3 03 29 00 00 02 24 99 29 00 00 02 25 06 29 00 00 02 50 00 29 00 00 02 51 22 29 00 00 02 ff 23 29 00 00 11 01 00 00 00 2e 00 5d 00 7d 00 95 00 aa 00 c0 00 cf 29 00 00 11 02 00 df 01 0d 01 30 01 61 01 82 01 b4 01 de 01 df 29 00 00 11 03 02 0b 02 43 02 6b 02 a0 02 c4 02 f6 03 06 03 18 29 00 00 0d 04 03 2c 03 44 03 61 03 88 03 c5 03 ff 29 00 00 11 05 00 00 00 2e 00 5d 00 7d 00 95 00 aa 00 c0 00 cf 29 00 00 11 06 00 df 01 0d 01 30 01 61 01 82 01 b4 01 de 01 df 29 00 00 11 07 02 0b 02 43 02 6b 02 a0 02 c4 02 f6 03 06 03 18 29 00 00 0d 08 03 2c 03 44 03 61 03 88 03 c5 03 ff 29 00 00 11 09 00 00 00 2e 00 5d 00 7d 00 95 00 aa 00 c0 00 cf 29 00 00 11 0a 00 df 01 0d 01 30 01 61 01 82 01 b4 01 de 01 df 29 00 00 11 0b 02 0b 02 43 02 6b 02 a0 02 c4 02 f6 03 06 03 18 29 00 00 0d 0c 03 2c 03 44 03 61 03 88 03 c5 03 ff 29 00 00 11 0d 00 00 00 2e 00 5d 00 7d 00 95 00 aa 00 c0 00 cf 29 00 00 11 0e 00 df 01 0d 01 30 01 61 01 82 01 b4 01 de 01 df 29 00 00 11 0f 02 0b 02 43 02 6b 02 a0 02 c4 02 f6 03 06 03 18 29 00 00 0d 10 03 2c 03 44 03 61 03 88 03 c5 03 ff 29 00 00 11 11 00 00 00 2e 00 5d 00 7d 00 95 00 aa 00 c0 00 cf 29 00 00 11 12 00 df 01 0d 01 30 01 61 01 82 01 b4 01 de 01 df 29 00 00 11 13 02 0b 02 43 02 6b 02 a0 02 c4 02 f6 03 06 03 18 29 00 00 0d 14 03 2c 03 44 03 61 03 88 03 c5 03 ff 29 00 00 11 15 00 00 00 2e 00 5d 00 7d 00 95 00 aa 00 c0 00 cf 29 00 00 11 16 00 df 01 0d 01 30 01 61 01 82 01 b4 01 de 01 df 29 00 00 11 17 02 0b 02 43 02 6b 02 a0 02 c4 02 f6 03 06 03 18 29 00 00 0d 18 03 2c 03 44 03 61 03 88 03 c5 03 ff 29 00 00 02 2d 65 29 00 00 02 37 01 29 00 00 02 2e 00 29 00 00 02 32 00 29 00 00 02 33 18 29 00 00 02 b9 31 29 00 00 02 b8 b7 29 00 00 02 35 16 29 00 00 02 36 0c 29 00 00 02 30 00 29 00 00 11 1f 0a 00 20 00 44 00 70 00 a8 00 e6 00 0a 00 20 00 29 00 00 09 20 44 00 70 00 a8 00 ff 00 29 00 00 11 21 a7 00 b2 00 c0 00 cd 00 da 00 f3 00 d8 00 d8 00 29 00 00 09 22 d8 00 d8 00 d8 00 ff 00 29 00 00 11 23 00 00 00 00 00 00 00 00 00 00 00 00 00 00 00 00 29 00 00 09 24 00 00 00 00 00 00 00 00 29 00 00 02 ff 26 29 00 00 05 1d 0c 00 00 00 29 00 00 02 ff 24 29 00 00 03 03 01 dd 29 00 00 02 50 aa 29 00 00 02 ff 22 29 00 00 02 1f 06 29 00 00 02 ff a3 29 00 00 02 fa 01 29 00 00 02 35 00 29 00 00 02 45 10 29 00 00 02 05 05 29 00 00 02 ff 10 29 00 00 03 51 00 00 29 00 00 02 53 2c 29 00 00 02 55 01 29 00 00 02 36 08 29 00 00 02 69 00 29 00 00 02 35 00 05 78 00 01 11 05 78 00 01 29 ];
					sprd,sleep-in-command = [ 39 00 00 04 ff 55 aa 66 15 00 00 02 ff 20 15 00 00 02 4a 01 15 00 00 02 48 10 15 00 00 02 49 00 15 00 00 02 ff 21 15 00 00 02 fb 00 15 00 00 02 d1 00 15 00 00 02 ff 10 05 64 00 01 28 05 78 00 01 10 39 00 00 04 ff 55 aa 66 15 00 00 02 ff 26 15 00 00 02 fb 00 39 00 00 05 1d a2 aa aa 0a 15 00 00 02 ff 10 15 00 00 02 fb 00 15 00 00 02 4f 01 ];
					sprd,sleep-gesture-command = [ 39 00 00 04 ff 55 aa 66 15 00 00 02 ff 20 15 00 00 02 4a 01 15 00 00 02 48 10 15 00 00 02 49 00 15 00 00 02 ff 21 15 00 00 02 fb 00 15 00 00 02 d1 00 15 00 00 02 ff 10 05 64 00 01 28 05 78 00 01 10 ];
					sprd,sleep-out-command = [ 05 78 00 01 11 05 23 00 01 29 ];
					sprd,cabc-ui-mode = [ 15 00 00 02 55 01 ];
					sprd,cabc-mov-mode = [ 15 00 00 02 55 03 ];
					sprd,cabc-off-mode = [ 15 00 00 02 55 02 ];
					phandle = < 0x29 >;

					oled-backlight {
						default-brightness-level = < 0x65 >;
						sprd,max-level = < 0xfff >;
						brightness-levels = [ 39 00 00 03 51 0f ff ];
					};

					display-timings {
						native-mode = < 0x03 >;

						timing0 {
							clock-frequency = < 0x5b8d800 >;
							hactive = < 0x2d0 >;
							vactive = < 0x640 >;
							hback-porch = < 0x58 >;
							hfront-porch = < 0x58 >;
							vback-porch = < 0x1c >;
							vfront-porch = < 0x8c >;
							hsync-len = < 0x04 >;
							vsync-len = < 0x06 >;
							phandle = < 0x03 >;
						};
					};
				};

				lcd_ili9882q_truly_mipi_hdp {
					sprd,dsi-work-mode = < 0x01 >;
					sprd,dsi-lane-number = < 0x04 >;
					sprd,dsi-color-format = "rgb888";
					sprd,phy-bit-clock = < 0xa1220 >;
					sprd,phy-escape-clock = < 0x4e20 >;
					sprd,width-mm = < 0x44 >;
					sprd,height-mm = < 0x97 >;
					sprd,esd-check-enable = < 0x01 >;
					sprd,esd-check-mode = < 0x01 >;
					sprd,esd-check-period = < 0x7d0 >;
					sprd,esd-check-register = < 0x0a >;
					sprd,esd-check-value = < 0x9c >;
					sprd,reset-on-sequence = < 0x00 0x0a 0x01 0x05 0x00 0x05 0x01 0x1e >;
					sprd,reset-off-sequence = < 0x00 0x05 >;
					sprd,use-dcs-write;
					sprd,initial-command = [ 39 00 00 04 ff 98 82 03 39 00 00 02 b3 f2 39 00 00 02 b4 cc 39 00 00 04 ff 98 82 00 39 00 00 03 68 03 00 39 00 00 03 51 00 00 15 00 00 02 53 2c 15 00 00 02 55 01 15 00 00 02 35 00 05 64 00 01 11 39 78 00 04 ff 98 82 0b 39 00 00 02 9a 88 39 00 00 02 9b ee 39 00 00 02 9c 06 39 00 00 02 9d 06 39 00 00 02 9e df 39 00 00 02 9f df 39 00 00 02 aa 22 39 78 00 04 ff 98 82 02 39 00 00 02 06 8d 39 00 00 02 0b a0 39 00 00 02 0c 00 39 00 00 02 0d 22 39 00 00 02 0e e8 39 00 00 04 ff 98 82 00 05 14 00 01 29 ];
					sprd,sleep-in-command = [ 39 01 00 04 ff 98 82 00 05 14 00 01 28 05 64 00 01 10 ];
					sprd,sleep-out-command = [ 39 00 00 04 ff 98 82 00 05 64 00 01 11 05 14 00 01 29 ];
					sprd,cabc-ui-mode = [ 15 00 00 02 55 01 ];
					sprd,cabc-mov-mode = [ 15 00 00 02 55 02 ];
					sprd,cabc-off-mode = [ 15 00 00 02 55 00 ];
					phandle = < 0x2a >;

					oled-backlight {
						default-brightness-level = < 0x65 >;
						sprd,max-level = < 0xfff >;
						brightness-levels = [ 39 00 00 03 51 0f ff ];
					};

					display-timings {
						native-mode = < 0x04 >;

						timing0 {
							clock-frequency = < 0x5b8d800 >;
							hactive = < 0x2d0 >;
							vactive = < 0x640 >;
							hback-porch = < 0x3c >;
							hfront-porch = < 0x3c >;
							vback-porch = < 0x1e >;
							vfront-porch = < 0xe8 >;
							hsync-len = < 0x14 >;
							vsync-len = < 0x04 >;
							phandle = < 0x04 >;
						};
					};
				};

				lcd_ili9882q_huarui_mipi_hdp {
					sprd,dsi-work-mode = < 0x01 >;
					sprd,dsi-lane-number = < 0x04 >;
					sprd,dsi-color-format = "rgb888";
					sprd,phy-bit-clock = < 0xb17d8 >;
					sprd,phy-escape-clock = < 0x4e20 >;
					sprd,width-mm = < 0x44 >;
					sprd,height-mm = < 0x97 >;
					sprd,esd-check-enable = < 0x01 >;
					sprd,esd-check-mode = < 0x01 >;
					sprd,esd-check-period = < 0x7d0 >;
					sprd,esd-check-register = < 0x0a >;
					sprd,esd-check-value = < 0x9c >;
					sprd,reset-on-sequence = < 0x00 0x0a 0x01 0x05 0x00 0x05 0x01 0x1e >;
					sprd,reset-off-sequence = < 0x00 0x05 >;
					sprd,use-dcs-write;
					sprd,initial-command = < 0x29000004 0xff988201 0x29000002 0x482900 0x20133 0x29000002 0x2002900 0x20300 0x29000002 0x4042900 0x20513 0x29000002 0x6002900 0x20700 0x29000002 0x8862900 0x20902 0x29000002 0xa732900 0x20b00 0x29000002 0xc062900 0x20d06 0x29000002 0xe002900 0x20f00 0x29000002 0x1a002900 0x21b00 0x29000002 0x1c002900 0x21d00 0x29000002 0x288a2900 0x22949 0x29000002 0x2a8a2900 0x22b49 0x29000002 0x310c2900 0x2322a 0x29000002 0x332a2900 0x23422 0x29000002 0x35022900 0x23608 0x29000002 0x370a2900 0x23823 0x29000002 0x39232900 0x23a10 0x29000002 0x3b102900 0x23c12 0x29000002 0x3d122900 0x23e14 0x29000002 0x3f142900 0x24016 0x29000002 0x41162900 0x24207 0x29000002 0x43072900 0x24407 0x29000002 0x45072900 0x24607 0x29000002 0x470d2900 0x2482a 0x29000002 0x492a2900 0x24a22 0x29000002 0x4b022900 0x24c09 0x29000002 0x4d0b2900 0x24e23 0x29000002 0x4f232900 0x25011 0x29000002 0x51112900 0x25213 0x29000002 0x53132900 0x25415 0x29000002 0x55152900 0x25617 0x29000002 0x57172900 0x25807 0x29000002 0x59072900 0x25a07 0x29000002 0x5b072900 0x25c07 0x29000004 0xff988202 0x29000002 0xf11c2900 0x24b5a 0x29000002 0x50ca2900 0x25100 0x29000002 0x68d2900 0x20ba0 0x29000002 0xc002900 0x20d22 0x29000002 0xee62900 0x24e11 0x29000002 0x4dce2900 0x2f24a 0x29000004 0xff988205 0x29000002 0x3012900 0x2042b 0x29000002 0x58612900 0x2639c 0x29000002 0x649c2900 0x268a1 0x29000002 0x69a72900 0x26a79 0x29000002 0x6b6b2900 0x28537 0x29000004 0xff988206 0x29000002 0xd91f2900 0x2c040 0x29000002 0xc1162900 0x28009 0x29000002 0x6a42900 0x4ff98 0x82033900 0x2b3f2 0x39000002 0xb4cc2900 0x28320 0x29000002 0x84002900 0x4ff98 0x82082900 0x1ce000 0x245f8ac5 0x54f82153 0x7ea5c2f8 0x2651aa7c 0xaccaf1ff 0x133f77a7 0x3ec2900 0x1ce100 0x245f8ac5 0x54f82153 0x7ea5c2f8 0x2651aa7c 0xaccaf1ff 0x133f77a7 0x3ec2900 0x4ff98 0x820b2900 0x29a88 0x29000002 0x9bee2900 0x29c06 0x29000002 0x9d062900 0x29edf 0x29000002 0x9fdf2900 0x2aa22 0x29000002 0xabe02900 0x2ac7f 0x29000002 0xad3f2900 0x4ff98 0x820e2900 0x21110 0x29000002 0x12082900 0x21310 0x29000002 0xa02900 0x4ff98 0x82002900 0x23500 0x29000003 0x51000029 0x368 0x3002900 0x2532c 0x29000002 0x55010564 0x11105 0x14000129 >;
					sprd,sleep-in-command = [ 05 14 00 01 28 05 64 00 01 10 ];
					sprd,sleep-out-command = [ 05 64 00 01 11 05 14 00 01 29 ];
					sprd,cabc-ui-mode = [ 15 00 00 02 55 01 ];
					sprd,cabc-mov-mode = [ 15 00 00 02 55 02 ];
					sprd,cabc-off-mode = [ 15 00 00 02 55 00 ];
					phandle = < 0x2b >;

					oled-backlight {
						default-brightness-level = < 0x65 >;
						sprd,max-level = < 0xfff >;
						brightness-levels = [ 39 00 00 03 51 0f ff ];
					};

					display-timings {
						native-mode = < 0x05 >;

						timing0 {
							clock-frequency = < 0x5b8d800 >;
							hactive = < 0x2d0 >;
							vactive = < 0x640 >;
							hback-porch = < 0x3c >;
							hfront-porch = < 0x3c >;
							vback-porch = < 0x20 >;
							vfront-porch = < 0xe6 >;
							hsync-len = < 0x14 >;
							vsync-len = < 0x02 >;
							phandle = < 0x05 >;
						};
					};
				};

				lcd_gc7202h_hlt_mipi_hdp {
					sprd,dsi-work-mode = < 0x01 >;
					sprd,dsi-lane-number = < 0x04 >;
					sprd,dsi-color-format = "rgb888";
					sprd,phy-bit-clock = < 0xa6428 >;
					sprd,phy-escape-clock = < 0x4e20 >;
					sprd,width-mm = < 0x44 >;
					sprd,height-mm = < 0x97 >;
					sprd,esd-check-enable = < 0x01 >;
					sprd,esd-check-mode = < 0x01 >;
					sprd,esd-check-period = < 0x7d0 >;
					sprd,esd-check-reg-count = < 0x01 >;
					sprd,esd-check-register = [ dd ];
					sprd,esd-check-value-len = < 0x01 >;
					sprd,esd-check-value = [ 9c ];
					sprd,reset-on-sequence = < 0x01 0x0a 0x00 0x0a 0x01 0x19 >;
					sprd,reset-off-sequence = < 0x01 0x46 0x00 0x0a >;
					sprd,use-dcs-write;
					sprd,bta-enable = < 0x00 >;
					sprd,bta-check-register = < 0xdd >;
					sprd,initial-command = [ 39 00 00 04 ff 55 aa 66 29 00 00 02 ff b3 29 00 00 02 2b 0c 29 00 00 02 29 3f 29 00 00 02 28 c0 29 00 00 02 2a 03 29 00 00 02 68 0f 29 00 00 02 ff 10 29 00 00 02 fb 00 29 00 00 02 ff 20 29 00 00 02 fb 00 29 00 00 02 ff 21 29 00 00 02 fb 00 29 00 00 02 ff 22 29 00 00 02 fb 00 29 00 00 02 ff 23 29 00 00 02 fb 00 29 00 00 02 ff 27 29 00 00 02 fb 00 29 00 00 02 ff 26 29 00 00 02 fb 00 29 00 00 02 ff 28 29 00 00 02 fb 00 29 00 00 02 ff b3 29 00 00 02 fb 00 29 00 00 02 ff 28 29 00 00 02 53 44 29 00 00 02 50 4c 29 00 00 02 52 53 29 00 00 02 4d a2 29 00 00 02 ff 20 29 00 00 02 a5 00 29 00 00 02 a6 ff 29 00 00 02 a9 00 29 00 00 02 aa ff 29 00 00 02 d3 06 29 00 00 02 2d 1f 29 00 00 02 2e 42 29 00 00 02 2f 14 29 00 00 02 ff 22 29 00 00 02 1f 06 29 00 00 02 ff b3 29 00 00 02 3e 03 29 00 00 02 58 84 29 00 00 02 53 1a 29 00 00 02 82 19 29 00 00 02 4a 0f 29 00 00 02 7d 80 29 00 00 02 5b 4b 29 00 00 02 48 26 29 00 00 02 7c 8c 29 00 00 02 ff 10 29 00 00 03 71 1f 98 29 00 00 02 ff 20 29 00 00 02 a3 45 29 00 00 02 a7 45 29 00 00 02 ff 26 29 00 00 02 1c 29 29 00 00 02 ff b3 29 00 00 02 b4 44 29 00 00 02 3f 37 29 00 00 02 5e 10 29 00 00 02 ff 22 29 00 00 02 e4 01 29 00 00 02 01 06 29 00 00 02 02 40 29 00 00 02 25 08 29 00 00 02 26 00 29 00 00 02 2e 6f 29 00 00 02 2f 00 29 00 00 02 36 0d 29 00 00 02 37 00 29 00 00 02 3f 6f 29 00 00 02 40 00 29 00 00 02 ff 28 29 00 00 02 01 25 29 00 00 02 02 1a 29 00 00 02 03 1a 29 00 00 02 04 02 29 00 00 02 05 20 29 00 00 02 06 21 29 00 00 02 07 08 29 00 00 02 08 0a 29 00 00 02 09 0c 29 00 00 02 0a 0e 29 00 00 02 0b 10 29 00 00 02 0c 12 29 00 00 02 0d 00 29 00 00 02 0e 25 29 00 00 02 0f 25 29 00 00 02 10 25 29 00 00 02 11 25 29 00 00 02 12 25 29 00 00 02 13 25 29 00 00 02 14 25 29 00 00 02 15 25 29 00 00 02 16 25 29 00 00 02 17 25 29 00 00 02 18 1a 29 00 00 02 19 1a 29 00 00 02 1a 03 29 00 00 02 1b 20 29 00 00 02 1c 21 29 00 00 02 1d 09 29 00 00 02 1e 0b 29 00 00 02 1f 0d 29 00 00 02 20 0f 29 00 00 02 21 11 29 00 00 02 22 13 29 00 00 02 23 01 29 00 00 02 24 25 29 00 00 02 25 25 29 00 00 02 26 25 29 00 00 02 27 25 29 00 00 02 28 25 29 00 00 02 29 25 29 00 00 02 2a 25 29 00 00 02 2b 25 29 00 00 02 2d 25 29 00 00 02 30 00 29 00 00 02 31 00 29 00 00 02 34 00 29 00 00 02 35 15 29 00 00 02 38 00 29 00 00 02 39 00 29 00 00 02 3a 01 29 00 00 02 3b 05 29 00 00 02 2f 1d 29 00 00 02 ff 21 29 00 00 02 7e 07 29 00 00 02 7f 24 29 00 00 02 8b 24 29 00 00 02 97 24 29 00 00 02 80 04 29 00 00 02 8c 00 29 00 00 02 98 1b 29 00 00 02 af 42 29 00 00 02 b0 42 29 00 00 02 b1 42 29 00 00 02 83 05 29 00 00 02 8f 05 29 00 00 02 9b 05 29 00 00 02 84 5f 29 00 00 02 90 5f 29 00 00 02 9c 5f 29 00 00 02 85 5f 29 00 00 02 91 5f 29 00 00 02 9d 5f 29 00 00 02 87 0d 29 00 00 02 93 05 29 00 00 02 9f 09 29 00 00 02 82 70 29 00 00 02 8e 70 29 00 00 02 9a 70 29 00 00 02 2b 00 29 00 00 02 2e 00 29 00 00 02 88 a7 29 00 00 02 89 20 29 00 00 02 8a 33 29 00 00 02 94 a7 29 00 00 02 95 20 29 00 00 02 96 33 29 00 00 02 a0 a7 29 00 00 02 a1 20 29 00 00 02 a2 33 29 00 00 02 45 0f 29 00 00 02 46 74 29 00 00 02 4c 74 29 00 00 02 52 74 29 00 00 02 58 74 29 00 00 02 47 05 29 00 00 02 4d 04 29 00 00 02 53 20 29 00 00 02 59 21 29 00 00 02 76 44 29 00 00 02 77 44 29 00 00 02 78 44 29 00 00 02 79 44 29 00 00 02 49 5f 29 00 00 02 4a 5f 29 00 00 02 4f 5f 29 00 00 02 50 5f 29 00 00 02 55 5f 29 00 00 02 56 5f 29 00 00 02 5b 5f 29 00 00 02 5c 5f 29 00 00 02 ca 03 29 00 00 02 cb 3c 29 00 00 02 cd 3c 29 00 00 02 cc 20 29 00 00 02 ce 20 29 00 00 02 cf 76 29 00 00 02 d0 72 29 00 00 02 c2 84 29 00 00 02 c6 46 29 00 00 02 ff 22 29 00 00 02 05 10 29 00 00 02 08 10 29 00 00 02 ff 20 29 00 00 02 c3 00 29 00 00 02 c4 71 29 00 00 02 c5 00 29 00 00 02 c6 71 29 00 00 02 b3 00 29 00 00 02 b4 20 29 00 00 02 b5 00 29 00 00 02 b6 dc 29 00 00 02 ff 28 29 00 00 02 3d 41 29 00 00 02 3e 41 29 00 00 02 3f 5a 29 00 00 02 40 5a 29 00 00 02 45 45 29 00 00 02 46 45 29 00 00 02 47 57 29 00 00 02 48 57 29 00 00 02 5a 8e 29 00 00 02 5b 8e 29 00 00 02 ff 20 29 00 00 02 7e 01 29 00 00 02 7f 00 29 00 00 02 80 64 29 00 00 02 81 00 29 00 00 02 82 00 29 00 00 02 83 64 29 00 00 02 84 64 29 00 00 02 85 2e 29 00 00 02 86 21 29 00 00 02 87 2e 29 00 00 02 88 21 29 00 00 02 8a 0a 29 00 00 02 8b 0a 29 00 00 02 ff 23 29 00 00 02 29 03 39 00 00 11 01 00 0a 00 1b 00 55 00 7a 00 99 00 b1 00 c5 00 da 39 00 00 11 02 00 e9 01 21 01 4a 01 87 01 b3 01 f8 02 33 02 35 39 00 00 11 03 02 74 02 c0 02 ef 03 2a 03 50 03 7e 03 8b 03 98 39 00 00 0d 04 03 a7 03 b7 03 ca 03 dd 03 f3 03 ff 39 00 00 11 0d 00 0a 00 1b 00 55 00 7a 00 99 00 b1 00 c5 00 da 39 00 00 11 0e 00 e9 01 21 01 4a 01 87 01 b3 01 f8 02 33 02 35 39 00 00 11 0f 02 74 02 c0 02 ef 03 2a 03 50 03 7e 03 8b 03 98 39 00 00 0d 10 03 a7 03 b7 03 ca 03 dd 03 f3 03 ff 29 00 00 02 2b 01 29 00 00 02 2d 65 29 00 00 02 37 01 29 00 00 02 2e 00 29 00 00 02 32 00 29 00 00 02 33 29 29 00 00 02 b9 31 29 00 00 02 b8 b7 29 00 00 02 35 cc 29 00 00 02 36 0c 29 00 00 02 30 00 39 00 00 0d 1f d8 d8 d8 d8 d8 d8 d8 d8 d8 d8 d8 ff 39 00 00 0d 20 00 00 00 00 00 00 00 00 00 00 00 00 39 00 00 0d 21 d8 d8 d8 d8 d8 d8 d8 d8 d8 d8 d8 ff 39 00 00 0d 22 00 00 00 00 00 00 00 00 00 00 00 00 39 00 00 0d 23 d8 d8 d8 d8 d8 d8 d8 d8 d8 d8 d8 ff 39 00 00 0d 24 00 00 00 00 00 00 00 00 00 00 00 00 39 00 00 0d 25 10 24 38 4c 60 74 88 9c b0 c4 f0 ff 29 00 00 02 ff 22 29 00 00 02 ef 04 29 00 00 02 ff 10 29 00 00 02 35 00 29 00 00 02 53 2c 39 00 00 03 51 00 00 29 00 00 02 55 00 29 00 00 02 ff 10 29 00 00 02 36 08 29 00 00 02 69 00 05 78 00 01 11 05 14 00 01 29 ];
					sprd,sleep-in-command = [ 39 00 00 04 ff 55 aa 66 29 00 00 02 ff 20 29 00 00 02 4a 01 29 00 00 02 48 10 29 00 00 02 49 00 29 00 00 02 ff 10 29 32 00 02 28 00 29 78 00 02 10 00 29 00 00 02 fb 00 29 00 00 02 4f 01 ];
					sprd,sleep-gesture-command = [ 39 00 00 04 ff 55 aa 66 29 00 00 02 ff 20 29 00 00 02 4a 01 29 00 00 02 48 10 29 00 00 02 49 00 29 00 00 02 ff 10 29 32 00 02 28 00 29 78 00 02 10 00 ];
					sprd,sleep-out-command = [ 05 78 00 01 11 05 23 00 01 29 ];
					sprd,cabc-ui-mode = [ 15 00 00 02 55 01 ];
					sprd,cabc-mov-mode = [ 15 00 00 02 55 03 ];
					sprd,cabc-off-mode = [ 15 00 00 02 55 00 ];
					phandle = < 0x2c >;

					oled-backlight {
						default-brightness-level = < 0x65 >;
						sprd,max-level = < 0xfff >;
						brightness-levels = [ 39 00 00 03 51 0f ff ];
					};

					display-timings {
						native-mode = < 0x06 >;

						timing0 {
							clock-frequency = < 0x5b8d800 >;
							hactive = < 0x2d0 >;
							vactive = < 0x640 >;
							hback-porch = < 0x58 >;
							hfront-porch = < 0x58 >;
							vback-porch = < 0x1c >;
							vfront-porch = < 0x8c >;
							hsync-len = < 0x04 >;
							vsync-len = < 0x06 >;
							phandle = < 0x06 >;
						};
					};
				};

				lcd_icnl9911c_txd_mipi_hdp {
					sprd,dsi-work-mode = < 0x01 >;
					sprd,dsi-lane-number = < 0x04 >;
					sprd,dsi-color-format = "rgb888";
					sprd,phy-bit-clock = < 0xa1220 >;
					sprd,phy-escape-clock = < 0x4e20 >;
					sprd,width-mm = < 0x44 >;
					sprd,height-mm = < 0x97 >;
					sprd,esd-check-enable = < 0x01 >;
					sprd,esd-check-mode = < 0x01 >;
					sprd,esd-check-period = < 0x7d0 >;
					sprd,reset-on-sequence = < 0x00 0x05 0x01 0x05 0x00 0x05 0x01 0x1e >;
					sprd,reset-off-sequence = < 0x00 0x05 >;
					sprd,use-dcs-write;
					sprd,pre-write = [ 29 00 00 03 f0 5a 59 29 00 00 03 f1 a5 a6 ];
					sprd,initial-command = [ 39 00 00 03 f0 5a 59 39 00 00 03 f1 a5 a6 39 00 00 1f b0 87 86 05 04 8a 8b 04 05 55 55 55 55 0a 00 00 64 00 00 0f 05 04 03 02 01 02 03 04 00 00 00 39 00 00 1e b1 53 42 85 00 0a 00 00 64 00 00 04 08 54 00 00 00 44 40 02 01 40 02 01 40 02 01 40 02 01 39 00 00 12 b2 54 84 85 05 40 02 01 40 02 01 05 05 54 0c 0c 0d 0b 39 00 00 20 b3 02 0e 0b 0e 0b 26 26 91 a2 33 44 00 26 00 18 01 02 08 20 30 08 09 44 20 40 20 40 08 09 22 33 39 00 00 1d b4 02 02 00 00 e3 09 22 00 22 0d 0f 11 13 05 02 02 02 02 02 02 02 02 ff ff fc 00 00 00 39 00 00 1d b5 00 00 00 00 e3 08 22 00 22 0c 0e 10 12 04 02 02 02 02 02 02 02 02 ff ff fc 00 00 00 39 00 00 19 b8 00 00 00 00 00 00 00 00 00 00 00 00 aa aa aa aa aa a0 aa aa aa aa aa a0 39 00 00 0e bb 01 05 09 11 0d 19 1d 55 25 69 00 21 25 39 00 00 0f bc 00 00 00 00 02 20 ff 00 03 33 01 73 33 00 39 00 00 0b bd e9 02 4e cf 72 a4 08 44 ae 15 39 00 00 0b be 77 77 3d 51 0c 77 43 07 0e 0e 39 00 00 09 bf 07 25 07 25 7f 00 11 04 39 00 00 0a c0 10 00 1f ff ff ff 00 ff 00 39 00 00 14 c1 c0 24 20 96 04 54 54 04 2a 40 36 00 07 c0 10 ff 94 01 c0 15 00 00 02 c2 00 39 00 00 0a c3 06 00 ff 00 ff 00 00 81 01 39 00 00 0b c4 84 01 2b 41 00 3c 00 03 03 2e 39 00 00 0c c5 03 1c c0 c0 40 10 42 44 0f 0f 14 39 00 00 0b c6 87 96 2a 29 29 33 7f 34 08 04 39 00 00 17 c7 d3 b0 90 77 4b 2b fb 4f 17 eb bf 8f e8 bd a1 7a 64 46 1a 7e c0 00 39 00 00 17 c8 fc b1 90 77 4b 2b fb 4f 17 eb bf 8f e8 bd a1 7a 64 46 3a 7e c0 00 15 00 00 02 cb 00 39 00 00 06 d0 80 0d ff 0f 61 15 00 00 02 d2 42 39 00 00 04 fa 45 93 01 39 00 00 05 fe ff ff ff 40 39 00 00 1b e0 30 00 80 88 11 3f 22 62 df a0 04 cc 01 ff f6 ff f0 fd ff fd f8 f5 fc fc fd ff 39 00 00 18 e1 ef fe fe fe fe ee f0 20 33 ff 00 00 6a 90 c0 0d 6a f0 3e ff 00 06 40 39 00 00 03 f1 5a 59 39 00 00 03 f0 a5 a6 39 00 00 03 51 00 00 15 00 00 02 53 2c 15 00 00 02 55 01 15 00 00 02 35 00 05 78 00 01 11 05 14 00 01 29 39 00 00 02 26 01 ];
					sprd,sleep-in-command = < 0x15000002 0x26080514 0x12805 0x64000110 >;
					sprd,sleep-out-command = < 0x5640001 0x11051400 0x1291500 0x22601 >;
					sprd,cabc-ui-mode = < 0x39000003 0xf05a5939 0x3f1 0xa5a63900 0x1be030 0x1a09801 0x1f2262df 0xa004cc01 0xfff8f8fa 0xfdf9f8f8 0xf8fcfcf0 0xff390000 0x18e1dfff 0xeffeffff 0xf0ae3535 0x35513535 0xf435325b 0x84ae000b 0xe4390000 0x3ea4650 0x39000003 0xf15a5939 0x3f0 0xa5a61500 0x25501 >;
					sprd,cabc-mov-mode = < 0x39000003 0xf05a5939 0x3f1 0xa5a63900 0x1be030 0x1a09801 0x1f2262df 0xa004cc01 0xfffcfcf0 0xfdfffcf8 0xfcf2fcf0 0xff390000 0x18e1cccc 0xcccccdde 0xe0ccd0d0 0xd0d0d0d0 0xd0d073ee 0x6dee000b 0xe4390000 0x3ea4650 0x39000003 0xf15a5939 0x3f0 0xa5a61500 0x25503 >;
					sprd,cabc-off-mode = [ 15 00 00 02 55 00 ];
					phandle = < 0x2d >;

					oled-backlight {
						default-brightness-level = < 0x65 >;
						sprd,max-level = < 0xfff >;
						brightness-levels = [ 39 00 00 03 51 0f ff ];
					};

					display-timings {
						native-mode = < 0x07 >;

						timing0 {
							clock-frequency = < 0x5b8d800 >;
							hactive = < 0x2d0 >;
							vactive = < 0x640 >;
							hback-porch = < 0x54 >;
							hfront-porch = < 0x54 >;
							vback-porch = < 0x24 >;
							vfront-porch = < 0x96 >;
							hsync-len = < 0x04 >;
							vsync-len = < 0x04 >;
							phandle = < 0x07 >;
						};
					};
				};

				lcd_nt35695_truly_mipi_fhd {
					sprd,dsi-work-mode = < 0x01 >;
					sprd,dsi-lane-number = < 0x04 >;
					sprd,dsi-color-format = "rgb888";
					sprd,phy-bit-clock = < 0xf4240 >;
					sprd,phy-escape-clock = < 0x4e20 >;
					sprd,width-mm = < 0x44 >;
					sprd,height-mm = < 0x79 >;
					sprd,esd-check-enable = < 0x01 >;
					sprd,esd-check-mode = < 0x01 >;
					sprd,esd-check-period = < 0x7d0 >;
					sprd,reset-on-sequence = < 0x01 0x05 0x00 0x05 0x01 0x14 >;
					sprd,reset-off-sequence = < 0x01 0x05 >;
					sprd,initial-command = [ 23 00 00 02 ff 20 23 00 00 02 00 01 23 00 00 02 01 55 23 00 00 02 02 45 23 00 00 02 03 55 23 00 00 02 05 50 23 00 00 02 06 4a 23 00 00 02 07 24 23 00 00 02 08 0c 23 00 00 02 0b 87 23 00 00 02 0c 87 23 00 00 02 0e b0 23 00 00 02 0f b3 23 00 00 02 11 25 23 00 00 02 12 10 23 00 00 02 13 03 23 00 00 02 14 4a 23 00 00 02 15 12 23 00 00 02 16 12 23 00 00 02 30 01 23 00 00 02 58 82 23 00 00 02 59 00 23 00 00 02 5a 02 23 00 00 02 5b 00 23 00 00 02 5c 82 23 00 00 02 5d 82 23 00 00 02 5e 02 23 00 00 02 5f 02 23 00 00 02 72 31 23 00 00 02 fb 01 23 00 00 02 75 00 23 00 00 02 76 00 23 00 00 02 77 00 23 00 00 02 78 06 23 00 00 02 79 00 23 00 00 02 7a 1a 23 00 00 02 7b 00 23 00 00 02 7c 37 23 00 00 02 7d 00 23 00 00 02 7e 5a 23 00 00 02 7f 00 23 00 00 02 80 75 23 00 00 02 81 00 23 00 00 02 82 8d 23 00 00 02 83 00 23 00 00 02 84 a0 23 00 00 02 85 00 23 00 00 02 86 b1 23 00 00 02 87 00 23 00 00 02 88 e4 23 00 00 02 89 01 23 00 00 02 8a 07 23 00 00 02 8b 01 23 00 00 02 8c 36 23 00 00 02 8d 01 23 00 00 02 8e 5d 23 00 00 02 8f 01 23 00 00 02 90 a9 23 00 00 02 91 01 23 00 00 02 92 e1 23 00 00 02 93 01 23 00 00 02 94 e3 23 00 00 02 95 02 23 00 00 02 96 11 23 00 00 02 97 02 23 00 00 02 98 54 23 00 00 02 99 02 23 00 00 02 9a 7f 23 00 00 02 9b 02 23 00 00 02 9c bd 23 00 00 02 9d 02 23 00 00 02 9e e5 23 00 00 02 9f 03 23 00 00 02 a0 1b 23 00 00 02 a2 03 23 00 00 02 a3 25 23 00 00 02 a4 03 23 00 00 02 a5 28 23 00 00 02 a6 03 23 00 00 02 a7 3a 23 00 00 02 a9 03 23 00 00 02 aa 5d 23 00 00 02 ab 03 23 00 00 02 ac a4 23 00 00 02 ad 03 23 00 00 02 ae c1 23 00 00 02 af 03 23 00 00 02 b0 d3 23 00 00 02 b1 03 23 00 00 02 b2 d8 23 00 00 02 b3 00 23 00 00 02 b4 00 23 00 00 02 b5 00 23 00 00 02 b6 06 23 00 00 02 b7 00 23 00 00 02 b8 1a 23 00 00 02 b9 00 23 00 00 02 ba 37 23 00 00 02 bb 00 23 00 00 02 bc 5a 23 00 00 02 bd 00 23 00 00 02 be 75 23 00 00 02 bf 00 23 00 00 02 c0 8d 23 00 00 02 c1 00 23 00 00 02 c2 a0 23 00 00 02 c3 00 23 00 00 02 c4 b1 23 00 00 02 c5 00 23 00 00 02 c6 e4 23 00 00 02 c7 01 23 00 00 02 c8 07 23 00 00 02 c9 01 23 00 00 02 ca 36 23 00 00 02 cb 01 23 00 00 02 cc 5d 23 00 00 02 cd 01 23 00 00 02 ce a9 23 00 00 02 cf 01 23 00 00 02 d0 e1 23 00 00 02 d1 01 23 00 00 02 d2 e3 23 00 00 02 d3 02 23 00 00 02 d4 11 23 00 00 02 d5 02 23 00 00 02 d6 54 23 00 00 02 d7 02 23 00 00 02 d8 7f 23 00 00 02 d9 02 23 00 00 02 da bd 23 00 00 02 db 02 23 00 00 02 dc e5 23 00 00 02 dd 03 23 00 00 02 de 1b 23 00 00 02 df 03 23 00 00 02 e0 25 23 00 00 02 e1 03 23 00 00 02 e2 28 23 00 00 02 e3 03 23 00 00 02 e4 3a 23 00 00 02 e5 03 23 00 00 02 e6 5d 23 00 00 02 e7 03 23 00 00 02 e8 a4 23 00 00 02 e9 03 23 00 00 02 ea c1 23 00 00 02 eb 03 23 00 00 02 ec d3 23 00 00 02 ed 03 23 00 00 02 ee d8 23 00 00 02 ef 00 23 00 00 02 f0 ba 23 00 00 02 f1 00 23 00 00 02 f2 c1 23 00 00 02 f3 00 23 00 00 02 f4 d1 23 00 00 02 f5 00 23 00 00 02 f6 de 23 00 00 02 f7 00 23 00 00 02 f8 e7 23 00 00 02 f9 00 23 00 00 02 fa f0 23 00 00 02 ff 21 23 00 00 02 00 00 23 00 00 02 01 fa 23 00 00 02 02 01 23 00 00 02 03 03 23 00 00 02 04 01 23 00 00 02 05 0e 23 00 00 02 06 01 23 00 00 02 07 33 23 00 00 02 08 01 23 00 00 02 09 4c 23 00 00 02 0a 01 23 00 00 02 0b 6d 23 00 00 02 0c 01 23 00 00 02 0d 8a 23 00 00 02 0e 01 23 00 00 02 0f c0 23 00 00 02 10 01 23 00 00 02 11 ef 23 00 00 02 12 01 23 00 00 02 13 f1 23 00 00 02 14 02 23 00 00 02 15 20 23 00 00 02 16 02 23 00 00 02 17 63 23 00 00 02 18 02 23 00 00 02 19 91 23 00 00 02 1a 02 23 00 00 02 1b cf 23 00 00 02 1c 02 23 00 00 02 1d f9 23 00 00 02 1e 03 23 00 00 02 1f 31 23 00 00 02 20 03 23 00 00 02 21 3d 23 00 00 02 22 03 23 00 00 02 23 40 23 00 00 02 24 03 23 00 00 02 25 51 23 00 00 02 26 03 23 00 00 02 27 71 23 00 00 02 28 03 23 00 00 02 29 85 23 00 00 02 2a 03 23 00 00 02 2b ab 23 00 00 02 2d 03 23 00 00 02 2f d6 23 00 00 02 30 03 23 00 00 02 31 d8 23 00 00 02 32 00 23 00 00 02 33 ba 23 00 00 02 34 00 23 00 00 02 35 c1 23 00 00 02 36 00 23 00 00 02 37 d1 23 00 00 02 38 00 23 00 00 02 39 de 23 00 00 02 3a 00 23 00 00 02 3b e7 23 00 00 02 3d 00 23 00 00 02 3f f0 23 00 00 02 40 00 23 00 00 02 41 fa 23 00 00 02 42 01 23 00 00 02 43 03 23 00 00 02 44 01 23 00 00 02 45 0e 23 00 00 02 46 01 23 00 00 02 47 33 23 00 00 02 48 01 23 00 00 02 49 4c 23 00 00 02 4a 01 23 00 00 02 4b 6d 23 00 00 02 4c 01 23 00 00 02 4d 8a 23 00 00 02 4e 01 23 00 00 02 4f c0 23 00 00 02 50 01 23 00 00 02 51 ef 23 00 00 02 52 01 23 00 00 02 53 f1 23 00 00 02 54 02 23 00 00 02 55 20 23 00 00 02 56 02 23 00 00 02 58 63 23 00 00 02 59 02 23 00 00 02 5a 91 23 00 00 02 5b 02 23 00 00 02 5c cf 23 00 00 02 5d 02 23 00 00 02 5e f9 23 00 00 02 5f 03 23 00 00 02 60 31 23 00 00 02 61 03 23 00 00 02 62 3d 23 00 00 02 63 03 23 00 00 02 64 40 23 00 00 02 65 03 23 00 00 02 66 51 23 00 00 02 67 03 23 00 00 02 68 71 23 00 00 02 69 03 23 00 00 02 6a 85 23 00 00 02 6b 03 23 00 00 02 6c ab 23 00 00 02 6d 03 23 00 00 02 6e d6 23 00 00 02 6f 03 23 00 00 02 70 d8 23 00 00 02 71 00 23 00 00 02 72 a7 23 00 00 02 73 00 23 00 00 02 74 ae 23 00 00 02 75 00 23 00 00 02 76 bd 23 00 00 02 77 00 23 00 00 02 78 ca 23 00 00 02 79 00 23 00 00 02 7a d4 23 00 00 02 7b 00 23 00 00 02 7c dd 23 00 00 02 7d 00 23 00 00 02 7e e6 23 00 00 02 7f 00 23 00 00 02 80 ef 23 00 00 02 81 00 23 00 00 02 82 f9 23 00 00 02 83 01 23 00 00 02 84 1d 23 00 00 02 85 01 23 00 00 02 86 36 23 00 00 02 87 01 23 00 00 02 88 5b 23 00 00 02 89 01 23 00 00 02 8a 79 23 00 00 02 8b 01 23 00 00 02 8c ba 23 00 00 02 8d 01 23 00 00 02 8e ea 23 00 00 02 8f 01 23 00 00 02 90 ed 23 00 00 02 91 02 23 00 00 02 92 1b 23 00 00 02 93 02 23 00 00 02 94 5f 23 00 00 02 95 02 23 00 00 02 96 8a 23 00 00 02 97 02 23 00 00 02 98 cc 23 00 00 02 99 02 23 00 00 02 9a fb 23 00 00 02 9b 03 23 00 00 02 9c 61 23 00 00 02 9d 03 23 00 00 02 9e af 23 00 00 02 9f 03 23 00 00 02 a0 c6 23 00 00 02 a2 03 23 00 00 02 a3 cc 23 00 00 02 a4 03 23 00 00 02 a5 ce 23 00 00 02 a6 03 23 00 00 02 a7 d2 23 00 00 02 a9 03 23 00 00 02 aa d4 23 00 00 02 ab 03 23 00 00 02 ac d7 23 00 00 02 ad 03 23 00 00 02 ae d8 23 00 00 02 af 00 23 00 00 02 b0 a7 23 00 00 02 b1 00 23 00 00 02 b2 ae 23 00 00 02 b3 00 23 00 00 02 b4 bd 23 00 00 02 b5 00 23 00 00 02 b6 ca 23 00 00 02 b7 00 23 00 00 02 b8 d4 23 00 00 02 b9 00 23 00 00 02 ba dd 23 00 00 02 bb 00 23 00 00 02 bc e6 23 00 00 02 bd 00 23 00 00 02 be ef 23 00 00 02 bf 00 23 00 00 02 c0 f9 23 00 00 02 c1 01 23 00 00 02 c2 1d 23 00 00 02 c3 01 23 00 00 02 c4 36 23 00 00 02 c5 01 23 00 00 02 c6 5b 23 00 00 02 c7 01 23 00 00 02 c8 79 23 00 00 02 c9 01 23 00 00 02 ca ba 23 00 00 02 cb 01 23 00 00 02 cc ea 23 00 00 02 cd 01 23 00 00 02 ce ed 23 00 00 02 cf 02 23 00 00 02 d0 1b 23 00 00 02 d1 02 23 00 00 02 d2 5f 23 00 00 02 d3 02 23 00 00 02 d4 8a 23 00 00 02 d5 02 23 00 00 02 d6 cc 23 00 00 02 d7 02 23 00 00 02 d8 fb 23 00 00 02 d9 03 23 00 00 02 da 61 23 00 00 02 db 03 23 00 00 02 dc af 23 00 00 02 dd 03 23 00 00 02 de c6 23 00 00 02 df 03 23 00 00 02 e0 cc 23 00 00 02 e1 03 23 00 00 02 e2 ce 23 00 00 02 e3 03 23 00 00 02 e4 d2 23 00 00 02 e5 03 23 00 00 02 e6 d4 23 00 00 02 e7 03 23 00 00 02 e8 d7 23 00 00 02 e9 03 23 00 00 02 ea d8 23 00 00 02 ff 24 23 00 00 02 00 01 23 00 00 02 01 0b 23 00 00 02 02 0c 23 00 00 02 03 09 23 00 00 02 04 0a 23 00 00 02 05 1c 23 00 00 02 06 10 23 00 00 02 07 00 23 00 00 02 08 1c 23 00 00 02 09 00 23 00 00 02 0a 00 23 00 00 02 0b 00 23 00 00 02 0c 00 23 00 00 02 0d 13 23 00 00 02 0e 15 23 00 00 02 0f 17 23 00 00 02 10 01 23 00 00 02 11 0b 23 00 00 02 12 0c 23 00 00 02 13 09 23 00 00 02 14 0a 23 00 00 02 15 1c 23 00 00 02 16 10 23 00 00 02 17 10 23 00 00 02 18 1c 23 00 00 02 19 00 23 00 00 02 1a 00 23 00 00 02 1b 00 23 00 00 02 1c 00 23 00 00 02 1d 13 23 00 00 02 1e 15 23 00 00 02 1f 17 23 00 00 02 20 00 23 00 00 02 21 03 23 00 00 02 22 01 23 00 00 02 23 4a 23 00 00 02 24 4a 23 00 00 02 25 6d 23 00 00 02 26 40 23 00 00 02 27 40 23 00 00 02 bd 20 23 00 00 02 b6 22 23 00 00 02 b7 24 23 00 00 02 b8 07 23 00 00 02 b9 07 23 00 00 02 c1 6d 23 00 00 02 be 07 23 00 00 02 bf 07 23 00 00 02 29 d8 23 00 00 02 2a 2a 23 00 00 02 4b 04 23 00 00 02 4c 12 23 00 00 02 4d 00 23 00 00 02 4e 22 23 00 00 02 4f 22 23 00 00 02 50 00 23 00 00 02 51 61 23 00 00 02 52 01 23 00 00 02 53 08 23 00 00 02 56 08 23 00 00 02 54 8a 23 00 00 02 58 8a 23 00 00 02 55 6d 23 00 00 02 5b 43 23 00 00 02 5c 00 23 00 00 02 5f 73 23 00 00 02 60 73 23 00 00 02 63 22 23 00 00 02 64 00 23 00 00 02 67 08 23 00 00 02 68 04 23 00 00 02 7a 80 23 00 00 02 7b 91 23 00 00 02 7c d8 23 00 00 02 7d 60 23 00 00 02 75 20 23 00 00 02 7f 20 23 00 00 02 74 10 23 00 00 02 7e 10 23 00 00 02 93 06 23 00 00 02 94 06 23 00 00 02 b3 00 23 00 00 02 b4 00 23 00 00 02 b5 00 23 00 00 02 78 00 23 00 00 02 79 00 23 00 00 02 80 00 23 00 00 02 83 00 23 00 00 02 84 04 23 00 00 02 8a 33 23 00 00 02 9b 0f 23 00 00 02 8b f0 23 00 00 02 e3 00 23 00 00 02 fb 01 23 00 00 02 ec 00 23 00 00 02 ff 10 29 00 00 04 3b 03 24 20 23 00 00 02 35 00 23 00 00 02 bb 03 29 00 00 03 51 ff 00 23 00 00 02 53 2c 23 00 00 02 55 00 13 50 00 01 11 13 14 00 01 29 ];
					sprd,sleep-in-command = [ 13 01 00 01 00 13 0a 00 01 28 13 78 00 01 10 23 0a 00 02 4f 01 ];
					sprd,sleep-out-command = [ 13 50 00 01 11 13 14 00 01 29 ];
					phandle = < 0x2e >;

					display-timings {
						native-mode = < 0x08 >;

						timing0 {
							clock-frequency = < 0x927c000 >;
							hactive = < 0x438 >;
							vactive = < 0x780 >;
							hback-porch = < 0x10 >;
							hfront-porch = < 0xb0 >;
							vback-porch = < 0x20 >;
							vfront-porch = < 0x20 >;
							hsync-len = < 0x0a >;
							vsync-len = < 0x04 >;
							phandle = < 0x08 >;
						};
					};
				};

				lcd_nt35532_truly_mipi_fhd {
					sprd,dsi-work-mode = < 0x01 >;
					sprd,dsi-lane-number = < 0x04 >;
					sprd,dsi-color-format = "rgb888";
					sprd,phy-bit-clock = < 0xeb7f8 >;
					sprd,phy-escape-clock = < 0x4e20 >;
					sprd,width-mm = < 0x44 >;
					sprd,height-mm = < 0x79 >;
					sprd,esd-check-enable = < 0x01 >;
					sprd,esd-check-mode = < 0x01 >;
					sprd,reset-on-sequence = < 0x01 0x05 0x00 0x05 0x01 0x14 >;
					sprd,reset-off-sequence = < 0x01 0x05 >;
					sprd,initial-command = < 0x23000002 0xff012300 0x2fb01 0x23000002 0x12300 0x20144 0x23000002 0x2592300 0x2040c 0x23000002 0x52b2300 0x20664 0x23000002 0x7c62300 0x20d89 0x23000002 0xe892300 0x20fe0 0x23000002 0x10032300 0x2115a 0x23000002 0x125a2300 0x2137e 0x23000002 0x147e2300 0x21560 0x23000002 0x16132300 0x21713 0x23000002 0x1ca32300 0x26e80 0x23000002 0x60772300 0x26813 0x23000002 0x75002300 0x27677 0x23000002 0x77002300 0x27878 0x23000002 0x79002300 0x27ab0 0x23000002 0x7b002300 0x27ccc 0x23000002 0x7d002300 0x27ee3 0x23000002 0x7f002300 0x280f6 0x23000002 0x81012300 0x28206 0x23000002 0x83012300 0x28415 0x23000002 0x85012300 0x28622 0x23000002 0x87012300 0x2884e 0x23000002 0x89012300 0x28a71 0x23000002 0x8b012300 0x28ca7 0x23000002 0x8d012300 0x28ed2 0x23000002 0x8f022300 0x29014 0x23000002 0x91022300 0x29249 0x23000002 0x93022300 0x2944b 0x23000002 0x95022300 0x2967d 0x23000002 0x97022300 0x298b6 0x23000002 0x99022300 0x29ad9 0x23000002 0x9b032300 0x29c0d 0x23000002 0x9d032300 0x29e2a 0x23000002 0x9f032300 0x2a051 0x23000002 0xa2032300 0x2a35d 0x23000002 0xa4032300 0x2a56a 0x23000002 0xa6032300 0x2a778 0x23000002 0xa9032300 0x2aa89 0x23000002 0xab032300 0x2ac9e 0x23000002 0xad032300 0x2aeb7 0x23000002 0xaf032300 0x2b0ce 0x23000002 0xb1032300 0x2b2d1 0x23000002 0xb3002300 0x2b418 0x23000002 0xb5002300 0x2b66a 0x23000002 0xb7002300 0x2b8b0 0x23000002 0xb9002300 0x2bacc 0x23000002 0xbb002300 0x2bce3 0x23000002 0xbd002300 0x2bef6 0x23000002 0xbf012300 0x2c006 0x23000002 0xc1012300 0x2c215 0x23000002 0xc3012300 0x2c422 0x23000002 0xc5012300 0x2c64e 0x23000002 0xc7012300 0x2c871 0x23000002 0xc9012300 0x2caa7 0x23000002 0xcb012300 0x2ccd2 0x23000002 0xcd022300 0x2ce14 0x23000002 0xcf022300 0x2d049 0x23000002 0xd1022300 0x2d24b 0x23000002 0xd3022300 0x2d47d 0x23000002 0xd5022300 0x2d6b6 0x23000002 0xd7022300 0x2d8d9 0x23000002 0xd9032300 0x2da0d 0x23000002 0xdb032300 0x2dc2a 0x23000002 0xdd032300 0x2de51 0x23000002 0xdf032300 0x2e05d 0x23000002 0xe1032300 0x2e26a 0x23000002 0xe3032300 0x2e478 0x23000002 0xe5032300 0x2e689 0x23000002 0xe7032300 0x2e89e 0x23000002 0xe9032300 0x2eab7 0x23000002 0xeb032300 0x2ecce 0x23000002 0xed032300 0x2eed1 0x23000002 0xef002300 0x2f077 0x23000002 0xf1002300 0x2f278 0x23000002 0xf3002300 0x2f4b0 0x23000002 0xf5002300 0x2f6cc 0x23000002 0xf7002300 0x2f8e3 0x23000002 0xf9002300 0x2faf6 0x23000002 0xff022300 0x2fb01 0x23000002 0x12300 0x20106 0x23000002 0x2012300 0x20315 0x23000002 0x4012300 0x20522 0x23000002 0x6012300 0x2074e 0x23000002 0x8012300 0x20971 0x23000002 0xa012300 0x20ba7 0x23000002 0xc012300 0x20dd2 0x23000002 0xe022300 0x20f14 0x23000002 0x10022300 0x21149 0x23000002 0x12022300 0x2134b 0x23000002 0x14022300 0x2157d 0x23000002 0x16022300 0x217b6 0x23000002 0x18022300 0x219d9 0x23000002 0x1a032300 0x21b0d 0x23000002 0x1c032300 0x21d2a 0x23000002 0x1e032300 0x21f51 0x23000002 0x20032300 0x2215d 0x23000002 0x22032300 0x2236a 0x23000002 0x24032300 0x22578 0x23000002 0x26032300 0x22789 0x23000002 0x28032300 0x2299e 0x23000002 0x2a032300 0x22bb7 0x23000002 0x2d032300 0x22fce 0x23000002 0x30032300 0x231d1 0x23000002 0x32002300 0x23318 0x23000002 0x34002300 0x2356a 0x23000002 0x36002300 0x237b0 0x23000002 0x38002300 0x239cc 0x23000002 0x3a002300 0x23be3 0x23000002 0x3d002300 0x23ff6 0x23000002 0x40012300 0x24106 0x23000002 0x42012300 0x24315 0x23000002 0x44012300 0x24522 0x23000002 0x46012300 0x2474e 0x23000002 0x48012300 0x24971 0x23000002 0x4a012300 0x24ba7 0x23000002 0x4c012300 0x24dd2 0x23000002 0x4e022300 0x24f14 0x23000002 0x50022300 0x25149 0x23000002 0x52022300 0x2534b 0x23000002 0x54022300 0x2557d 0x23000002 0x56022300 0x258b6 0x23000002 0x59022300 0x25ad9 0x23000002 0x5b032300 0x25c0d 0x23000002 0x5d032300 0x25e2a 0x23000002 0x5f032300 0x26051 0x23000002 0x61032300 0x2625d 0x23000002 0x63032300 0x2646a 0x23000002 0x65032300 0x26678 0x23000002 0x67032300 0x26889 0x23000002 0x69032300 0x26a9e 0x23000002 0x6b032300 0x26cb7 0x23000002 0x6d032300 0x26ece 0x23000002 0x6f032300 0x270d1 0x23000002 0x71002300 0x27277 0x23000002 0x73002300 0x27478 0x23000002 0x75002300 0x276b0 0x23000002 0x77002300 0x278cc 0x23000002 0x79002300 0x27ae3 0x23000002 0x7b002300 0x27cf6 0x23000002 0x7d012300 0x27e06 0x23000002 0x7f012300 0x28015 0x23000002 0x81012300 0x28222 0x23000002 0x83012300 0x2844e 0x23000002 0x85012300 0x28671 0x23000002 0x87012300 0x288a7 0x23000002 0x89012300 0x28ad2 0x23000002 0x8b022300 0x28c14 0x23000002 0x8d022300 0x28e49 0x23000002 0x8f022300 0x2904b 0x23000002 0x91022300 0x2927d 0x23000002 0x93022300 0x294b6 0x23000002 0x95022300 0x296d9 0x23000002 0x97032300 0x2980d 0x23000002 0x99032300 0x29a2a 0x23000002 0x9b032300 0x29c51 0x23000002 0x9d032300 0x29e5d 0x23000002 0x9f032300 0x2a06a 0x23000002 0xa2032300 0x2a378 0x23000002 0xa4032300 0x2a589 0x23000002 0xa6032300 0x2a79e 0x23000002 0xa9032300 0x2aab7 0x23000002 0xab032300 0x2acce 0x23000002 0xad032300 0x2aed1 0x23000002 0xaf002300 0x2b018 0x23000002 0xb1002300 0x2b26a 0x23000002 0xb3002300 0x2b4b0 0x23000002 0xb5002300 0x2b6cc 0x23000002 0xb7002300 0x2b8e3 0x23000002 0xb9002300 0x2baf6 0x23000002 0xbb012300 0x2bc06 0x23000002 0xbd012300 0x2be15 0x23000002 0xbf012300 0x2c022 0x23000002 0xc1012300 0x2c24e 0x23000002 0xc3012300 0x2c471 0x23000002 0xc5012300 0x2c6a7 0x23000002 0xc7012300 0x2c8d2 0x23000002 0xc9022300 0x2ca14 0x23000002 0xcb022300 0x2cc49 0x23000002 0xcd022300 0x2ce4b 0x23000002 0xcf022300 0x2d07d 0x23000002 0xd1022300 0x2d2b6 0x23000002 0xd3022300 0x2d4d9 0x23000002 0xd5032300 0x2d60d 0x23000002 0xd7032300 0x2d82a 0x23000002 0xd9032300 0x2da51 0x23000002 0xdb032300 0x2dc5d 0x23000002 0xdd032300 0x2de6a 0x23000002 0xdf032300 0x2e078 0x23000002 0xe1032300 0x2e289 0x23000002 0xe3032300 0x2e49e 0x23000002 0xe5032300 0x2e6b7 0x23000002 0xe7032300 0x2e8ce 0x23000002 0xe9032300 0x2ead1 0x23000002 0xff052300 0x2fb01 0x23000002 0x382300 0x20138 0x23000002 0x2072300 0x20340 0x23000002 0x4402300 0x20525 0x23000002 0x61d2300 0x20723 0x23000002 0x81b2300 0x20921 0x23000002 0xa192300 0x20b1f 0x23000002 0xc172300 0x20d05 0x23000002 0xe042300 0x20f0f 0x23000002 0x10382300 0x21138 0x23000002 0x12382300 0x21338 0x23000002 0x14382300 0x21538 0x23000002 0x16062300 0x21740 0x23000002 0x18402300 0x21924 0x23000002 0x1a1c2300 0x21b22 0x23000002 0x1c1a2300 0x21d20 0x23000002 0x1e182300 0x21f1e 0x23000002 0x20162300 0x22105 0x23000002 0x22042300 0x2230e 0x23000002 0x24382300 0x22538 0x23000002 0x26382300 0x22738 0x23000002 0x28382300 0x22938 0x23000002 0x2a0e2300 0x22b40 0x23000002 0x2d402300 0x22f16 0x23000002 0x301e2300 0x23118 0x23000002 0x32202300 0x2331a 0x23000002 0x34222300 0x2351c 0x23000002 0x36242300 0x23705 0x23000002 0x38042300 0x23906 0x23000002 0x3a382300 0x23b38 0x23000002 0x3d382300 0x23f38 0x23000002 0x40382300 0x24138 0x23000002 0x420f2300 0x24340 0x23000002 0x44402300 0x24517 0x23000002 0x461f2300 0x24719 0x23000002 0x48212300 0x2491b 0x23000002 0x4a232300 0x24b1d 0x23000002 0x4c252300 0x24d05 0x23000002 0x4e042300 0x24f07 0x23000002 0x50382300 0x25138 0x23000002 0x52382300 0x25338 0x23000002 0x5b0a2300 0x25c0a 0x23000002 0x630a2300 0x26415 0x23000002 0x68242300 0x26924 0x23000002 0x907b2300 0x29110 0x23000002 0x92152300 0x27e10 0x23000002 0x7f102300 0x28000 0x23000002 0x98002300 0x29900 0x23000002 0x542e2300 0x25938 0x23000002 0x5d012300 0x25e27 0x23000002 0x62392300 0x26688 0x23000002 0x67112300 0x26a0e 0x23000002 0x6b202300 0x26c08 0x23000002 0x6d002300 0x27d01 0x23000002 0xb7012300 0x2b80a 0x23000002 0xba132300 0x2bc01 0x23000002 0xbd552300 0x2be38 0x23000002 0xbf442300 0x2cf88 0x23000002 0xc8002300 0x2c955 0x23000002 0xca002300 0x2cb55 0x23000002 0xcca22300 0x2ce88 0x23000002 0xcf882300 0x2d000 0x23000002 0xd1002300 0x2d300 0x23000002 0xd5002300 0x2d622 0x23000002 0xd7312300 0x2d87e 0x23000002 0xff002300 0x2fb01 0x23000002 0xd3242300 0x2d420 0x23000002 0xd55a2300 0x2d650 0x23000002 0xd7002300 0x23500 0x23000002 0xff002300 0x2fb01 0x23000002 0x51ff2300 0x2532c 0x23000002 0x36001378 0x11113 0xa000129 >;
					sprd,sleep-in-command = [ 13 01 00 01 00 13 0a 00 01 28 13 78 00 01 10 23 0a 00 02 4f 01 ];
					sprd,sleep-out-command = [ 13 78 00 01 11 13 32 00 01 29 ];
					phandle = < 0x2f >;

					display-timings {
						native-mode = < 0x09 >;

						timing0 {
							clock-frequency = < 0x927c000 >;
							hactive = < 0x438 >;
							vactive = < 0x780 >;
							hback-porch = < 0x10 >;
							hfront-porch = < 0xb0 >;
							vback-porch = < 0x20 >;
							vfront-porch = < 0x20 >;
							hsync-len = < 0x0a >;
							vsync-len = < 0x04 >;
							phandle = < 0x09 >;
						};
					};
				};

				lcd_nt35596_boe_mipi_fhd {
					sprd,dsi-work-mode = < 0x01 >;
					sprd,dsi-lane-number = < 0x04 >;
					sprd,dsi-color-format = "rgb888";
					sprd,phy-bit-clock = < 0xf4240 >;
					sprd,phy-escape-clock = < 0x4e20 >;
					sprd,width-mm = < 0x44 >;
					sprd,height-mm = < 0x79 >;
					sprd,esd-check-enable = < 0x01 >;
					sprd,esd-check-mode = < 0x01 >;
					sprd,esd-check-period = < 0x3e8 >;
					sprd,reset-on-sequence = < 0x01 0x05 0x00 0x05 0x01 0x05 0x00 0x05 0x01 0x14 >;
					sprd,reset-off-sequence = < 0x00 0x14 >;
					sprd,initial-command = [ 23 00 00 02 ff ee 23 0a 00 02 18 40 23 14 00 02 18 00 23 00 00 02 ff 01 23 00 00 02 fb 01 23 00 00 02 00 01 23 00 00 02 01 55 23 00 00 02 02 40 23 00 00 02 05 40 23 00 00 02 06 94 23 00 00 02 07 94 23 00 00 02 08 0c 23 00 00 02 11 19 23 00 00 02 12 19 23 00 00 02 13 03 23 00 00 02 14 94 23 00 00 02 15 15 23 00 00 02 16 15 23 00 00 02 6d 22 23 00 00 02 0b af 23 00 00 02 0c af 23 00 00 02 0e ab 23 00 00 02 0f a4 23 00 00 02 58 82 23 00 00 02 59 02 23 00 00 02 5a 02 23 00 00 02 5b 02 23 00 00 02 5c 82 23 00 00 02 5d 82 23 00 00 02 5e 02 23 00 00 02 5f 02 23 00 00 02 75 00 23 00 00 02 76 00 23 00 00 02 77 00 23 00 00 02 78 11 23 00 00 02 79 00 23 00 00 02 7a 30 23 00 00 02 7b 00 23 00 00 02 7c 4a 23 00 00 02 7d 00 23 00 00 02 7e 62 23 00 00 02 7f 00 23 00 00 02 80 78 23 00 00 02 81 00 23 00 00 02 82 8c 23 00 00 02 83 00 23 00 00 02 84 9e 23 00 00 02 85 00 23 00 00 02 86 ae 23 00 00 02 87 00 23 00 00 02 88 e4 23 00 00 02 89 01 23 00 00 02 8a 0e 23 00 00 02 8b 01 23 00 00 02 8c 4c 23 00 00 02 8d 01 23 00 00 02 8e 7b 23 00 00 02 8f 01 23 00 00 02 90 c2 23 00 00 02 91 01 23 00 00 02 92 fb 23 00 00 02 93 01 23 00 00 02 94 fc 23 00 00 02 95 02 23 00 00 02 96 34 23 00 00 02 97 02 23 00 00 02 98 79 23 00 00 02 99 02 23 00 00 02 9a a4 23 00 00 02 9b 02 23 00 00 02 9c dd 23 00 00 02 9d 03 23 00 00 02 9e 05 23 00 00 02 9f 03 23 00 00 02 a0 39 23 00 00 02 a2 03 23 00 00 02 a3 48 23 00 00 02 a4 03 23 00 00 02 a5 58 23 00 00 02 a6 03 23 00 00 02 a7 6a 23 00 00 02 a9 03 23 00 00 02 aa 7f 23 00 00 02 ab 03 23 00 00 02 ac 98 23 00 00 02 ad 03 23 00 00 02 ae b7 23 00 00 02 af 03 23 00 00 02 b0 d7 23 00 00 02 b1 03 23 00 00 02 b2 ff 23 00 00 02 b3 00 23 00 00 02 b4 00 23 00 00 02 b5 00 23 00 00 02 b6 11 23 00 00 02 b7 00 23 00 00 02 b8 30 23 00 00 02 b9 00 23 00 00 02 ba 4a 23 00 00 02 bb 00 23 00 00 02 bc 62 23 00 00 02 bd 00 23 00 00 02 be 78 23 00 00 02 bf 00 23 00 00 02 c0 8c 23 00 00 02 c1 00 23 00 00 02 c2 9e 23 00 00 02 c3 00 23 00 00 02 c4 ae 23 00 00 02 c5 00 23 00 00 02 c6 e4 23 00 00 02 c7 01 23 00 00 02 c8 0e 23 00 00 02 c9 01 23 00 00 02 ca 4c 23 00 00 02 cb 01 23 00 00 02 cc 7b 23 00 00 02 cd 01 23 00 00 02 ce c2 23 00 00 02 cf 01 23 00 00 02 d0 fb 23 00 00 02 d1 01 23 00 00 02 d2 fc 23 00 00 02 d3 02 23 00 00 02 d4 34 23 00 00 02 d5 02 23 00 00 02 d6 79 23 00 00 02 d7 02 23 00 00 02 d8 a4 23 00 00 02 d9 02 23 00 00 02 da dd 23 00 00 02 db 03 23 00 00 02 dc 05 23 00 00 02 dd 03 23 00 00 02 de 39 23 00 00 02 df 03 23 00 00 02 e0 48 23 00 00 02 e1 03 23 00 00 02 e2 58 23 00 00 02 e3 03 23 00 00 02 e4 6a 23 00 00 02 e5 03 23 00 00 02 e6 7f 23 00 00 02 e7 03 23 00 00 02 e8 98 23 00 00 02 e9 03 23 00 00 02 ea b7 23 00 00 02 eb 03 23 00 00 02 ec d7 23 00 00 02 ed 03 23 00 00 02 ee ff 23 00 00 02 ef 00 23 00 00 02 f0 00 23 00 00 02 f1 00 23 00 00 02 f2 11 23 00 00 02 f3 00 23 00 00 02 f4 30 23 00 00 02 f5 00 23 00 00 02 f6 4a 23 00 00 02 f7 00 23 00 00 02 f8 62 23 00 00 02 f9 00 23 00 00 02 fa 78 23 00 00 02 ff 02 23 00 00 02 fb 01 23 00 00 02 00 00 23 00 00 02 01 8c 23 00 00 02 02 00 23 00 00 02 03 9e 23 00 00 02 04 00 23 00 00 02 05 ae 23 00 00 02 06 00 23 00 00 02 07 e4 23 00 00 02 08 01 23 00 00 02 09 0e 23 00 00 02 0a 01 23 00 00 02 0b 4c 23 00 00 02 0c 01 23 00 00 02 0d 7b 23 00 00 02 0e 01 23 00 00 02 0f c2 23 00 00 02 10 01 23 00 00 02 11 fb 23 00 00 02 12 01 23 00 00 02 13 fc 23 00 00 02 14 02 23 00 00 02 15 34 23 00 00 02 16 02 23 00 00 02 17 79 23 00 00 02 18 02 23 00 00 02 19 a4 23 00 00 02 1a 02 23 00 00 02 1b dd 23 00 00 02 1c 03 23 00 00 02 1d 05 23 00 00 02 1e 03 23 00 00 02 1f 39 23 00 00 02 20 03 23 00 00 02 21 48 23 00 00 02 22 03 23 00 00 02 23 58 23 00 00 02 24 03 23 00 00 02 25 6a 23 00 00 02 26 03 23 00 00 02 27 7f 23 00 00 02 28 03 23 00 00 02 29 98 23 00 00 02 2a 03 23 00 00 02 2b b7 23 00 00 02 2d 03 23 00 00 02 2f d7 23 00 00 02 30 03 23 00 00 02 31 ff 23 00 00 02 32 00 23 00 00 02 33 00 23 00 00 02 34 00 23 00 00 02 35 11 23 00 00 02 36 00 23 00 00 02 37 30 23 00 00 02 38 00 23 00 00 02 39 4a 23 00 00 02 3a 00 23 00 00 02 3b 62 23 00 00 02 3d 00 23 00 00 02 3f 78 23 00 00 02 40 00 23 00 00 02 41 8c 23 00 00 02 42 00 23 00 00 02 43 9e 23 00 00 02 44 00 23 00 00 02 45 ae 23 00 00 02 46 00 23 00 00 02 47 e4 23 00 00 02 48 01 23 00 00 02 49 0e 23 00 00 02 4a 01 23 00 00 02 4b 4c 23 00 00 02 4c 01 23 00 00 02 4d 7b 23 00 00 02 4e 01 23 00 00 02 4f c2 23 00 00 02 50 01 23 00 00 02 51 fb 23 00 00 02 52 01 23 00 00 02 53 fc 23 00 00 02 54 02 23 00 00 02 55 34 23 00 00 02 56 02 23 00 00 02 58 79 23 00 00 02 59 02 23 00 00 02 5a a4 23 00 00 02 5b 02 23 00 00 02 5c dd 23 00 00 02 5d 03 23 00 00 02 5e 05 23 00 00 02 5f 03 23 00 00 02 60 39 23 00 00 02 61 03 23 00 00 02 62 48 23 00 00 02 63 03 23 00 00 02 64 58 23 00 00 02 65 03 23 00 00 02 66 6a 23 00 00 02 67 03 23 00 00 02 68 7f 23 00 00 02 69 03 23 00 00 02 6a 98 23 00 00 02 6b 03 23 00 00 02 6c b7 23 00 00 02 6d 03 23 00 00 02 6e d7 23 00 00 02 6f 03 23 00 00 02 70 ff 23 00 00 02 71 00 23 00 00 02 72 00 23 00 00 02 73 00 23 00 00 02 74 11 23 00 00 02 75 00 23 00 00 02 76 30 23 00 00 02 77 00 23 00 00 02 78 4a 23 00 00 02 79 00 23 00 00 02 7a 62 23 00 00 02 7b 00 23 00 00 02 7c 78 23 00 00 02 7d 00 23 00 00 02 7e 8c 23 00 00 02 7f 00 23 00 00 02 80 9e 23 00 00 02 81 00 23 00 00 02 82 ae 23 00 00 02 83 00 23 00 00 02 84 e4 23 00 00 02 85 01 23 00 00 02 86 0e 23 00 00 02 87 01 23 00 00 02 88 4c 23 00 00 02 89 01 23 00 00 02 8a 7b 23 00 00 02 8b 01 23 00 00 02 8c c2 23 00 00 02 8d 01 23 00 00 02 8e fb 23 00 00 02 8f 01 23 00 00 02 90 fc 23 00 00 02 91 02 23 00 00 02 92 34 23 00 00 02 93 02 23 00 00 02 94 79 23 00 00 02 95 02 23 00 00 02 96 a4 23 00 00 02 97 02 23 00 00 02 98 dd 23 00 00 02 99 03 23 00 00 02 9a 05 23 00 00 02 9b 03 23 00 00 02 9c 39 23 00 00 02 9d 03 23 00 00 02 9e 48 23 00 00 02 9f 03 23 00 00 02 a0 58 23 00 00 02 a2 03 23 00 00 02 a3 6a 23 00 00 02 a4 03 23 00 00 02 a5 7f 23 00 00 02 a6 03 23 00 00 02 a7 98 23 00 00 02 a9 03 23 00 00 02 aa b7 23 00 00 02 ab 03 23 00 00 02 ac d7 23 00 00 02 ad 03 23 00 00 02 ae ff 23 00 00 02 af 00 23 00 00 02 b0 00 23 00 00 02 b1 00 23 00 00 02 b2 11 23 00 00 02 b3 00 23 00 00 02 b4 30 23 00 00 02 b5 00 23 00 00 02 b6 4a 23 00 00 02 b7 00 23 00 00 02 b8 62 23 00 00 02 b9 00 23 00 00 02 ba 78 23 00 00 02 bb 00 23 00 00 02 bc 8c 23 00 00 02 bd 00 23 00 00 02 be 9e 23 00 00 02 bf 00 23 00 00 02 c0 ae 23 00 00 02 c1 00 23 00 00 02 c2 e4 23 00 00 02 c3 01 23 00 00 02 c4 0e 23 00 00 02 c5 01 23 00 00 02 c6 4c 23 00 00 02 c7 01 23 00 00 02 c8 7b 23 00 00 02 c9 01 23 00 00 02 ca c2 23 00 00 02 cb 01 23 00 00 02 cc fb 23 00 00 02 cd 01 23 00 00 02 ce fc 23 00 00 02 cf 02 23 00 00 02 d0 34 23 00 00 02 d1 02 23 00 00 02 d2 79 23 00 00 02 d3 02 23 00 00 02 d4 a4 23 00 00 02 d5 02 23 00 00 02 d6 dd 23 00 00 02 d7 03 23 00 00 02 d8 05 23 00 00 02 d9 03 23 00 00 02 da 39 23 00 00 02 db 03 23 00 00 02 dc 48 23 00 00 02 dd 03 23 00 00 02 de 58 23 00 00 02 df 03 23 00 00 02 e0 6a 23 00 00 02 e1 03 23 00 00 02 e2 7f 23 00 00 02 e3 03 23 00 00 02 e4 98 23 00 00 02 e5 03 23 00 00 02 e6 b7 23 00 00 02 e7 03 23 00 00 02 e8 d7 23 00 00 02 e9 03 23 00 00 02 ea ff 23 00 00 02 ff 05 23 00 00 02 fb 01 23 00 00 02 00 00 23 00 00 02 01 01 23 00 00 02 02 0b 23 00 00 02 03 0c 23 00 00 02 04 00 23 00 00 02 05 03 23 00 00 02 06 00 23 00 00 02 07 04 23 00 00 02 08 00 23 00 00 02 09 00 23 00 00 02 0a 00 23 00 00 02 0b 00 23 00 00 02 0c 00 23 00 00 02 0d 17 23 00 00 02 0e 15 23 00 00 02 0f 13 23 00 00 02 10 00 23 00 00 02 11 01 23 00 00 02 12 0b 23 00 00 02 13 0c 23 00 00 02 14 00 23 00 00 02 15 03 23 00 00 02 16 00 23 00 00 02 17 04 23 00 00 02 18 00 23 00 00 02 19 00 23 00 00 02 1a 00 23 00 00 02 1b 00 23 00 00 02 1c 00 23 00 00 02 1d 17 23 00 00 02 1e 15 23 00 00 02 1f 13 23 00 00 02 20 09 23 00 00 02 21 02 23 00 00 02 22 00 23 00 00 02 23 00 23 00 00 02 24 00 23 00 00 02 25 3d 23 00 00 02 29 38 23 00 00 02 2a 2b 23 00 00 02 2f 02 23 00 00 02 30 01 23 00 00 02 31 49 23 00 00 02 32 23 23 00 00 02 33 01 23 00 00 02 34 05 23 00 00 02 35 74 23 00 00 02 36 00 23 00 00 02 37 2d 23 00 00 02 38 08 23 00 00 02 92 94 23 00 00 02 5b 00 23 00 00 02 5f 1d 23 00 00 02 63 00 23 00 00 02 67 04 23 00 00 02 6c 55 23 00 00 02 7a 00 23 00 00 02 7b a2 23 00 00 02 7c d8 23 00 00 02 7d 50 23 00 00 02 7e 0a 23 00 00 02 7f 1c 23 00 00 02 81 06 23 00 00 02 82 02 23 00 00 02 84 03 23 00 00 02 85 05 23 00 00 02 c5 20 23 00 00 02 80 00 23 00 00 02 83 00 23 00 00 02 93 08 23 00 00 02 94 0a 23 00 00 02 8a 33 23 00 00 02 a4 0f 23 00 00 02 9b 0f 23 00 00 02 9d b0 23 00 00 02 e7 83 23 00 00 02 e3 02 23 00 00 02 ff 00 23 00 00 02 d2 03 23 00 00 02 d3 24 23 00 00 02 d4 20 23 00 00 02 35 00 23 00 00 02 ba 03 13 78 00 01 11 13 64 00 01 29 ];
					sprd,sleep-in-command = < 0x130a0001 0x28137800 0x110230a 0x24f01 >;
					sprd,sleep-out-command = [ 13 78 00 01 11 13 64 00 01 29 ];
					phandle = < 0x30 >;

					display-timings {
						native-mode = < 0x0a >;

						timing0 {
							clock-frequency = < 0x927c000 >;
							hactive = < 0x438 >;
							vactive = < 0x780 >;
							hback-porch = < 0x10 >;
							hfront-porch = < 0xb0 >;
							vback-porch = < 0x20 >;
							vfront-porch = < 0x20 >;
							hsync-len = < 0x0a >;
							vsync-len = < 0x04 >;
							phandle = < 0x0a >;
						};
					};
				};

				lcd_dummy_mipi_hd {
					sprd,dsi-work-mode = < 0x01 >;
					sprd,dsi-lane-number = < 0x04 >;
					sprd,dsi-color-format = "rgb888";
					sprd,initial-command = [ 13 78 00 01 11 13 64 00 01 29 ];
					sprd,sleep-in-command = [ 13 0a 00 01 28 13 78 00 01 10 ];
					sprd,sleep-out-command = [ 13 78 00 01 11 13 64 00 01 29 ];
					phandle = < 0x31 >;

					display-timings {
						native-mode = < 0x0b >;

						timing0 {
							clock-frequency = < 0x493e000 >;
							hactive = < 0x2d0 >;
							vactive = < 0x500 >;
							hback-porch = < 0x3c >;
							hfront-porch = < 0x50 >;
							vback-porch = < 0x0c >;
							vfront-porch = < 0x26 >;
							hsync-len = < 0x3c >;
							vsync-len = < 0x04 >;
							phandle = < 0x0b >;
						};
					};
				};
			};

			fingerprint@0 {
				compatible = "microarray,afs121";
				fpint-gpios = < 0xffffffff 0x82 0x00 >;
			};

			sprd_backlight {
				compatible = "pwm-backlight";
				pwms = < 0xffffffff 0x01 0x7530 >;
				pwm-names = "backlight";
				brightness-levels = < 0x02 0x02 0x02 0x02 0x02 0x02 0x02 0x03 0x04 0x05 0x06 0x07 0x08 0x09 0x0a 0x0b 0x0c 0x0d 0x0e 0x0f 0x10 0x11 0x12 0x13 0x14 0x15 0x16 0x17 0x18 0x19 0x1a 0x1b 0x1c 0x1d 0x1e 0x1f 0x20 0x21 0x22 0x23 0x24 0x25 0x26 0x27 0x28 0x29 0x2a 0x2b 0x2c 0x2d 0x2e 0x2f 0x30 0x31 0x32 0x33 0x34 0x35 0x36 0x37 0x38 0x39 0x3a 0x3b 0x3c 0x3d 0x3e 0x3f 0x40 0x41 0x42 0x43 0x44 0x45 0x46 0x47 0x48 0x49 0x4a 0x4b 0x4c 0x4d 0x4e 0x4f 0x50 0x51 0x52 0x53 0x54 0x55 0x56 0x57 0x58 0x59 0x5a 0x5b 0x5c 0x5d 0x5e 0x5f 0x60 0x61 0x62 0x63 0x64 0x65 0x66 0x67 0x68 0x69 0x6a 0x6b 0x6c 0x6d 0x6e 0x6f 0x70 0x71 0x72 0x73 0x74 0x75 0x76 0x77 0x78 0x79 0x7a 0x7b 0x7c 0x7d 0x7e 0x7f 0x80 0x81 0x82 0x83 0x84 0x85 0x86 0x87 0x88 0x89 0x8a 0x8b 0x8c 0x8d 0x8e 0x8f 0x90 0x91 0x92 0x93 0x94 0x95 0x96 0x97 0x98 0x99 0x9a 0x9b 0x9c 0x9d 0x9e 0x9f 0xa0 0xa1 0xa2 0xa3 0xa4 0xa5 0xa6 0xa7 0xa8 0xa9 0xaa 0xab 0xac 0xad 0xae 0xaf 0xb0 0xb1 0xb2 0xb3 0xb4 0xb5 0xb6 0xb7 0xb8 0xb9 0xba 0xbb 0xbc 0xbd 0xbe 0xbf 0xc0 0xc1 0xc2 0xc3 0xc4 0xc5 0xc6 0xc7 0xc8 0xc9 0xca 0xcb 0xcc 0xcd 0xce 0xcf 0xd0 0xd1 0xd2 0xd3 0xd4 0xd5 0xd6 0xd7 0xd8 0xd9 0xda 0xdb 0xdc 0xdd 0xde 0xdf 0xe0 0xe1 0xe2 0xe3 0xe4 0xe5 0xe6 0xe7 0xe8 0xe9 0xea 0xeb 0xec 0xed 0xee 0xef 0xf0 0xf1 0xf2 0xf3 0xf4 0xf5 0xf6 0xf7 0xf8 0xf9 0xfa 0xfb >;
				default-brightness-level = < 0x1d >;
				phandle = < 0x32 >;
			};

			thermal-sensor {
				compatible = "generic-adc-thermal";
				#thermal-sensor-cells = < 0x00 >;
				io-channels = < 0xffffffff 0x01 >;
				io-channel-names = "sensor-channel";
				temperature-lookup-table = < 0xffff64c2 0x46b 0xffff8baf 0x456 0xffffb3e8 0x432 0xffffedb9 0x3d7 0x277e 0x346 0x60e5 0x28e 0xaf7a 0x19d 0xd677 0x13c 0xfd7f 0xee 0x12484 0xb2 0x14b93 0x85 0x172a3 0x64 0x199b0 0x4b 0x1c0c9 0x39 0x1e7c8 0x2b >;
				phandle = < 0x24 >;
			};

			ant_check_div {
				compatible = "ant_check_div";
				ant_check_div_gpio = < 0xffffffff 0x7a 0x01 >;
			};

			battery {
				compatible = "simple-battery";
				charge-full-design-microamp-hours = < 0x4b8bd8 >;
				charge-term-current-microamp = < 0xea60 >;
				constant_charge_current_max_microamp = < 0x17cdc0 >;
				constant_charge_voltage_max_microvolt = < 0x432380 >;
				factory-internal-resistance-micro-ohms = < 0x20b70 >;
				voltage-min-design-microvolt = < 0x34b818 >;
				ocv-capacity-celsius = < 0x14 >;
				ocv-capacity-table-0 = < 0x42b238 0x64 0x41b450 0x5f 0x40cdd8 0x5a 0x3fef30 0x55 0x3f1858 0x50 0x3e4950 0x4b 0x3d8dd0 0x46 0x3cde08 0x41 0x3c39f8 0x3c 0x3b6708 0x37 0x3ada68 0x32 0x3a74d8 0x2d 0x3a26b8 0x28 0x39e838 0x23 0x39b188 0x1e 0x396b38 0x19 0x392100 0x14 0x38c340 0x0f 0x3855e0 0x0a 0x381760 0x05 0x33e140 0x00 >;
				voltage-temp-table = < 0x10a9a0 0x320 0xf03c0 0x352 0xd65b0 0x384 0xbd358 0x3b6 0xa5c58 0x3e8 0x90498 0x41a 0x7cc18 0x44c 0x6b6c0 0x47e 0x5c490 0x4b0 0x4f1a0 0x4e2 0x43df0 0x514 0x3a1b0 0x546 0x31ce0 0x578 0x2ab98 0x5aa 0x249f0 0x5dc 0x1f7e8 0x60e 0x1b198 0x640 0x17700 0x672 0x14438 0x6a4 0x11940 0x6d6 0xf618 0x708 >;
				capacity-temp-table = < 0x32 0x64 0x19 0x64 0x0a 0x64 0x00 0x60 0xfffffff6 0x5c 0xffffffec 0x4e >;
				resistance-temp-table = < 0x32 0x64 0x19 0x64 0x0a 0xb1 0x00 0x329 0xfffffff6 0x387 0xffffffec 0x3ea >;
				charge-sdp-current-microamp = < 0x7a120 0x7a120 >;
				charge-dcp-current-microamp = < 0x17cdc0 0x186a00 >;
				charge-cdp-current-microamp = < 0x13d620 0x13d620 >;
				charge-unknown-current-microamp = < 0x7a120 0x7a120 >;
				phandle = < 0x0c >;
			};

			charger-manager {
				status = "okay";
				compatible = "charger-manager";
				cm-name = "battery";
				cm-poll-mode = < 0x02 >;
				cm-poll-interval = < 0x3a98 >;
				cm-battery-stat = < 0x02 >;
				cm-fullbatt-vchkdrop-ms = < 0x7530 >;
				cm-fullbatt-vchkdrop-volt = < 0x186a0 >;
				cm-fullbatt-voltage = < 0x42cd90 >;
				cm-fullbatt-current = < 0x3a980 >;
				cm-first-fullbatt-current = < 0x57e40 >;
				cm-fullbatt-capacity = < 0x64 >;
				cm-num-chargers = < 0x01 >;
				cm-chargers = "bq2560x_charger";
				cm-fuel-gauge = "sc27xx-fgu";
				cm-battery-cold = < 0xc8 >;
				cm-battery-cold-in-minus;
				cm-battery-hot = < 0x320 >;
				cm-battery-temp-diff = < 0x64 >;
				cm-charging-max = < 0x44aa200 >;
				cm-discharging-max = < 0x2932e0 >;
				cm-wdt-interval = < 0x3c >;
				cm-shutdown-voltage = < 0x2f4d60 >;
				cm-tickle-time-out = < 0x5dc >;
				cm-one-cap-time = < 0x1e >;
				cm-charge-voltage-max = < 0x632ea0 >;
				cm-charge-voltage-drop = < 0xaae60 >;
				cm-dcp-jeita-temp-table = < 0x3e8 0x3fc 0x00 0x432380 0x41a 0x424 0x7a120 0x432380 0x460 0x474 0x155cc0 0x432380 0x5aa 0x596 0x17cdc0 0x432380 0x60e 0x5fa 0x17cdc0 0x401640 >;
				cm-sdp-jeita-temp-table = < 0x3e8 0x3fc 0x00 0x432380 0x41a 0x424 0x7a120 0x432380 0x460 0x474 0x7a120 0x432380 0x5aa 0x596 0x7a120 0x432380 0x60e 0x5fa 0x7a120 0x401640 >;
				cm-cdp-jeita-temp-table = < 0x3e8 0x3fc 0x00 0x432380 0x41a 0x424 0x7a120 0x432380 0x460 0x474 0x155cc0 0x432380 0x5aa 0x596 0x16e360 0x432380 0x60e 0x5fa 0x16e360 0x401640 >;
				cm-unknown-jeita-temp-table = < 0x3e8 0x3fc 0x00 0x432380 0x41a 0x424 0x7a120 0x432380 0x460 0x474 0x7a120 0x432380 0x5aa 0x596 0x7a120 0x432380 0x60e 0x5fa 0x7a120 0x401640 >;
				monitored-battery = < 0x0c >;
				cm-cap-remap-table = < 0x01 0x02 0x03 0x02 0x03 0x02 0x62 0x63 0x02 0x63 0x64 0x03 >;

				regulator@0 {
					cm-regulator-name = "vddgen0";

					cable@0 {
						cm-cable-name = "USB";
						extcon = < 0xffffffff >;
					};
				};
			};

			gpio-keys {
				compatible = "gpio-keys";

				key-volumedown {
					label = "Volume Down Key";
					linux,code = < 0x72 >;
					gpios = < 0xffffffff 0x0a 0x00 >;
					debounce-interval = < 0x02 >;
					wakeup-source;
				};

				key-volumeup {
					label = "Volume Up Key";
					linux,code = < 0x73 >;
					gpios = < 0xffffffff 0x02 0x01 >;
					debounce-interval = < 0x02 >;
					wakeup-source;
				};

				key-power {
					label = "Power Key";
					linux,code = < 0x74 >;
					gpios = < 0xffffffff 0x01 0x01 >;
					debounce-interval = < 0x02 >;
					wakeup-source;
				};
			};

			flash-gpios {
				compatible = "sprd,flash-syx378duc";
				flash-ic = < 0x17a >;
				flash-en-gpios = < 0xffffffff 0x84 0x00 >;
				torch-en-gpios = < 0xffffffff 0x85 0x00 >;
				status = "okay";
			};
		};
	};

	fragment@0 {
		target = < 0xffffffff >;

		__overlay__ {
			status = "okay";

			touchpanel@0 {
				compatible = "touchpanel";
				reg = < 0x00 >;
				status = "ok";
				spi-max-frequency = < 0x927c00 >;
				pinctrl-names = "gpio_144\0gpio_144_slp";
				pinctrl-0 = < 0x0d >;
				pinctrl-1 = < 0x0e >;
				ts,rst-gpio = < 0xffffffff 0x91 0x00 >;
				ts,irq-gpio = < 0xffffffff 0x90 0x00 >;
				ges,irq-gpio = < 0xffffffff 0x00 0x00 >;
				gts,test-chip-id;
				gts,chip-id = [ 72 02 ];
				gts,test-open;
				gts,open-cb = < 0xc8 >;
				gts,open-min = < 0x3e8 >;
				gts,test-short;
				gts,short-cb = < 0x0a >;
				gts,short-min = < 0x64 >;
				gts,test-chip-id-7202H;
				gts,chip-id-7202H = [ 72 03 ];
				gts,test-open-7202H;
				gts,open-cb-7202H = < 0x1e >;
				gts,open-min-7202H = < 0x1f4 >;
				gts,test-short-7202H;
				gts,short-cb-7202H = < 0x0a >;
				gts,short-min-7202H = < 0x64 >;
				gts,test-rawdata-7202H;
				gts,rawdata-max-7202H = < 0x5a >;
				gts,rawdata-range-7202H = < 0x64 0x2d0 >;
				gts,test-noise-7202H;
				gts,peak_to_peak-7202H = < 0x3c >;
				touch,max-touch-number = < 0x05 >;
				touch,display-coords = < 0x00 0x00 0x2d0 0x640 >;
				cts,x-res = < 0x2d0 >;
				cts,y-res = < 0x640 >;
				cts,test-reset-pin;
				cts,test-rawdata;
				cts,test-rawdata-frames = < 0x01 >;
				cts,rawdata-min = < 0x578 >;
				cts,rawdata-max = < 0xa28 >;
				cts,test-noise;
				cts,test-noise-frames = < 0x10 >;
				cts,noise-max = < 0x50 >;
				cts,test-open;
				cts,open-min = < 0xad4 >;
				cts,test-short;
				cts,short-min = < 0x1f4 >;
				cts,compensate-cap-min = < 0x01 >;
				cts,compensate-cap-max = < 0x7e >;
				cts,touch-charger-detect-enable;
				cts,touch-charger-detect-type = "notify";
				cts,touch-charger-detect-psy-name = "bq2560x_charger";
				cts,touch-charger-detect-psp = "POWER_SUPPLY_PROP_ONLINE";
				cts,touch-charger-detect-psp-poll-interval = < 0x3e8 >;
				cts,touch-earjack-detect-enable;
				cts,touch-earjack-state-filepath = "/sys/kernel/headset/state";
				cts,touch-earjack-poll-interval = < 0x3e8 >;
				nvt,swrst-n8-addr = < 0x3f0fe >;
				nvt,spi-rd-fast-addr = < 0x3f310 >;
				nvt,touch-charger-detect-enable;
				nvt,touch-charger-detect-type = "notify";
				nvt,touch-charger-detect-psy-name = "bq2560x_charger";
				nvt,touch-charger-detect-psp = "POWER_SUPPLY_PROP_ONLINE";
				nvt,touch-charger-detect-psp-poll-interval = < 0x3e8 >;
				nvt,mp-support-dt;

				nvt-mp-criteria@7234 {
					#address-cells = < 0x01 >;
					#size-cells = < 0x00 >;
					compatible = "nvt-mp-criteria-7234";
					IC_X_CFG_SIZE = < 0x12 >;
					IC_Y_CFG_SIZE = < 0x20 >;
					IC_KEY_CFG_SIZE = < 0x04 >;
					X_Channel = < 0x12 >;
					Y_Channel = < 0x20 >;
					AIN_X = < 0x00 0x01 0x02 0x03 0x04 0x05 0x06 0x07 0x08 0x09 0x0a 0x0b 0x0c 0x0d 0x0e 0x0f 0x10 0x11 >;
					AIN_Y = < 0x00 0x01 0x02 0x03 0x04 0x05 0x06 0x07 0x08 0x09 0x0a 0x0b 0x0c 0x0d 0x0e 0x0f 0x10 0x11 0x12 0x13 0x14 0x15 0x16 0x17 0x18 0x19 0x1a 0x1b 0x1c 0x1d 0x1e 0x1f >;
					AIN_KEY = < 0x00 0x01 0x02 0xff >;
					PS_Config_Lmt_Short_Rawdata_P = < 0x36b8 0x36b8 0x36b8 0x36b8 0x36b8 0x36b8 0x36b8 0x36b8 0x36b8 0x36b8 0x36b8 0x36b8 0x36b8 0x36b8 0x36b8 0x36b8 0x36b8 0x36b8 0x36b8 0x36b8 0x36b8 0x36b8 0x36b8 0x36b8 0x36b8 0x36b8 0x36b8 0x36b8 0x36b8 0x36b8 0x36b8 0x36b8 0x36b8 0x36b8 0x36b8 0x36b8 0x36b8 0x36b8 0x36b8 0x36b8 0x36b8 0x36b8 0x36b8 0x36b8 0x36b8 0x36b8 0x36b8 0x36b8 0x36b8 0x36b8 0x36b8 0x36b8 0x36b8 0x36b8 0x36b8 0x36b8 0x36b8 0x36b8 0x36b8 0x36b8 0x36b8 0x36b8 0x36b8 0x36b8 0x36b8 0x36b8 0x36b8 0x36b8 0x36b8 0x36b8 0x36b8 0x36b8 0x36b8 0x36b8 0x36b8 0x36b8 0x36b8 0x36b8 0x36b8 0x36b8 0x36b8 0x36b8 0x36b8 0x36b8 0x36b8 0x36b8 0x36b8 0x36b8 0x36b8 0x36b8 0x36b8 0x36b8 0x36b8 0x36b8 0x36b8 0x36b8 0x36b8 0x36b8 0x36b8 0x36b8 0x36b8 0x36b8 0x36b8 0x36b8 0x36b8 0x36b8 0x36b8 0x36b8 0x36b8 0x36b8 0x36b8 0x36b8 0x36b8 0x36b8 0x36b8 0x36b8 0x36b8 0x36b8 0x36b8 0x36b8 0x36b8 0x36b8 0x36b8 0x36b8 0x36b8 0x36b8 0x36b8 0x36b8 0x36b8 0x36b8 0x36b8 0x36b8 0x36b8 0x36b8 0x36b8 0x36b8 0x36b8 0x36b8 0x36b8 0x36b8 0x36b8 0x36b8 0x36b8 0x36b8 0x36b8 0x36b8 0x36b8 0x36b8 0x36b8 0x36b8 0x36b8 0x36b8 0x36b8 0x36b8 0x36b8 0x36b8 0x36b8 0x36b8 0x36b8 0x36b8 0x36b8 0x36b8 0x36b8 0x36b8 0x36b8 0x36b8 0x36b8 0x36b8 0x36b8 0x36b8 0x36b8 0x36b8 0x36b8 0x36b8 0x36b8 0x36b8 0x36b8 0x36b8 0x36b8 0x36b8 0x36b8 0x36b8 0x36b8 0x36b8 0x36b8 0x36b8 0x36b8 0x36b8 0x36b8 0x36b8 0x36b8 0x36b8 0x36b8 0x36b8 0x36b8 0x36b8 0x36b8 0x36b8 0x36b8 0x36b8 0x36b8 0x36b8 0x36b8 0x36b8 0x36b8 0x36b8 0x36b8 0x36b8 0x36b8 0x36b8 0x36b8 0x36b8 0x36b8 0x36b8 0x36b8 0x36b8 0x36b8 0x36b8 0x36b8 0x36b8 0x36b8 0x36b8 0x36b8 0x36b8 0x36b8 0x36b8 0x36b8 0x36b8 0x36b8 0x36b8 0x36b8 0x36b8 0x36b8 0x36b8 0x36b8 0x36b8 0x36b8 0x36b8 0x36b8 0x36b8 0x36b8 0x36b8 0x36b8 0x36b8 0x36b8 0x36b8 0x36b8 0x36b8 0x36b8 0x36b8 0x36b8 0x36b8 0x36b8 0x36b8 0x36b8 0x36b8 0x36b8 0x36b8 0x36b8 0x36b8 0x36b8 0x36b8 0x36b8 0x36b8 0x36b8 0x36b8 0x36b8 0x36b8 0x36b8 0x36b8 0x36b8 0x36b8 0x36b8 0x36b8 0x36b8 0x36b8 0x36b8 0x36b8 0x36b8 0x36b8 0x36b8 0x36b8 0x36b8 0x36b8 0x36b8 0x36b8 0x36b8 0x36b8 0x36b8 0x36b8 0x36b8 0x36b8 0x36b8 0x36b8 0x36b8 0x36b8 0x36b8 0x36b8 0x36b8 0x36b8 0x36b8 0x36b8 0x36b8 0x36b8 0x36b8 0x36b8 0x36b8 0x36b8 0x36b8 0x36b8 0x36b8 0x36b8 0x36b8 0x36b8 0x36b8 0x36b8 0x36b8 0x36b8 0x36b8 0x36b8 0x36b8 0x36b8 0x36b8 0x36b8 0x36b8 0x36b8 0x36b8 0x36b8 0x36b8 0x36b8 0x36b8 0x36b8 0x36b8 0x36b8 0x36b8 0x36b8 0x36b8 0x36b8 0x36b8 0x36b8 0x36b8 0x36b8 0x36b8 0x36b8 0x36b8 0x36b8 0x36b8 0x36b8 0x36b8 0x36b8 0x36b8 0x36b8 0x36b8 0x36b8 0x36b8 0x36b8 0x36b8 0x36b8 0x36b8 0x36b8 0x36b8 0x36b8 0x36b8 0x36b8 0x36b8 0x36b8 0x36b8 0x36b8 0x36b8 0x36b8 0x36b8 0x36b8 0x36b8 0x36b8 0x36b8 0x36b8 0x36b8 0x36b8 0x36b8 0x36b8 0x36b8 0x36b8 0x36b8 0x36b8 0x36b8 0x36b8 0x36b8 0x36b8 0x36b8 0x36b8 0x36b8 0x36b8 0x36b8 0x36b8 0x36b8 0x36b8 0x36b8 0x36b8 0x36b8 0x36b8 0x36b8 0x36b8 0x36b8 0x36b8 0x36b8 0x36b8 0x36b8 0x36b8 0x36b8 0x36b8 0x36b8 0x36b8 0x36b8 0x36b8 0x36b8 0x36b8 0x36b8 0x36b8 0x36b8 0x36b8 0x36b8 0x36b8 0x36b8 0x36b8 0x36b8 0x36b8 0x36b8 0x36b8 0x36b8 0x36b8 0x36b8 0x36b8 0x36b8 0x36b8 0x36b8 0x36b8 0x36b8 0x36b8 0x36b8 0x36b8 0x36b8 0x36b8 0x36b8 0x36b8 0x36b8 0x36b8 0x36b8 0x36b8 0x36b8 0x36b8 0x36b8 0x36b8 0x36b8 0x36b8 0x36b8 0x36b8 0x36b8 0x36b8 0x36b8 0x36b8 0x36b8 0x36b8 0x36b8 0x36b8 0x36b8 0x36b8 0x36b8 0x36b8 0x36b8 0x36b8 0x36b8 0x36b8 0x36b8 0x36b8 0x36b8 0x36b8 0x36b8 0x36b8 0x36b8 0x36b8 0x36b8 0x36b8 0x36b8 0x36b8 0x36b8 0x36b8 0x36b8 0x36b8 0x36b8 0x36b8 0x36b8 0x36b8 0x36b8 0x36b8 0x36b8 0x36b8 0x36b8 0x36b8 0x36b8 0x36b8 0x36b8 0x36b8 0x36b8 0x36b8 0x36b8 0x36b8 0x36b8 0x36b8 0x36b8 0x36b8 0x36b8 0x36b8 0x36b8 0x36b8 0x36b8 0x36b8 0x36b8 0x36b8 0x36b8 0x36b8 0x36b8 0x36b8 0x36b8 0x36b8 0x36b8 0x36b8 0x36b8 0x36b8 0x36b8 0x36b8 0x36b8 0x36b8 0x36b8 0x36b8 0x36b8 0x36b8 0x36b8 0x36b8 0x36b8 0x36b8 0x36b8 0x36b8 0x36b8 0x36b8 0x36b8 0x36b8 0x36b8 0x36b8 0x36b8 0x36b8 0x36b8 0x36b8 0x36b8 0x36b8 0x36b8 0x36b8 0x36b8 0x36b8 0x36b8 0x36b8 0x36b8 0x36b8 0x36b8 0x36b8 0x36b8 0x36b8 0x36b8 0x36b8 0x36b8 0x36b8 0x36b8 0x36b8 0x36b8 0x36b8 0x36b8 0x36b8 >;
					PS_Config_Lmt_Short_Rawdata_N = < 0x2c70 0x2c70 0x2c70 0x2c70 0x2c70 0x2c70 0x2c70 0x2c70 0x2c70 0x2c70 0x2c70 0x2c70 0x2c70 0x2c70 0x2c70 0x2c70 0x2c70 0x2c70 0x2c70 0x2c70 0x2c70 0x2c70 0x2c70 0x2c70 0x2c70 0x2c70 0x2c70 0x2c70 0x2c70 0x2c70 0x2c70 0x2c70 0x2c70 0x2c70 0x2c70 0x2c70 0x2c70 0x2c70 0x2c70 0x2c70 0x2c70 0x2c70 0x2c70 0x2c70 0x2c70 0x2c70 0x2c70 0x2c70 0x2c70 0x2c70 0x2c70 0x2c70 0x2c70 0x2c70 0x2c70 0x2c70 0x2c70 0x2c70 0x2c70 0x2c70 0x2c70 0x2c70 0x2c70 0x2c70 0x2c70 0x2c70 0x2c70 0x2c70 0x2c70 0x2c70 0x2c70 0x2c70 0x2c70 0x2c70 0x2c70 0x2c70 0x2c70 0x2c70 0x2c70 0x2c70 0x2c70 0x2c70 0x2c70 0x2c70 0x2c70 0x2c70 0x2c70 0x2c70 0x2c70 0x2c70 0x2c70 0x2c70 0x2c70 0x2c70 0x2c70 0x2c70 0x2c70 0x2c70 0x2c70 0x2c70 0x2c70 0x2c70 0x2c70 0x2c70 0x2c70 0x2c70 0x2c70 0x2c70 0x2c70 0x2c70 0x2c70 0x2c70 0x2c70 0x2c70 0x2c70 0x2c70 0x2c70 0x2c70 0x2c70 0x2c70 0x2c70 0x2c70 0x2c70 0x2c70 0x2c70 0x2c70 0x2c70 0x2c70 0x2c70 0x2c70 0x2c70 0x2c70 0x2c70 0x2c70 0x2c70 0x2c70 0x2c70 0x2c70 0x2c70 0x2c70 0x2c70 0x2c70 0x2c70 0x2c70 0x2c70 0x2c70 0x2c70 0x2c70 0x2c70 0x2c70 0x2c70 0x2c70 0x2c70 0x2c70 0x2c70 0x2c70 0x2c70 0x2c70 0x2c70 0x2c70 0x2c70 0x2c70 0x2c70 0x2c70 0x2c70 0x2c70 0x2c70 0x2c70 0x2c70 0x2c70 0x2c70 0x2c70 0x2c70 0x2c70 0x2c70 0x2c70 0x2c70 0x2c70 0x2c70 0x2c70 0x2c70 0x2c70 0x2c70 0x2c70 0x2c70 0x2c70 0x2c70 0x2c70 0x2c70 0x2c70 0x2c70 0x2c70 0x2c70 0x2c70 0x2c70 0x2c70 0x2c70 0x2c70 0x2c70 0x2c70 0x2c70 0x2c70 0x2c70 0x2c70 0x2c70 0x2c70 0x2c70 0x2c70 0x2c70 0x2c70 0x2c70 0x2c70 0x2c70 0x2c70 0x2c70 0x2c70 0x2c70 0x2c70 0x2c70 0x2c70 0x2c70 0x2c70 0x2c70 0x2c70 0x2c70 0x2c70 0x2c70 0x2c70 0x2c70 0x2c70 0x2c70 0x2c70 0x2c70 0x2c70 0x2c70 0x2c70 0x2c70 0x2c70 0x2c70 0x2c70 0x2c70 0x2c70 0x2c70 0x2c70 0x2c70 0x2c70 0x2c70 0x2c70 0x2c70 0x2c70 0x2c70 0x2c70 0x2c70 0x2c70 0x2c70 0x2c70 0x2c70 0x2c70 0x2c70 0x2c70 0x2c70 0x2c70 0x2c70 0x2c70 0x2c70 0x2c70 0x2c70 0x2c70 0x2c70 0x2c70 0x2c70 0x2c70 0x2c70 0x2c70 0x2c70 0x2c70 0x2c70 0x2c70 0x2c70 0x2c70 0x2c70 0x2c70 0x2c70 0x2c70 0x2c70 0x2c70 0x2c70 0x2c70 0x2c70 0x2c70 0x2c70 0x2c70 0x2c70 0x2c70 0x2c70 0x2c70 0x2c70 0x2c70 0x2c70 0x2c70 0x2c70 0x2c70 0x2c70 0x2c70 0x2c70 0x2c70 0x2c70 0x2c70 0x2c70 0x2c70 0x2c70 0x2c70 0x2c70 0x2c70 0x2c70 0x2c70 0x2c70 0x2c70 0x2c70 0x2c70 0x2c70 0x2c70 0x2c70 0x2c70 0x2c70 0x2c70 0x2c70 0x2c70 0x2c70 0x2c70 0x2c70 0x2c70 0x2c70 0x2c70 0x2c70 0x2c70 0x2c70 0x2c70 0x2c70 0x2c70 0x2c70 0x2c70 0x2c70 0x2c70 0x2c70 0x2c70 0x2c70 0x2c70 0x2c70 0x2c70 0x2c70 0x2c70 0x2c70 0x2c70 0x2c70 0x2c70 0x2c70 0x2c70 0x2c70 0x2c70 0x2c70 0x2c70 0x2c70 0x2c70 0x2c70 0x2c70 0x2c70 0x2c70 0x2c70 0x2c70 0x2c70 0x2c70 0x2c70 0x2c70 0x2c70 0x2c70 0x2c70 0x2c70 0x2c70 0x2c70 0x2c70 0x2c70 0x2c70 0x2c70 0x2c70 0x2c70 0x2c70 0x2c70 0x2c70 0x2c70 0x2c70 0x2c70 0x2c70 0x2c70 0x2c70 0x2c70 0x2c70 0x2c70 0x2c70 0x2c70 0x2c70 0x2c70 0x2c70 0x2c70 0x2c70 0x2c70 0x2c70 0x2c70 0x2c70 0x2c70 0x2c70 0x2c70 0x2c70 0x2c70 0x2c70 0x2c70 0x2c70 0x2c70 0x2c70 0x2c70 0x2c70 0x2c70 0x2c70 0x2c70 0x2c70 0x2c70 0x2c70 0x2c70 0x2c70 0x2c70 0x2c70 0x2c70 0x2c70 0x2c70 0x2c70 0x2c70 0x2c70 0x2c70 0x2c70 0x2c70 0x2c70 0x2c70 0x2c70 0x2c70 0x2c70 0x2c70 0x2c70 0x2c70 0x2c70 0x2c70 0x2c70 0x2c70 0x2c70 0x2c70 0x2c70 0x2c70 0x2c70 0x2c70 0x2c70 0x2c70 0x2c70 0x2c70 0x2c70 0x2c70 0x2c70 0x2c70 0x2c70 0x2c70 0x2c70 0x2c70 0x2c70 0x2c70 0x2c70 0x2c70 0x2c70 0x2c70 0x2c70 0x2c70 0x2c70 0x2c70 0x2c70 0x2c70 0x2c70 0x2c70 0x2c70 0x2c70 0x2c70 0x2c70 0x2c70 0x2c70 0x2c70 0x2c70 0x2c70 0x2c70 0x2c70 0x2c70 0x2c70 0x2c70 0x2c70 0x2c70 0x2c70 0x2c70 0x2c70 0x2c70 0x2c70 0x2c70 0x2c70 0x2c70 0x2c70 0x2c70 0x2c70 0x2c70 0x2c70 0x2c70 0x2c70 0x2c70 0x2c70 0x2c70 0x2c70 0x2c70 0x2c70 0x2c70 0x2c70 0x2c70 0x2c70 0x2c70 0x2c70 0x2c70 0x2c70 0x2c70 0x2c70 0x2c70 0x2c70 0x2c70 0x2c70 0x2c70 0x2c70 0x2c70 0x2c70 0x2c70 0x2c70 0x2c70 0x2c70 0x2c70 0x2c70 0x2c70 0x2c70 0x2c70 0x2c70 0x2c70 0x2c70 0x2c70 0x2c70 0x2c70 0x2c70 0x2c70 0x2c70 0x2c70 0x2c70 0x2c70 0x2c70 0x2c70 0x2c70 0x2c70 0x2c70 0x2c70 0x2c70 0x2c70 0x2c70 0x2c70 0x2c70 0x2c70 0x2c70 0x2c70 0x2c70 0x2c70 >;
					PS_Config_Lmt_Open_Rawdata_P = < 0xc56 0xc5e 0xc67 0xc83 0xca0 0xc7d 0xc63 0xcae 0xcae 0xc50 0xc50 0xc03 0xc25 0xc4b 0xc79 0xcab 0xcb9 0xc7f 0xb4f 0xb5b 0xb88 0xbc9 0xc08 0xc02 0xbf0 0xbe3 0xbb4 0xb92 0xbd0 0xbd8 0xbf5 0xbfe 0xc0f 0xc22 0xc05 0xbc7 0xb9c 0xbad 0xbd7 0xc21 0xc67 0xc64 0xc4b 0xc3e 0xc03 0xb8a 0xbc4 0xbd7 0xbea 0xbf8 0xc05 0xc1e 0xbff 0xbd0 0xbaf 0xbb5 0xbe0 0xc2b 0xc78 0xc78 0xc5d 0xc52 0xc11 0xbcb 0xc0f 0xc21 0xc34 0xc40 0xc4c 0xc61 0xc45 0xc1b 0xbc6 0xbce 0xbf8 0xc42 0xc8f 0xc8a 0xc6f 0xc64 0xc24 0xbad 0xbf3 0xc06 0xc1a 0xc28 0xc32 0xc47 0xc33 0xc09 0xbb6 0xbbb 0xbe5 0xc30 0xc7d 0xc8a 0xc71 0xc65 0xc1f 0xbee 0xc3b 0xc4f 0xc64 0xc76 0xc80 0xc94 0xc88 0xc5d 0xc1e 0xc30 0xc4f 0xc5d 0xc5e 0xc53 0xc5a 0xc48 0xc29 0xca4 0xcb7 0xcd1 0xcc6 0xcbb 0xc61 0xc03 0xbc3 0xb95 0xc48 0xc59 0xc7d 0xc8b 0xc84 0xc80 0xc76 0xc6b 0xc4b 0xccd 0xce2 0xcf3 0xcf4 0xcf7 0xca3 0xc41 0xc01 0xbd2 0xc56 0xc6a 0xc91 0xca7 0xca0 0xc9f 0xc8b 0xc86 0xc63 0xccc 0xce6 0xcf4 0xd02 0xd04 0xcb2 0xc4b 0xc0d 0xbdc 0xc81 0xc94 0xcc2 0xcd4 0xcd0 0xcce 0xcc0 0xcae 0xc8a 0xd08 0xd24 0xd3d 0xd48 0xd4c 0xcf7 0xc92 0xc53 0xc1b 0xcae 0xcc2 0xcf4 0xd04 0xcf7 0xcef 0xcdf 0xccc 0xcb1 0xd13 0xd29 0xd40 0xd4e 0xd53 0xd0c 0xca7 0xc67 0xc33 0xce1 0xcf6 0xd2e 0xd44 0xd3c 0xd36 0xd1b 0xd0b 0xcf1 0xd5a 0xd71 0xd89 0xda3 0xdac 0xd64 0xcfb 0xcbb 0xc84 0xcd7 0xce6 0xd3e 0xd4a 0xd45 0xd39 0xd24 0xd13 0xd02 0xd59 0xd6b 0xd80 0xd98 0xda7 0xd60 0xd02 0xca6 0xc72 0xd09 0xd20 0xd71 0xd87 0xd78 0xd6f 0xd59 0xd48 0xd36 0xd8e 0xda0 0xdb4 0xdcc 0xdd7 0xda3 0xd43 0xce9 0xcb2 0xd43 0xd59 0xda6 0xdba 0xdae 0xd9b 0xd8d 0xd80 0xd66 0xdac 0xdbf 0xdd4 0xddd 0xdf9 0xdc1 0xd6a 0xd0f 0xcd7 0xd6a 0xd84 0xdd0 0xdf0 0xddb 0xdd4 0xdb8 0xda9 0xd8a 0xde4 0xdfb 0xe12 0xe28 0xe38 0xe12 0xdb5 0xd59 0xd1d 0xd78 0xd91 0xde1 0xdf3 0xdeb 0xddf 0xdc9 0xdb8 0xd99 0xdd8 0xdf0 0xe09 0xe1e 0xe2f 0xe0b 0xdbc 0xd61 0xd27 0xda0 0xdbb 0xe01 0xe19 0xe0e 0xe02 0xdeb 0xddd 0xdbc 0xe12 0xe2e 0xe48 0xe5f 0xe74 0xe54 0xe09 0xdb4 0xd74 0xdd7 0xde9 0xe38 0xe40 0xe40 0xe38 0xe24 0xe0b 0xdec 0xe19 0xe41 0xe56 0xe74 0xe7c 0xe60 0xe1a 0xdcf 0xd86 0xe05 0xe1a 0xe67 0xe7c 0xe78 0xe6a 0xe56 0xe3f 0xe1e 0xe5b 0xe83 0xe9b 0xeba 0xec9 0xebb 0xe74 0xe25 0xddd 0xe24 0xe2f 0xe79 0xe95 0xe8c 0xe83 0xe70 0xe58 0xe33 0xe51 0xe7c 0xe90 0xead 0xeb7 0xeb3 0xe6a 0xe21 0xde2 0xe58 0xe60 0xeaa 0xec9 0xebd 0xeb0 0xe9a 0xe80 0xe5b 0xe94 0xec2 0xed7 0xef3 0xefe 0xf05 0xec1 0xe72 0xe32 0xe90 0xe9c 0xed6 0xf1c 0xf20 0xf15 0xefc 0xee7 0xeb8 0xe93 0xec5 0xed9 0xef9 0xf03 0xf19 0xef5 0xeb8 0xe7c 0xe98 0xea2 0xeda 0xf19 0xf20 0xf15 0xefc 0xee7 0xeb8 0xede 0xf12 0xf27 0xf43 0xf4d 0xf62 0xf4b 0xf0c 0xecd 0xed4 0xed4 0xf0c 0xf44 0xf52 0xf49 0xf35 0xf1d 0xeee 0xec8 0xefc 0xf13 0xf2f 0xf3c 0xf52 0xf4a 0xf0b 0xeda 0xeee 0xee8 0xf1d 0xf4e 0xf5f 0xf52 0xf3f 0xf28 0xefa 0xf0c 0xf3f 0xf59 0xf6e 0xf7a 0xf8c 0xf88 0xf4a 0xf1a 0xe6d 0xf34 0xf60 0xf94 0xfa5 0xf9d 0xf9f 0xf8f 0xf60 0xf26 0xf55 0xf6c 0xf6a 0xf7a 0xf8a 0xf89 0xf58 0xe59 0xe6a 0xf35 0xf65 0xf89 0xf9d 0xf93 0xf97 0xf81 0xf54 0xf66 0xf9a 0xfaf 0xfb0 0xfbe 0xfd0 0xfe0 0xfb2 0xea3 0xe90 0xf65 0xf8c 0xfb4 0xfc8 0xfc1 0xfba 0xfac 0xf7b 0xf40 0xf78 0xf89 0xf8f 0xf98 0xfab 0xfba 0xf94 0xe86 0xe90 0xf67 0xf8f 0xfb2 0xfc7 0xfc0 0xfbb 0xfab 0xf7b 0xf77 0xfad 0xfc0 0xfc4 0xfce 0xfe1 0xffa 0xfd3 0xeba 0xedb 0xfba 0xfdd 0xff8 0x100f 0x1007 0x1007 0xff5 0xfc9 0xf70 0xfa6 0xfb9 0xfbd 0xfcb 0xfdd 0xff9 0xfdc 0xec1 0xf20 0xf62 0xfd7 0xfee 0x1004 0xffa 0xffd 0xfec 0xfb7 0xfac 0xfe4 0xff2 0xff8 0x1004 0x101b 0x103c 0xfcc 0xf52 >;
					PS_Config_Lmt_Open_Rawdata_N = < 0x549 0x54d 0x550 0x55c 0x569 0x55a 0x54f 0x56f 0x56f 0x547 0x547 0x526 0x534 0x544 0x558 0x56e 0x574 0x55b 0x4d8 0x4de 0x4f1 0x50d 0x528 0x525 0x51d 0x518 0x504 0x4f5 0x510 0x513 0x520 0x523 0x52b 0x533 0x526 0x50c 0x4f9 0x501 0x513 0x532 0x550 0x54f 0x544 0x53f 0x526 0x4f2 0x50b 0x513 0x51b 0x521 0x526 0x531 0x524 0x510 0x502 0x504 0x517 0x537 0x558 0x558 0x54c 0x547 0x52c 0x50e 0x52b 0x532 0x53b 0x540 0x545 0x54e 0x542 0x530 0x50b 0x50f 0x521 0x541 0x562 0x55f 0x554 0x54f 0x534 0x501 0x51f 0x527 0x52f 0x535 0x53a 0x543 0x53a 0x528 0x505 0x507 0x519 0x539 0x55a 0x55f 0x555 0x550 0x532 0x51d 0x53e 0x546 0x54f 0x557 0x55b 0x564 0x55f 0x54c 0x531 0x539 0x546 0x54c 0x54d 0x548 0x54b 0x543 0x536 0x56b 0x573 0x57e 0x579 0x574 0x54e 0x526 0x50a 0x4f6 0x543 0x54a 0x55a 0x560 0x55d 0x55b 0x557 0x552 0x544 0x57c 0x585 0x58c 0x58d 0x58e 0x56a 0x540 0x525 0x511 0x549 0x552 0x562 0x56c 0x569 0x568 0x560 0x55e 0x54f 0x57c 0x587 0x58d 0x593 0x594 0x571 0x544 0x52a 0x515 0x55c 0x564 0x577 0x57f 0x57d 0x57d 0x577 0x56f 0x55f 0x595 0x5a1 0x5ac 0x5b1 0x5b3 0x58e 0x563 0x548 0x530 0x56f 0x577 0x58d 0x594 0x58e 0x58b 0x584 0x57c 0x570 0x59a 0x5a4 0x5ad 0x5b3 0x5b6 0x597 0x56c 0x550 0x53a 0x585 0x58e 0x5a6 0x5af 0x5ac 0x5a9 0x59e 0x597 0x58c 0x5b9 0x5c2 0x5cd 0x5d8 0x5dc 0x5bd 0x590 0x574 0x55d 0x580 0x587 0x5ad 0x5b2 0x5b0 0x5aa 0x5a1 0x59a 0x593 0x5b8 0x5c0 0x5c9 0x5d3 0x5da 0x5bb 0x593 0x56b 0x555 0x596 0x5a0 0x5c2 0x5cc 0x5c5 0x5c2 0x5b8 0x5b1 0x5a9 0x5cf 0x5d7 0x5df 0x5e9 0x5ee 0x5d8 0x5af 0x588 0x571 0x5af 0x5b8 0x5d9 0x5e2 0x5dd 0x5d4 0x5ce 0x5c9 0x5be 0x5dc 0x5e4 0x5ed 0x5f1 0x5fd 0x5e5 0x5bf 0x598 0x580 0x5bf 0x5cb 0x5eb 0x5f9 0x5f0 0x5ed 0x5e1 0x5da 0x5cd 0x5f4 0x5fe 0x607 0x611 0x618 0x607 0x5e0 0x5b8 0x59e 0x5c5 0x5d0 0x5f2 0x5fa 0x5f7 0x5f2 0x5e8 0x5e1 0x5d4 0x5ef 0x5f9 0x604 0x60d 0x614 0x604 0x5e3 0x5bc 0x5a3 0x5d7 0x5e2 0x600 0x60a 0x606 0x601 0x5f7 0x5f1 0x5e3 0x607 0x613 0x61f 0x628 0x631 0x624 0x604 0x5df 0x5c4 0x5ee 0x5f6 0x618 0x61b 0x61b 0x618 0x60f 0x604 0x5f7 0x60a 0x61c 0x625 0x631 0x635 0x629 0x60b 0x5eb 0x5cb 0x602 0x60b 0x62c 0x635 0x633 0x62d 0x625 0x61b 0x60d 0x627 0x638 0x642 0x64f 0x656 0x650 0x631 0x610 0x5f1 0x60f 0x614 0x634 0x640 0x63c 0x638 0x630 0x625 0x616 0x622 0x635 0x63d 0x64a 0x64e 0x64c 0x62d 0x60e 0x5f3 0x625 0x629 0x649 0x656 0x651 0x64b 0x642 0x637 0x627 0x63f 0x653 0x65c 0x668 0x66d 0x670 0x652 0x631 0x615 0x63d 0x643 0x65b 0x679 0x67b 0x676 0x66c 0x663 0x64f 0x63f 0x654 0x65d 0x66a 0x66f 0x678 0x669 0x64f 0x635 0x641 0x645 0x65d 0x678 0x67b 0x676 0x66c 0x663 0x64f 0x65f 0x675 0x67e 0x68a 0x68e 0x697 0x68e 0x673 0x658 0x65b 0x65b 0x673 0x68b 0x691 0x68d 0x684 0x67a 0x666 0x655 0x66c 0x676 0x682 0x687 0x691 0x68d 0x672 0x65d 0x666 0x663 0x67a 0x68f 0x696 0x691 0x688 0x67f 0x66b 0x673 0x688 0x694 0x69d 0x6a2 0x6a9 0x6a8 0x68d 0x679 0x62e 0x684 0x697 0x6ad 0x6b4 0x6b1 0x6b2 0x6ab 0x697 0x67e 0x692 0x69c 0x69b 0x6a2 0x6a9 0x6a8 0x693 0x626 0x62d 0x684 0x699 0x6a8 0x6b1 0x6ac 0x6ae 0x6a5 0x691 0x699 0x6af 0x6b8 0x6b9 0x6bf 0x6c7 0x6cd 0x6ba 0x646 0x63d 0x699 0x6a9 0x6bb 0x6c3 0x6c0 0x6bd 0x6b7 0x6a2 0x689 0x6a1 0x6a8 0x6ab 0x6af 0x6b7 0x6bd 0x6ad 0x639 0x63d 0x69a 0x6ab 0x6ba 0x6c3 0x6c0 0x6be 0x6b7 0x6a2 0x6a0 0x6b8 0x6c0 0x6c1 0x6c6 0x6ce 0x6d9 0x6c8 0x64f 0x65e 0x6bd 0x6cc 0x6d8 0x6e2 0x6de 0x6de 0x6d6 0x6c4 0x69d 0x6b5 0x6bd 0x6be 0x6c4 0x6cc 0x6d8 0x6cc 0x652 0x67b 0x697 0x6ca 0x6d3 0x6dd 0x6d9 0x6da 0x6d3 0x6bc 0x6b7 0x6cf 0x6d5 0x6d8 0x6dd 0x6e7 0x6f5 0x6c5 0x691 >;
					PS_Config_Lmt_FW_Rawdata_P = < 0xd22 0xd47 0xd40 0xd27 0xd29 0xd20 0xd21 0xd22 0xd22 0xd44 0xd44 0xd4a 0xd12 0xd36 0xd1d 0xd19 0xd24 0xd17 0xd2f 0xd0d 0xd22 0xd21 0xd39 0xd28 0xd1b 0xd1e 0xd27 0xd39 0xd28 0xd2c 0xd28 0xd43 0xd35 0xcfa 0xd17 0xd33 0xd37 0xd02 0xd1d 0xd13 0xd30 0xd27 0xd28 0xd27 0xd0d 0xd1e 0xd3e 0xd3a 0xd2e 0xd4a 0xd4b 0xd28 0xd3c 0xd2b 0xd2f 0xd27 0xd17 0xd30 0xd27 0xd39 0xd3c 0xd40 0xd22 0xd53 0xd2b 0xd39 0xd2e 0xd59 0xd35 0xd1e 0xcf4 0xd36 0xd37 0xcf7 0xd10 0xd09 0xd16 0xd05 0xd04 0xd13 0xd3a 0xd3a 0xd0d 0xd2c 0xd2f 0xd28 0xd48 0xd4e 0xd1d 0xd20 0xd2b 0xd24 0xd16 0xd22 0xcf7 0xd1a 0xd14 0xd1b 0xd17 0xd27 0xd32 0xd2c 0xd2c 0xd1e 0xd36 0xd41 0xd1d 0xd17 0xd43 0xd1e 0xd35 0xd36 0xd09 0xd30 0xd10 0xd1d 0xd0c 0xd33 0xd27 0xd2c 0xd25 0xd41 0xd30 0xce9 0xd2c 0xd2c 0xd2e 0xd17 0xd2c 0xd1e 0xcf8 0xd2f 0xd12 0xd14 0xcff 0xd10 0xd19 0xd13 0xd17 0xd1d 0xd10 0xd36 0xd4b 0xd14 0xd2e 0xd13 0xd1a 0xd21 0xd2b 0xd30 0xd39 0xd22 0xd2c 0xd09 0xd08 0xcf3 0xd04 0xd0b 0xd2c 0xd43 0xd28 0xd1d 0xd32 0xd29 0xd12 0xd28 0xd2b 0xd25 0xd2b 0xd10 0xd20 0xd2e 0xd27 0xd2e 0xd2e 0xd27 0xcf3 0xd10 0xd16 0xd3c 0xd45 0xd04 0xd4f 0xd35 0xd44 0xd41 0xd32 0xd33 0xd36 0xd06 0xd1b 0xd05 0xd16 0xd29 0xd4b 0xd39 0xd4b 0xd17 0xd33 0xd51 0xd37 0xd3e 0xcfe 0xd1a 0xd0c 0xd1b 0xd1d 0xd30 0xd25 0xd3d 0xd29 0xd41 0xd14 0xd06 0xd02 0xd05 0xd25 0xd1d 0xd36 0xd21 0xd20 0xd22 0xd19 0xd21 0xd25 0xd0b 0xd12 0xd13 0xd19 0xd12 0xd24 0xd25 0xd19 0xd30 0xd33 0xd10 0xd16 0xcfd 0xd19 0xd30 0xd22 0xcff 0xcff 0xd19 0xd29 0xd1d 0xd17 0xd1b 0xd1d 0xd2f 0xd1a 0xd41 0xd13 0xd21 0xd0f 0xd05 0xd0c 0xd32 0xd08 0xd13 0xd13 0xd28 0xd19 0xd14 0xd14 0xd1e 0xd37 0xd36 0xd0f 0xd2c 0xd3d 0xd24 0xd1a 0xd14 0xd33 0xd20 0xd21 0xd0b 0xd25 0xd1b 0xd12 0xd24 0xd1d 0xd33 0xd21 0xd06 0xd0d 0xd0f 0xd01 0xd3c 0xd21 0xd0f 0xd0b 0xd28 0xd1d 0xd06 0xd25 0xd44 0xd30 0xd29 0xd3c 0xd2f 0xd12 0xd29 0xd36 0xd33 0xd1a 0xd32 0xd3e 0xd3e 0xd41 0xd2f 0xd2c 0xd44 0xd2b 0xd3c 0xd24 0xd32 0xd1a 0xd2b 0xd21 0xd20 0xd13 0xd1e 0xd04 0xd2f 0xd10 0xd06 0xd1e 0xd13 0xd16 0xd17 0xd2f 0xd51 0xd13 0xd1d 0xd17 0xd28 0xd22 0xd33 0xd2f 0xd27 0xd3a 0xd40 0xd19 0xd3c 0xd1b 0xd2b 0xd22 0xd1d 0xd17 0xd27 0xd01 0xcfb 0xd1a 0xd1d 0xcfe 0xd1b 0xd32 0xd19 0xd1a 0xd37 0xcf7 0xcfb 0xd01 0xd4c 0xd4b 0xd2e 0xd20 0xd0d 0xcf6 0xd01 0xd0b 0xd0d 0xd06 0xd12 0xd16 0xd2c 0xd12 0xd29 0xd27 0xd1e 0xd25 0xd41 0xd30 0xd2e 0xd28 0xd14 0xd1b 0xd1b 0xcf8 0xd44 0xd0b 0xd4f 0xcfa 0xd14 0xd19 0xd19 0xd08 0xd17 0xd1e 0xd05 0xd0b 0xd24 0xd27 0xd39 0xd13 0xd12 0xd1d 0xd04 0xd20 0xd0c 0xd36 0xd13 0xd13 0xd06 0xd06 0xd10 0xd12 0xd41 0xd3d 0xd0b 0xd06 0xd28 0xd09 0xd0f 0xd22 0xd08 0xd06 0xd0d 0xd09 0xd0c 0xd12 0xd20 0xd0c 0xd10 0xd28 0xd27 0xd25 0xd19 0xd0f 0xd21 0xd1d 0xd14 0xcde 0xd37 0xd0d 0xd20 0xcf3 0xd0f 0xd1a 0xd10 0xcf1 0xd0c 0xd01 0xd20 0xd2e 0xd1e 0xd16 0xd28 0xd1d 0xd25 0xd20 0xd2b 0xd17 0xd1b 0xd20 0xd27 0xd24 0xd14 0xd0c 0xd0d 0xd06 0xd36 0xd12 0xd1e 0xd32 0xd0c 0xd05 0xd0b 0xcff 0xd20 0xd13 0xd0b 0xd14 0xd12 0xd33 0xd1d 0xd22 0xd24 0xd2b 0xd20 0xd39 0xd32 0xd13 0xd20 0xd13 0xd1b 0xd10 0xd1b 0xd20 0xd22 0xd53 0xd21 0xcf1 0xd09 0xd19 0xd1b 0xd1a 0xd12 0xd14 0xcff 0xd08 0xd13 0xd0c 0xd0f 0xd16 0xd19 0xd1b 0xd21 0xd13 0xd3e 0xd1b 0xd24 0xd08 0xd0f 0xd13 0xd29 0xd20 0xd28 0xd47 0xd16 0xd0b 0xd12 0xd1e 0xd53 0xd4e 0xd2c 0xd29 0xd1a 0xcfd 0xd1a 0xd36 0xd2e 0xd1b 0xd32 0xd3a 0xd19 0xd12 0xd1a 0xd29 0xd1e 0xd21 0xd33 0xd3d 0xd28 0xd0b 0xd37 0xd1a 0xd30 0xd2b 0xd0c 0xd41 0xd3d 0xd29 0xd27 0xd20 0xd2b 0xd1a 0xd1e 0xd22 0xd22 0xd1e 0xd39 0xd48 0xd5f >;
					PS_Config_Lmt_FW_Rawdata_N = < 0x5a1 0x5b0 0x5ad 0x5a3 0x5a4 0x5a0 0x5a0 0x5a1 0x5a1 0x5af 0x5af 0x5b2 0x59a 0x5a9 0x59e 0x59d 0x5a1 0x59c 0x5a6 0x598 0x5a1 0x5a0 0x5aa 0x5a3 0x59e 0x59f 0x5a3 0x5aa 0x5a3 0x5a5 0x5a3 0x5af 0x5a9 0x58f 0x59c 0x5a8 0x5aa 0x593 0x59e 0x59a 0x5a7 0x5a3 0x5a3 0x5a3 0x598 0x59f 0x5ad 0x5ab 0x5a6 0x5b2 0x5b2 0x5a3 0x5ac 0x5a4 0x5a6 0x5a3 0x59c 0x5a7 0x5a3 0x5aa 0x5ac 0x5ad 0x5a1 0x5b6 0x5a4 0x5aa 0x5a6 0x5b8 0x5a9 0x59f 0x58d 0x5a9 0x5aa 0x58e 0x599 0x596 0x59b 0x594 0x594 0x59a 0x5ab 0x5ab 0x598 0x5a5 0x5a6 0x5a3 0x5b1 0x5b3 0x59e 0x5a0 0x5a4 0x5a1 0x59b 0x5a1 0x58e 0x59d 0x59b 0x59e 0x59c 0x5a3 0x5a7 0x5a5 0x5a5 0x59f 0x5a9 0x5ae 0x59e 0x59c 0x5af 0x59f 0x5a9 0x5a9 0x596 0x5a7 0x599 0x59e 0x597 0x5a8 0x5a3 0x5a5 0x5a2 0x5ae 0x5a7 0x588 0x5a5 0x5a5 0x5a6 0x59c 0x5a5 0x59f 0x58f 0x5a6 0x59a 0x59b 0x592 0x599 0x59d 0x59a 0x59c 0x59e 0x599 0x5a9 0x5b2 0x59b 0x5a6 0x59a 0x59d 0x5a0 0x5a4 0x5a7 0x5aa 0x5a1 0x5a5 0x596 0x595 0x58c 0x594 0x597 0x5a5 0x5af 0x5a3 0x59e 0x5a7 0x5a4 0x59a 0x5a3 0x5a4 0x5a2 0x5a4 0x599 0x5a0 0x5a6 0x5a3 0x5a6 0x5a6 0x5a3 0x58c 0x599 0x59b 0x5ac 0x5b0 0x594 0x5b4 0x5a9 0x5af 0x5ae 0x5a7 0x5a8 0x5a9 0x595 0x59e 0x594 0x59b 0x5a4 0x5b2 0x5aa 0x5b2 0x59c 0x5a8 0x5b5 0x5aa 0x5ad 0x591 0x59d 0x597 0x59e 0x59e 0x5a7 0x5a2 0x5ac 0x5a4 0x5ae 0x59b 0x595 0x593 0x594 0x5a2 0x59e 0x5a9 0x5a0 0x5a0 0x5a1 0x59d 0x5a0 0x5a2 0x597 0x59a 0x59a 0x59d 0x59a 0x5a1 0x5a2 0x59d 0x5a7 0x5a8 0x599 0x59b 0x591 0x59d 0x5a7 0x5a1 0x592 0x592 0x59d 0x5a4 0x59e 0x59c 0x59e 0x59e 0x5a6 0x59d 0x5ae 0x59a 0x5a0 0x598 0x594 0x597 0x5a7 0x595 0x59a 0x59a 0x5a3 0x59d 0x59b 0x59b 0x59f 0x5aa 0x5a9 0x598 0x5a5 0x5ac 0x5a1 0x59d 0x59b 0x5a8 0x5a0 0x5a0 0x597 0x5a2 0x59e 0x59a 0x5a1 0x59e 0x5a8 0x5a0 0x595 0x598 0x598 0x592 0x5ac 0x5a0 0x598 0x597 0x5a3 0x59e 0x595 0x5a2 0x5af 0x5a7 0x5a4 0x5ac 0x5a6 0x59a 0x5a4 0x5a9 0x5a8 0x59d 0x5a7 0x5ad 0x5ad 0x5ae 0x5a6 0x5a5 0x5af 0x5a4 0x5ac 0x5a1 0x5a7 0x59d 0x5a4 0x5a0 0x5a0 0x59a 0x59f 0x594 0x5a6 0x599 0x595 0x59f 0x59a 0x59b 0x59c 0x5a6 0x5b5 0x59a 0x59e 0x59c 0x5a3 0x5a1 0x5a8 0x5a6 0x5a3 0x5ab 0x5ad 0x59d 0x5ac 0x59e 0x5a4 0x5a1 0x59e 0x59c 0x5a3 0x592 0x590 0x59d 0x59e 0x591 0x59e 0x5a7 0x59d 0x59d 0x5aa 0x58e 0x590 0x592 0x5b3 0x5b2 0x5a6 0x5a0 0x598 0x58e 0x592 0x597 0x598 0x595 0x59a 0x59b 0x5a5 0x59a 0x5a4 0x5a3 0x59f 0x5a2 0x5ae 0x5a7 0x5a6 0x5a3 0x59b 0x59e 0x59e 0x58f 0x5af 0x597 0x5b4 0x58f 0x59b 0x59d 0x59d 0x595 0x59c 0x59f 0x594 0x597 0x5a1 0x5a3 0x5aa 0x59a 0x59a 0x59e 0x594 0x5a0 0x597 0x5a9 0x59a 0x59a 0x595 0x595 0x599 0x59a 0x5ae 0x5ac 0x597 0x595 0x5a3 0x596 0x598 0x5a1 0x595 0x595 0x598 0x596 0x597 0x59a 0x5a0 0x597 0x599 0x5a3 0x5a3 0x5a2 0x59d 0x598 0x5a0 0x59e 0x59b 0x583 0x5aa 0x598 0x5a0 0x58c 0x598 0x59d 0x599 0x58c 0x597 0x592 0x5a0 0x5a6 0x59f 0x59b 0x5a3 0x59e 0x5a2 0x5a0 0x5a4 0x59c 0x59e 0x5a0 0x5a3 0x5a1 0x59b 0x597 0x598 0x595 0x5a9 0x59a 0x59f 0x5a7 0x597 0x594 0x597 0x592 0x5a0 0x59a 0x597 0x59b 0x59a 0x5a8 0x59e 0x5a1 0x5a1 0x5a4 0x5a0 0x5aa 0x5a7 0x59a 0x5a0 0x59a 0x59e 0x599 0x59e 0x5a0 0x5a1 0x5b6 0x5a0 0x58c 0x596 0x59d 0x59e 0x59d 0x59a 0x59b 0x592 0x595 0x59a 0x597 0x598 0x59b 0x59d 0x59e 0x5a0 0x59a 0x5ad 0x59e 0x5a1 0x595 0x598 0x59a 0x5a4 0x5a0 0x5a3 0x5b0 0x59b 0x597 0x59a 0x59f 0x5b6 0x5b3 0x5a5 0x5a4 0x59d 0x591 0x59d 0x5a9 0x5a6 0x59e 0x5a7 0x5ab 0x59d 0x59a 0x59d 0x5a4 0x59f 0x5a0 0x5a8 0x5ac 0x5a3 0x597 0x5aa 0x59d 0x5a7 0x5a4 0x597 0x5ae 0x5ac 0x5a4 0x5a3 0x5a0 0x5a4 0x59d 0x59f 0x5a1 0x5a1 0x59f 0x5aa 0x5b1 0x5bb >;
					PS_Config_Lmt_FW_CC_P = < 0x5d 0x5c 0x5c 0x5d 0x5f 0x5f 0x5f 0x5f 0x5f 0x60 0x60 0x60 0x60 0x5f 0x5f 0x5f 0x5f 0x5f 0x5f 0x5d 0x5d 0x5d 0x5d 0x5d 0x5d 0x5d 0x60 0x66 0x63 0x63 0x64 0x63 0x63 0x64 0x64 0x66 0x61 0x60 0x60 0x60 0x60 0x60 0x60 0x60 0x63 0x63 0x60 0x60 0x60 0x60 0x60 0x60 0x61 0x63 0x60 0x5f 0x5f 0x5f 0x5f 0x5f 0x5f 0x5f 0x63 0x67 0x64 0x64 0x64 0x64 0x64 0x64 0x66 0x66 0x63 0x61 0x60 0x61 0x61 0x61 0x61 0x61 0x64 0x64 0x61 0x61 0x61 0x61 0x61 0x61 0x61 0x64 0x61 0x5f 0x5f 0x60 0x60 0x60 0x60 0x60 0x63 0x67 0x64 0x66 0x66 0x64 0x64 0x66 0x66 0x67 0x63 0x61 0x60 0x61 0x60 0x60 0x60 0x60 0x64 0x67 0x66 0x66 0x66 0x64 0x64 0x64 0x64 0x66 0x64 0x63 0x63 0x63 0x63 0x61 0x63 0x63 0x66 0x6b 0x68 0x68 0x68 0x67 0x67 0x66 0x67 0x68 0x64 0x61 0x61 0x61 0x61 0x61 0x61 0x61 0x64 0x67 0x64 0x64 0x64 0x64 0x63 0x63 0x63 0x66 0x66 0x64 0x63 0x63 0x63 0x63 0x63 0x63 0x66 0x6a 0x68 0x68 0x68 0x67 0x67 0x67 0x67 0x68 0x63 0x61 0x61 0x61 0x60 0x60 0x60 0x60 0x63 0x67 0x66 0x66 0x66 0x64 0x64 0x64 0x64 0x66 0x66 0x64 0x63 0x64 0x63 0x63 0x63 0x63 0x66 0x6b 0x68 0x68 0x68 0x68 0x68 0x67 0x67 0x6a 0x63 0x61 0x61 0x61 0x61 0x60 0x61 0x61 0x64 0x67 0x66 0x66 0x66 0x64 0x64 0x64 0x64 0x66 0x67 0x64 0x64 0x64 0x64 0x63 0x64 0x64 0x67 0x6b 0x68 0x68 0x68 0x68 0x68 0x67 0x68 0x6a 0x64 0x63 0x61 0x61 0x61 0x61 0x61 0x61 0x64 0x67 0x64 0x64 0x64 0x64 0x64 0x63 0x64 0x66 0x67 0x64 0x64 0x64 0x64 0x64 0x64 0x64 0x67 0x6b 0x68 0x68 0x68 0x68 0x68 0x68 0x68 0x6b 0x64 0x63 0x63 0x63 0x61 0x61 0x61 0x63 0x64 0x68 0x66 0x66 0x66 0x66 0x66 0x66 0x66 0x67 0x67 0x66 0x64 0x64 0x64 0x64 0x64 0x64 0x67 0x6b 0x68 0x68 0x68 0x68 0x68 0x68 0x68 0x6a 0x64 0x63 0x61 0x63 0x61 0x61 0x61 0x61 0x64 0x68 0x66 0x66 0x66 0x66 0x66 0x66 0x66 0x68 0x68 0x66 0x66 0x66 0x66 0x64 0x64 0x66 0x68 0x6b 0x68 0x68 0x68 0x68 0x68 0x68 0x68 0x6b 0x64 0x63 0x61 0x63 0x61 0x61 0x61 0x61 0x64 0x68 0x67 0x67 0x67 0x66 0x67 0x66 0x67 0x68 0x68 0x67 0x67 0x67 0x66 0x66 0x66 0x66 0x6a 0x6d 0x6a 0x6a 0x6a 0x6a 0x6a 0x6a 0x6a 0x6d 0x66 0x64 0x63 0x64 0x63 0x63 0x63 0x63 0x66 0x67 0x64 0x64 0x64 0x64 0x64 0x64 0x64 0x67 0x64 0x61 0x61 0x61 0x61 0x61 0x61 0x61 0x64 0x6a 0x67 0x67 0x68 0x67 0x68 0x67 0x68 0x6a 0x66 0x64 0x64 0x64 0x64 0x63 0x63 0x64 0x67 0x68 0x66 0x66 0x66 0x66 0x66 0x66 0x67 0x68 0x64 0x63 0x63 0x63 0x63 0x61 0x61 0x63 0x66 0x6b 0x68 0x68 0x68 0x68 0x68 0x68 0x68 0x6b 0x64 0x64 0x64 0x64 0x64 0x64 0x64 0x64 0x67 0x68 0x66 0x66 0x66 0x66 0x66 0x66 0x66 0x66 0x64 0x64 0x63 0x63 0x63 0x63 0x63 0x63 0x67 0x6b 0x68 0x68 0x68 0x68 0x68 0x68 0x6a 0x6a 0x64 0x64 0x64 0x64 0x64 0x64 0x64 0x64 0x67 0x6a 0x67 0x67 0x67 0x67 0x67 0x67 0x68 0x67 0x64 0x64 0x63 0x63 0x63 0x63 0x63 0x63 0x66 0x6b 0x68 0x68 0x68 0x68 0x68 0x68 0x6a 0x68 0x66 0x66 0x64 0x64 0x64 0x64 0x64 0x64 0x68 0x6a 0x66 0x66 0x66 0x66 0x66 0x66 0x67 0x67 0x63 0x63 0x63 0x63 0x63 0x63 0x63 0x63 0x67 0x6d 0x6a 0x6a 0x6a 0x68 0x68 0x6a 0x6a 0x6a >;
					PS_Config_Lmt_FW_CC_N = < 0x2a 0x29 0x29 0x2a 0x2a 0x2a 0x2a 0x2a 0x2a 0x2b 0x2b 0x2b 0x2b 0x2a 0x2a 0x2a 0x2a 0x2a 0x2a 0x2a 0x2a 0x2a 0x2a 0x2a 0x2a 0x2a 0x2b 0x2d 0x2c 0x2c 0x2d 0x2c 0x2c 0x2d 0x2d 0x2d 0x2c 0x2b 0x2b 0x2b 0x2b 0x2b 0x2b 0x2b 0x2c 0x2c 0x2b 0x2b 0x2b 0x2b 0x2b 0x2b 0x2c 0x2c 0x2b 0x2a 0x2a 0x2a 0x2a 0x2a 0x2a 0x2a 0x2c 0x2e 0x2d 0x2d 0x2d 0x2d 0x2d 0x2d 0x2d 0x2d 0x2c 0x2c 0x2b 0x2c 0x2c 0x2c 0x2c 0x2c 0x2d 0x2d 0x2c 0x2c 0x2c 0x2c 0x2c 0x2c 0x2c 0x2d 0x2c 0x2a 0x2a 0x2b 0x2b 0x2b 0x2b 0x2b 0x2c 0x2e 0x2d 0x2d 0x2d 0x2d 0x2d 0x2d 0x2d 0x2e 0x2c 0x2c 0x2b 0x2c 0x2b 0x2b 0x2b 0x2b 0x2d 0x2e 0x2d 0x2d 0x2d 0x2d 0x2d 0x2d 0x2d 0x2d 0x2d 0x2c 0x2c 0x2c 0x2c 0x2c 0x2c 0x2c 0x2d 0x30 0x2f 0x2f 0x2f 0x2e 0x2e 0x2d 0x2e 0x2f 0x2d 0x2c 0x2c 0x2c 0x2c 0x2c 0x2c 0x2c 0x2d 0x2e 0x2d 0x2d 0x2d 0x2d 0x2c 0x2c 0x2c 0x2d 0x2d 0x2d 0x2c 0x2c 0x2c 0x2c 0x2c 0x2c 0x2d 0x2f 0x2f 0x2f 0x2f 0x2e 0x2e 0x2e 0x2e 0x2f 0x2c 0x2c 0x2c 0x2c 0x2b 0x2b 0x2b 0x2b 0x2c 0x2e 0x2d 0x2d 0x2d 0x2d 0x2d 0x2d 0x2d 0x2d 0x2d 0x2d 0x2c 0x2d 0x2c 0x2c 0x2c 0x2c 0x2d 0x30 0x2f 0x2f 0x2f 0x2f 0x2f 0x2e 0x2e 0x2f 0x2c 0x2c 0x2c 0x2c 0x2c 0x2b 0x2c 0x2c 0x2d 0x2e 0x2d 0x2d 0x2d 0x2d 0x2d 0x2d 0x2d 0x2d 0x2e 0x2d 0x2d 0x2d 0x2d 0x2c 0x2d 0x2d 0x2e 0x30 0x2f 0x2f 0x2f 0x2f 0x2f 0x2e 0x2f 0x2f 0x2d 0x2c 0x2c 0x2c 0x2c 0x2c 0x2c 0x2c 0x2d 0x2e 0x2d 0x2d 0x2d 0x2d 0x2d 0x2c 0x2d 0x2d 0x2e 0x2d 0x2d 0x2d 0x2d 0x2d 0x2d 0x2d 0x2e 0x30 0x2f 0x2f 0x2f 0x2f 0x2f 0x2f 0x2f 0x30 0x2d 0x2c 0x2c 0x2c 0x2c 0x2c 0x2c 0x2c 0x2d 0x2f 0x2d 0x2d 0x2d 0x2d 0x2d 0x2d 0x2d 0x2e 0x2e 0x2d 0x2d 0x2d 0x2d 0x2d 0x2d 0x2d 0x2e 0x30 0x2f 0x2f 0x2f 0x2f 0x2f 0x2f 0x2f 0x2f 0x2d 0x2c 0x2c 0x2c 0x2c 0x2c 0x2c 0x2c 0x2d 0x2f 0x2d 0x2d 0x2d 0x2d 0x2d 0x2d 0x2d 0x2f 0x2f 0x2d 0x2d 0x2d 0x2d 0x2d 0x2d 0x2d 0x2f 0x30 0x2f 0x2f 0x2f 0x2f 0x2f 0x2f 0x2f 0x30 0x2d 0x2c 0x2c 0x2c 0x2c 0x2c 0x2c 0x2c 0x2d 0x2f 0x2e 0x2e 0x2e 0x2d 0x2e 0x2d 0x2e 0x2f 0x2f 0x2e 0x2e 0x2e 0x2d 0x2d 0x2d 0x2d 0x2f 0x30 0x2f 0x2f 0x2f 0x2f 0x2f 0x2f 0x2f 0x30 0x2d 0x2d 0x2c 0x2d 0x2c 0x2c 0x2c 0x2c 0x2d 0x2e 0x2d 0x2d 0x2d 0x2d 0x2d 0x2d 0x2d 0x2e 0x2d 0x2c 0x2c 0x2c 0x2c 0x2c 0x2c 0x2c 0x2d 0x2f 0x2e 0x2e 0x2f 0x2e 0x2f 0x2e 0x2f 0x2f 0x2d 0x2d 0x2d 0x2d 0x2d 0x2c 0x2c 0x2d 0x2e 0x2f 0x2d 0x2d 0x2d 0x2d 0x2d 0x2d 0x2e 0x2f 0x2d 0x2c 0x2c 0x2c 0x2c 0x2c 0x2c 0x2c 0x2d 0x30 0x2f 0x2f 0x2f 0x2f 0x2f 0x2f 0x2f 0x30 0x2d 0x2d 0x2d 0x2d 0x2d 0x2d 0x2d 0x2d 0x2e 0x2f 0x2d 0x2d 0x2d 0x2d 0x2d 0x2d 0x2d 0x2d 0x2d 0x2d 0x2c 0x2c 0x2c 0x2c 0x2c 0x2c 0x2e 0x30 0x2f 0x2f 0x2f 0x2f 0x2f 0x2f 0x2f 0x2f 0x2d 0x2d 0x2d 0x2d 0x2d 0x2d 0x2d 0x2d 0x2e 0x2f 0x2e 0x2e 0x2e 0x2e 0x2e 0x2e 0x2f 0x2e 0x2d 0x2d 0x2c 0x2c 0x2c 0x2c 0x2c 0x2c 0x2d 0x30 0x2f 0x2f 0x2f 0x2f 0x2f 0x2f 0x2f 0x2f 0x2d 0x2d 0x2d 0x2d 0x2d 0x2d 0x2d 0x2d 0x2f 0x2f 0x2d 0x2d 0x2d 0x2d 0x2d 0x2d 0x2e 0x2e 0x2c 0x2c 0x2c 0x2c 0x2c 0x2c 0x2c 0x2c 0x2e 0x30 0x2f 0x2f 0x2f 0x2f 0x2f 0x2f 0x2f 0x2f >;
					PS_Config_Lmt_FW_Diff_P = < 0x32 0x32 0x32 0x32 0x32 0x32 0x32 0x32 0x32 0x32 0x32 0x32 0x32 0x32 0x32 0x32 0x32 0x32 0x32 0x32 0x32 0x32 0x32 0x32 0x32 0x32 0x32 0x32 0x32 0x32 0x32 0x32 0x32 0x32 0x32 0x32 0x32 0x32 0x32 0x32 0x32 0x32 0x32 0x32 0x32 0x32 0x32 0x32 0x32 0x32 0x32 0x32 0x32 0x32 0x32 0x32 0x32 0x32 0x32 0x32 0x32 0x32 0x32 0x32 0x32 0x32 0x32 0x32 0x32 0x32 0x32 0x32 0x32 0x32 0x32 0x32 0x32 0x32 0x32 0x32 0x32 0x32 0x32 0x32 0x32 0x32 0x32 0x32 0x32 0x32 0x32 0x32 0x32 0x32 0x32 0x32 0x32 0x32 0x32 0x32 0x32 0x32 0x32 0x32 0x32 0x32 0x32 0x32 0x32 0x32 0x32 0x32 0x32 0x32 0x32 0x32 0x32 0x32 0x32 0x32 0x32 0x32 0x32 0x32 0x32 0x32 0x32 0x32 0x32 0x32 0x32 0x32 0x32 0x32 0x32 0x32 0x32 0x32 0x32 0x32 0x32 0x32 0x32 0x32 0x32 0x32 0x32 0x32 0x32 0x32 0x32 0x32 0x32 0x32 0x32 0x32 0x32 0x32 0x32 0x32 0x32 0x32 0x32 0x32 0x32 0x32 0x32 0x32 0x32 0x32 0x32 0x32 0x32 0x32 0x32 0x32 0x32 0x32 0x32 0x32 0x32 0x32 0x32 0x32 0x32 0x32 0x32 0x32 0x32 0x32 0x32 0x32 0x32 0x32 0x32 0x32 0x32 0x32 0x32 0x32 0x32 0x32 0x32 0x32 0x32 0x32 0x32 0x32 0x32 0x32 0x32 0x32 0x32 0x32 0x32 0x32 0x32 0x32 0x32 0x32 0x32 0x32 0x32 0x32 0x32 0x32 0x32 0x32 0x32 0x32 0x32 0x32 0x32 0x32 0x32 0x32 0x32 0x32 0x32 0x32 0x32 0x32 0x32 0x32 0x32 0x32 0x32 0x32 0x32 0x32 0x32 0x32 0x32 0x32 0x32 0x32 0x32 0x32 0x32 0x32 0x32 0x32 0x32 0x32 0x32 0x32 0x32 0x32 0x32 0x32 0x32 0x32 0x32 0x32 0x32 0x32 0x32 0x32 0x32 0x32 0x32 0x32 0x32 0x32 0x32 0x32 0x32 0x32 0x32 0x32 0x32 0x32 0x32 0x32 0x32 0x32 0x32 0x32 0x32 0x32 0x32 0x32 0x32 0x32 0x32 0x32 0x32 0x32 0x32 0x32 0x32 0x32 0x32 0x32 0x32 0x32 0x32 0x32 0x32 0x32 0x32 0x32 0x32 0x32 0x32 0x32 0x32 0x32 0x32 0x32 0x32 0x32 0x32 0x32 0x32 0x32 0x32 0x32 0x32 0x32 0x32 0x32 0x32 0x32 0x32 0x32 0x32 0x32 0x32 0x32 0x32 0x32 0x32 0x32 0x32 0x32 0x32 0x32 0x32 0x32 0x32 0x32 0x32 0x32 0x32 0x32 0x32 0x32 0x32 0x32 0x32 0x32 0x32 0x32 0x32 0x32 0x32 0x32 0x32 0x32 0x32 0x32 0x32 0x32 0x32 0x32 0x32 0x32 0x32 0x32 0x32 0x32 0x32 0x32 0x32 0x32 0x32 0x32 0x32 0x32 0x32 0x32 0x32 0x32 0x32 0x32 0x32 0x32 0x32 0x32 0x32 0x32 0x32 0x32 0x32 0x32 0x32 0x32 0x32 0x32 0x32 0x32 0x32 0x32 0x32 0x32 0x32 0x32 0x32 0x32 0x32 0x32 0x32 0x32 0x32 0x32 0x32 0x32 0x32 0x32 0x32 0x32 0x32 0x32 0x32 0x32 0x32 0x32 0x32 0x32 0x32 0x32 0x32 0x32 0x32 0x32 0x32 0x32 0x32 0x32 0x32 0x32 0x32 0x32 0x32 0x32 0x32 0x32 0x32 0x32 0x32 0x32 0x32 0x32 0x32 0x32 0x32 0x32 0x32 0x32 0x32 0x32 0x32 0x32 0x32 0x32 0x32 0x32 0x32 0x32 0x32 0x32 0x32 0x32 0x32 0x32 0x32 0x32 0x32 0x32 0x32 0x32 0x32 0x32 0x32 0x32 0x32 0x32 0x32 0x32 0x32 0x32 0x32 0x32 0x32 0x32 0x32 0x32 0x32 0x32 0x32 0x32 0x32 0x32 0x32 0x32 0x32 0x32 0x32 0x32 0x32 0x32 0x32 0x32 0x32 0x32 0x32 0x32 0x32 0x32 0x32 0x32 0x32 0x32 0x32 0x32 0x32 0x32 0x32 0x32 0x32 0x32 0x32 0x32 0x32 0x32 0x32 0x32 0x32 0x32 0x32 0x32 0x32 0x32 0x32 0x32 0x32 0x32 0x32 0x32 0x32 0x32 0x32 0x32 0x32 0x32 >;
					PS_Config_Lmt_FW_Diff_N = < 0xffffffce 0xffffffce 0xffffffce 0xffffffce 0xffffffce 0xffffffce 0xffffffce 0xffffffce 0xffffffce 0xffffffce 0xffffffce 0xffffffce 0xffffffce 0xffffffce 0xffffffce 0xffffffce 0xffffffce 0xffffffce 0xffffffce 0xffffffce 0xffffffce 0xffffffce 0xffffffce 0xffffffce 0xffffffce 0xffffffce 0xffffffce 0xffffffce 0xffffffce 0xffffffce 0xffffffce 0xffffffce 0xffffffce 0xffffffce 0xffffffce 0xffffffce 0xffffffce 0xffffffce 0xffffffce 0xffffffce 0xffffffce 0xffffffce 0xffffffce 0xffffffce 0xffffffce 0xffffffce 0xffffffce 0xffffffce 0xffffffce 0xffffffce 0xffffffce 0xffffffce 0xffffffce 0xffffffce 0xffffffce 0xffffffce 0xffffffce 0xffffffce 0xffffffce 0xffffffce 0xffffffce 0xffffffce 0xffffffce 0xffffffce 0xffffffce 0xffffffce 0xffffffce 0xffffffce 0xffffffce 0xffffffce 0xffffffce 0xffffffce 0xffffffce 0xffffffce 0xffffffce 0xffffffce 0xffffffce 0xffffffce 0xffffffce 0xffffffce 0xffffffce 0xffffffce 0xffffffce 0xffffffce 0xffffffce 0xffffffce 0xffffffce 0xffffffce 0xffffffce 0xffffffce 0xffffffce 0xffffffce 0xffffffce 0xffffffce 0xffffffce 0xffffffce 0xffffffce 0xffffffce 0xffffffce 0xffffffce 0xffffffce 0xffffffce 0xffffffce 0xffffffce 0xffffffce 0xffffffce 0xffffffce 0xffffffce 0xffffffce 0xffffffce 0xffffffce 0xffffffce 0xffffffce 0xffffffce 0xffffffce 0xffffffce 0xffffffce 0xffffffce 0xffffffce 0xffffffce 0xffffffce 0xffffffce 0xffffffce 0xffffffce 0xffffffce 0xffffffce 0xffffffce 0xffffffce 0xffffffce 0xffffffce 0xffffffce 0xffffffce 0xffffffce 0xffffffce 0xffffffce 0xffffffce 0xffffffce 0xffffffce 0xffffffce 0xffffffce 0xffffffce 0xffffffce 0xffffffce 0xffffffce 0xffffffce 0xffffffce 0xffffffce 0xffffffce 0xffffffce 0xffffffce 0xffffffce 0xffffffce 0xffffffce 0xffffffce 0xffffffce 0xffffffce 0xffffffce 0xffffffce 0xffffffce 0xffffffce 0xffffffce 0xffffffce 0xffffffce 0xffffffce 0xffffffce 0xffffffce 0xffffffce 0xffffffce 0xffffffce 0xffffffce 0xffffffce 0xffffffce 0xffffffce 0xffffffce 0xffffffce 0xffffffce 0xffffffce 0xffffffce 0xffffffce 0xffffffce 0xffffffce 0xffffffce 0xffffffce 0xffffffce 0xffffffce 0xffffffce 0xffffffce 0xffffffce 0xffffffce 0xffffffce 0xffffffce 0xffffffce 0xffffffce 0xffffffce 0xffffffce 0xffffffce 0xffffffce 0xffffffce 0xffffffce 0xffffffce 0xffffffce 0xffffffce 0xffffffce 0xffffffce 0xffffffce 0xffffffce 0xffffffce 0xffffffce 0xffffffce 0xffffffce 0xffffffce 0xffffffce 0xffffffce 0xffffffce 0xffffffce 0xffffffce 0xffffffce 0xffffffce 0xffffffce 0xffffffce 0xffffffce 0xffffffce 0xffffffce 0xffffffce 0xffffffce 0xffffffce 0xffffffce 0xffffffce 0xffffffce 0xffffffce 0xffffffce 0xffffffce 0xffffffce 0xffffffce 0xffffffce 0xffffffce 0xffffffce 0xffffffce 0xffffffce 0xffffffce 0xffffffce 0xffffffce 0xffffffce 0xffffffce 0xffffffce 0xffffffce 0xffffffce 0xffffffce 0xffffffce 0xffffffce 0xffffffce 0xffffffce 0xffffffce 0xffffffce 0xffffffce 0xffffffce 0xffffffce 0xffffffce 0xffffffce 0xffffffce 0xffffffce 0xffffffce 0xffffffce 0xffffffce 0xffffffce 0xffffffce 0xffffffce 0xffffffce 0xffffffce 0xffffffce 0xffffffce 0xffffffce 0xffffffce 0xffffffce 0xffffffce 0xffffffce 0xffffffce 0xffffffce 0xffffffce 0xffffffce 0xffffffce 0xffffffce 0xffffffce 0xffffffce 0xffffffce 0xffffffce 0xffffffce 0xffffffce 0xffffffce 0xffffffce 0xffffffce 0xffffffce 0xffffffce 0xffffffce 0xffffffce 0xffffffce 0xffffffce 0xffffffce 0xffffffce 0xffffffce 0xffffffce 0xffffffce 0xffffffce 0xffffffce 0xffffffce 0xffffffce 0xffffffce 0xffffffce 0xffffffce 0xffffffce 0xffffffce 0xffffffce 0xffffffce 0xffffffce 0xffffffce 0xffffffce 0xffffffce 0xffffffce 0xffffffce 0xffffffce 0xffffffce 0xffffffce 0xffffffce 0xffffffce 0xffffffce 0xffffffce 0xffffffce 0xffffffce 0xffffffce 0xffffffce 0xffffffce 0xffffffce 0xffffffce 0xffffffce 0xffffffce 0xffffffce 0xffffffce 0xffffffce 0xffffffce 0xffffffce 0xffffffce 0xffffffce 0xffffffce 0xffffffce 0xffffffce 0xffffffce 0xffffffce 0xffffffce 0xffffffce 0xffffffce 0xffffffce 0xffffffce 0xffffffce 0xffffffce 0xffffffce 0xffffffce 0xffffffce 0xffffffce 0xffffffce 0xffffffce 0xffffffce 0xffffffce 0xffffffce 0xffffffce 0xffffffce 0xffffffce 0xffffffce 0xffffffce 0xffffffce 0xffffffce 0xffffffce 0xffffffce 0xffffffce 0xffffffce 0xffffffce 0xffffffce 0xffffffce 0xffffffce 0xffffffce 0xffffffce 0xffffffce 0xffffffce 0xffffffce 0xffffffce 0xffffffce 0xffffffce 0xffffffce 0xffffffce 0xffffffce 0xffffffce 0xffffffce 0xffffffce 0xffffffce 0xffffffce 0xffffffce 0xffffffce 0xffffffce 0xffffffce 0xffffffce 0xffffffce 0xffffffce 0xffffffce 0xffffffce 0xffffffce 0xffffffce 0xffffffce 0xffffffce 0xffffffce 0xffffffce 0xffffffce 0xffffffce 0xffffffce 0xffffffce 0xffffffce 0xffffffce 0xffffffce 0xffffffce 0xffffffce 0xffffffce 0xffffffce 0xffffffce 0xffffffce 0xffffffce 0xffffffce 0xffffffce 0xffffffce 0xffffffce 0xffffffce 0xffffffce 0xffffffce 0xffffffce 0xffffffce 0xffffffce 0xffffffce 0xffffffce 0xffffffce 0xffffffce 0xffffffce 0xffffffce 0xffffffce 0xffffffce 0xffffffce 0xffffffce 0xffffffce 0xffffffce 0xffffffce 0xffffffce 0xffffffce 0xffffffce 0xffffffce 0xffffffce 0xffffffce 0xffffffce 0xffffffce 0xffffffce 0xffffffce 0xffffffce 0xffffffce 0xffffffce 0xffffffce 0xffffffce 0xffffffce 0xffffffce 0xffffffce 0xffffffce 0xffffffce 0xffffffce 0xffffffce 0xffffffce 0xffffffce 0xffffffce 0xffffffce 0xffffffce 0xffffffce 0xffffffce 0xffffffce 0xffffffce 0xffffffce 0xffffffce 0xffffffce 0xffffffce 0xffffffce 0xffffffce 0xffffffce 0xffffffce 0xffffffce 0xffffffce 0xffffffce 0xffffffce 0xffffffce 0xffffffce 0xffffffce 0xffffffce 0xffffffce 0xffffffce 0xffffffce 0xffffffce 0xffffffce 0xffffffce 0xffffffce 0xffffffce 0xffffffce 0xffffffce 0xffffffce 0xffffffce 0xffffffce 0xffffffce 0xffffffce 0xffffffce 0xffffffce 0xffffffce 0xffffffce 0xffffffce 0xffffffce 0xffffffce 0xffffffce 0xffffffce 0xffffffce 0xffffffce 0xffffffce 0xffffffce 0xffffffce 0xffffffce 0xffffffce 0xffffffce 0xffffffce 0xffffffce 0xffffffce 0xffffffce 0xffffffce 0xffffffce 0xffffffce 0xffffffce 0xffffffce 0xffffffce 0xffffffce 0xffffffce 0xffffffce 0xffffffce 0xffffffce 0xffffffce 0xffffffce 0xffffffce 0xffffffce 0xffffffce 0xffffffce 0xffffffce 0xffffffce 0xffffffce 0xffffffce 0xffffffce 0xffffffce 0xffffffce 0xffffffce 0xffffffce 0xffffffce 0xffffffce 0xffffffce 0xffffffce 0xffffffce 0xffffffce 0xffffffce 0xffffffce 0xffffffce 0xffffffce 0xffffffce 0xffffffce 0xffffffce 0xffffffce 0xffffffce 0xffffffce 0xffffffce 0xffffffce 0xffffffce 0xffffffce 0xffffffce >;
					PS_Config_Diff_Test_Frame = < 0x32 >;
				};
			};
		};
	};

	fragment@1 {
		target = < 0xffffffff >;

		__overlay__ {

			usb-notifier {
				compatible = "samsung,usb-notifier";
				qcom,disable_control_en = < 0x01 >;
				qcom,unsupport_host_en = < 0x00 >;
				phandle = < 0x33 >;
			};

			imem@177E0 {
				compatible = "unisoc,sprd-imem";
				reg = < 0x177e0 0x20 >;
				ranges = < 0x00 0x00 0x177e0 0x20 >;
				#address-cells = < 0x01 >;
				#size-cells = < 0x01 >;
				phandle = < 0x34 >;

				restart_reason@0 {
					compatible = "unisoc,sprd-imem-restart_reason";
					reg = < 0x00 0x04 >;
				};

				upload_cause@4 {
					compatible = "unisoc,sprd-imem-upload_cause";
					reg = < 0x04 0x04 >;
				};
			};
		};
	};

	fragment@2 {
		target = < 0xffffffff >;

		__overlay__ {

			sec_debug_region@8F000000 {
				compatible = "removed-dma-pool";
				no-map;
				reg = < 0x00 0x8f000000 0x00 0x900000 >;
				phandle = < 0x35 >;
			};

			ss_plog@8F900000 {
				compatible = "ss_plog";
				no-map;
				reg = < 0x00 0x8f900000 0x00 0x200000 >;
			};
		};
	};

	fragment@3 {
		target = < 0xffffffff >;

		__overlay__ {
			id-gpio = < 0xffffffff 0x04 0x00 >;
		};
	};

	fragment@4 {
		target = < 0xffffffff >;

		__overlay__ {
			bootargs_ext = "androidboot.hardware=m168 androidboot.dtbo_idx=0";
		};
	};

	fragment@5 {
		target = < 0xffffffff >;

		__overlay__ {
			parts = "vbmeta,socko,odmko,boot,recovery,dtbo,l_modem,pm_sys,l_ldsp,l_gdsp";
		};
	};

	fragment@6 {
		target = < 0xffffffff >;

		__overlay__ {
			extcon = < 0xffffffff >;
			vbus-supply = < 0x0f >;
		};
	};

	fragment@7 {
		target = < 0xffffffff >;

		__overlay__ {
			avdd-gpio = < 0xffffffff 0x04 0x00 >;
			avee-gpio = < 0xffffffff 0x05 0x00 >;
			reset-gpio = < 0xffffffff 0x32 0x00 >;
		};
	};

	fragment@8 {
		target = < 0xffffffff >;

		__overlay__ {
			status = "okay";
			clock-frequency = < 0x61a80 >;

			sensor-main@20 {
				compatible = "sprd,sensor-main";
				reg = < 0x20 >;
				clock-names = "clk_src\0sensor_eb\0clk_96m\0clk_76m8\0clk_48m\0clk_26m";
				clocks = < 0xffffffff 0x30 0xffffffff 0x0b 0xffffffff 0x04 0xffffffff 0x10 0xffffffff 0x05 0xffffffff >;
				vddio-supply = < 0xffffffff >;
				vddcama-supply = < 0xffffffff >;
				vddcamd-supply = < 0xffffffff >;
				vddcammot-supply = < 0xffffffff >;
				sprd,phyid = < 0x01 >;
				csi = < 0xffffffff >;
				reset-gpios = < 0xffffffff 0x2c 0x00 >;
				phandle = < 0x36 >;
			};
		};
	};

	fragment@9 {
		target = < 0xffffffff >;

		__overlay__ {
			status = "okay";
			clock-frequency = < 0x61a80 >;

			sensor-sub@6e {
				compatible = "sprd,sensor-sub";
				reg = < 0x6e >;
				clock-names = "clk_src\0sensor_eb\0clk_96m\0clk_76m8\0clk_48m\0clk_26m";
				clocks = < 0xffffffff 0x31 0xffffffff 0x0c 0xffffffff 0x04 0xffffffff 0x10 0xffffffff 0x05 0xffffffff >;
				vddio-supply = < 0xffffffff >;
				vddcama-supply = < 0xffffffff >;
				vddcamd-supply = < 0xffffffff >;
				sprd,phyid = < 0x03 >;
				csi = < 0xffffffff >;
				reset-gpios = < 0xffffffff 0x29 0x00 >;
				phandle = < 0x37 >;
			};
		};
	};

	fragment@10 {
		target = < 0xffffffff >;

		__overlay__ {
			status = "okay";

			lcd_bias_sm5109c@3e {
				compatible = "sm5109c,i2c";
				status = "okay";
				reg = < 0x3e >;
			};
		};
	};

	fragment@11 {
		target = < 0xffffffff >;

		__overlay__ {
			status = "okay";
			clock-frequency = < 0x61a80 >;

			charger@6b {
				compatible = "ti,bq2560x_chg";
				reg = < 0x6b >;
				phys = < 0xffffffff >;
				monitored-battery = < 0x0c >;
				extcon = < 0xffffffff >;
				phandle = < 0x38 >;

				otg-vbus {
					regulator-name = "vddvbus";
					phandle = < 0x0f >;
				};
			};
		};
	};

	fragment@12 {
		target = < 0xffffffff >;

		__overlay__ {
			status = "okay";
			clock-frequency = < 0x61a80 >;

			regulator@60 {
				compatible = "fcs,fan53555";
				reg = < 0x60 >;
				regulator-name = "fan53555";
				regulator-min-microvolt = < 0x93378 >;
				regulator-max-microvolt = < 0x1587b8 >;
				regulator-ramp-delay = < 0xfa00 >;
				regulator-always-on;
				fcs,suspend-voltage-selector = < 0x01 >;
				phandle = < 0x39 >;
			};
		};
	};

	fragment@13 {
		target = < 0xffffffff >;

		__overlay__ {
			monitored-battery = < 0x0c >;
			sprd,calib-resistance-real = < 0x4a38 >;
			sprd,calib-resistance-spec = < 0x4e20 >;
			first-calib-voltage = < 0x366820 >;
			first-calib-capacity = < 0x32 >;
			fgu-capacity-track;
			fullbatt-track-end-vol = < 0x10c7 >;
			fullbatt-track-end-cur = < 0x82 >;
			phys = < 0xffffffff >;
		};
	};

	fragment@14 {
		target = < 0xffffffff >;

		__overlay__ {
			avdd-gpio = < 0xffffffff 0x04 0x00 >;
			avee-gpio = < 0xffffffff 0x05 0x00 >;
			reset-gpio = < 0xffffffff 0x32 0x00 >;
		};
	};

	fragment@15 {
		target = < 0xffffffff >;

		__overlay__ {
			sprd-scene = "boost\0lcdon\0lcdoff\0camlow\0camhigh\0camveryhigh";
			sprd-freq = < 0x3a5 0x190 0xe9 0x26e 0x26e 0x3a5 >;
		};
	};

	fragment@16 {
		target = < 0xffffffff >;

		__overlay__ {
			hwdvfs_dev = < 0x10 0x11 0x12 >;

			cluster@0 {
				reg = < 0x00 >;
				dcdc-ctrl = < 0x13 >;
				phandle = < 0x10 >;
			};

			cluster@1 {
				reg = < 0x01 >;
				dcdc-ctrl = < 0x14 >;
				phandle = < 0x11 >;
			};

			dsu@0 {
				reg = < 0x00 >;
				dcdc-ctrl = < 0x14 >;
				phandle = < 0x12 >;
			};

			dcdc-controller@0 {
				reg = < 0x00 0x00 >;
				volt-via-adi;
				volt-hold-us = < 0x32 >;
				volt-pause-us = < 0x05 >;
				volt-timeout-us = < 0x320 >;
				volt-stable-us = < 0x05 >;
				volt-max-step-microvolt = < 0x61a8 >;
				phandle = < 0x14 >;
			};

			dcdc-controller@1 {
				reg = < 0x01 0x02 >;
				volt-via-i2c;
				volt-hold-us = < 0x19 >;
				volt-pause-us = < 0x14 >;
				volt-timeout-us = < 0x320 >;
				volt-stable-us = < 0x19 >;
				volt-max-step-microvolt = < 0x124f84 >;
				phandle = < 0x13 >;
			};
		};
	};

	fragment@17 {
		target = < 0xffffffff >;

		__overlay__ {
			pinctrl-names = "gpio_121\0gpio_122\0gpio_123\0gpio_124\0gpio_125\0gpio_126\0gpio_144\0gpio_145\0gpio_146\0gpio_147\0shutdown";
			pinctrl-0 = < 0x15 >;
			pinctrl-1 = < 0x16 >;
			pinctrl-2 = < 0x17 >;
			pinctrl-3 = < 0x18 >;
			pinctrl-4 = < 0x19 >;
			pinctrl-5 = < 0x1a >;
			pinctrl-6 = < 0x0d >;
			pinctrl-7 = < 0x1b >;
			pinctrl-8 = < 0x1c >;
			pinctrl-9 = < 0x1d >;
			pinctrl-10 = < 0x1e 0x1f 0x20 0x21 0x22 0x23 >;

			keyout0 {
				pins = "SHARKL3_KEYOUT0";
				function = "func4";
				phandle = < 0x15 >;
			};

			keyout1 {
				pins = "SHARKL3_KEYOUT1";
				function = "func4";
				phandle = < 0x16 >;
			};

			keyout2 {
				pins = "SHARKL3_KEYOUT2";
				function = "func4";
				phandle = < 0x17 >;
			};

			keyin0 {
				pins = "SHARKL3_KEYIN0";
				function = "func4";
				phandle = < 0x18 >;
			};

			keyin1 {
				pins = "SHARKL3_KEYIN1";
				function = "func4";
				phandle = < 0x19 >;
			};

			keyin2 {
				pins = "SHARKL3_KEYIN2";
				function = "func4";
				phandle = < 0x1a >;
			};

			extint0 {
				pins = "SHARKL3_EXTINT0";
				function = "func4";
				phandle = < 0x0d >;
			};

			ges_int {
				pins = "SHARKL3_EXTINT0";
				function = "func1";
				phandle = < 0x0e >;
			};

			extint1 {
				pins = "SHARKL3_EXTINT1";
				function = "func4";
				phandle = < 0x1b >;
			};

			scl3 {
				pins = "SHARKL3_SCL3";
				function = "func4";
				phandle = < 0x1c >;
			};

			sda3 {
				pins = "SHARKL3_SDA3";
				function = "func4";
				phandle = < 0x1d >;
			};

			rfsen0 {
				pins = "SHARKL3_RFSEN0";
				function = "func4";
				phandle = < 0x1e >;
			};

			rfsck0 {
				pins = "SHARKL3_RFSCK0";
				function = "func4";
				phandle = < 0x1f >;
			};

			rfsda0 {
				pins = "SHARKL3_RFSDA0";
				function = "func4";
				phandle = < 0x20 >;
			};

			rfsen1 {
				pins = "SHARKL3_RFSEN1";
				function = "func4";
				phandle = < 0x21 >;
			};

			rfsck1 {
				pins = "SHARKL3_RFSCK1";
				function = "func4";
				phandle = < 0x22 >;
			};

			rfsda1 {
				pins = "SHARKL3_RFSDA1";
				function = "func4";
				phandle = < 0x23 >;
			};
		};
	};

	fragment@18 {
		target = < 0xffffffff >;

		__overlay__ {
			cd-gpios = < 0xffffffff 0x09 0x00 >;
		};
	};

	fragment@19 {
		target = < 0xffffffff >;

		__overlay__ {

			board-thmzone {
				polling-delay-passive = < 0x00 >;
				polling-delay = < 0x00 >;
				thermal-sensors = < 0x24 >;
				phandle = < 0x3a >;
			};
		};
	};

	fragment@20 {
		target = < 0xffffffff >;

		__overlay__ {
			regulator-always-on;
		};
	};

	fragment@21 {
		target = < 0xffffffff >;

		__overlay__ {
			regulator-always-on;
		};
	};

	fragment@22 {
		target = < 0xffffffff >;

		__overlay__ {
			regulator-always-on;
		};
	};

	fragment@23 {
		target = < 0xffffffff >;

		__overlay__ {
			regulator-always-on;
		};
	};

	fragment@24 {
		target = < 0xffffffff >;

		__overlay__ {
			status = "disabled";
		};
	};

	fragment@25 {
		target = < 0xffffffff >;

		__overlay__ {

			logobuffer@9e000000 {
				reg = < 0x00 0x9e000000 0x00 0x7e9000 >;
				phandle = < 0x26 >;
			};

			framebuffer@ff4ee000 {
				reg = < 0x00 0xff4ee000 0x00 0xa92000 >;
				phandle = < 0x25 >;
			};
		};
	};

	fragment@26 {
		target = < 0xffffffff >;

		__overlay__ {
			status = "okay";
			sprd,spk-route-hp;
		};
	};

	fragment@27 {
		target = < 0xffffffff >;

		__overlay__ {
			status = "okay";
			sprd,spk-ext-pa-info = < 0x00 0x00 0x02 0x00 >;
			sprd,spk-ext-pa-gpio = < 0xffffffff 0x9c 0x00 >;
			sprd,spk-ext-pa-type-gpio = < 0xffffffff 0x5a 0x00 >;
		};
	};

	fragment@28 {
		target = < 0xffffffff >;

		__overlay__ {

			heap@3 {
				reg = < 0x03 >;
				label = "carveout_fb";
				type = < 0x02 >;
				memory-region = < 0x25 >;
			};
		};
	};

	fragment@29 {
		target = < 0xffffffff >;

		__overlay__ {
			sprd,logo-memory = < 0x26 >;
		};
	};

	__symbols__ {
		lcd_nt36525b_txd_mipi_hdp = "/fragment/__overlay__/lcds/lcd_nt36525b_txd_mipi_hdp";
		nt36525b_timing0 = "/fragment/__overlay__/lcds/lcd_nt36525b_txd_mipi_hdp/display-timings/timing0";
		lcd_icnl9911c_truly_mipi_hdp = "/fragment/__overlay__/lcds/lcd_icnl9911c_truly_mipi_hdp";
		icnl9911c_timing0 = "/fragment/__overlay__/lcds/lcd_icnl9911c_truly_mipi_hdp/display-timings/timing0";
		lcd_gc7202_hlt_mipi_hdp = "/fragment/__overlay__/lcds/lcd_gc7202_hlt_mipi_hdp";
		gc7202_timing0 = "/fragment/__overlay__/lcds/lcd_gc7202_hlt_mipi_hdp/display-timings/timing0";
		lcd_ili9882q_truly_mipi_hdp = "/fragment/__overlay__/lcds/lcd_ili9882q_truly_mipi_hdp";
		ili9882q_timing0 = "/fragment/__overlay__/lcds/lcd_ili9882q_truly_mipi_hdp/display-timings/timing0";
		lcd_ili9882q_huarui_mipi_hdp = "/fragment/__overlay__/lcds/lcd_ili9882q_huarui_mipi_hdp";
		ili9882q_huarui_timing0 = "/fragment/__overlay__/lcds/lcd_ili9882q_huarui_mipi_hdp/display-timings/timing0";
		lcd_gc7202h_hlt_mipi_hdp = "/fragment/__overlay__/lcds/lcd_gc7202h_hlt_mipi_hdp";
		gc7202h_timing0 = "/fragment/__overlay__/lcds/lcd_gc7202h_hlt_mipi_hdp/display-timings/timing0";
		lcd_icnl9911c_txd_mipi_hdp = "/fragment/__overlay__/lcds/lcd_icnl9911c_txd_mipi_hdp";
		icnl9911c_txd_timing0 = "/fragment/__overlay__/lcds/lcd_icnl9911c_txd_mipi_hdp/display-timings/timing0";
		lcd_nt35695_truly_mipi_fhd = "/fragment/__overlay__/lcds/lcd_nt35695_truly_mipi_fhd";
		nt35695_truly_timing0 = "/fragment/__overlay__/lcds/lcd_nt35695_truly_mipi_fhd/display-timings/timing0";
		lcd_nt35532_truly_mipi_fhd = "/fragment/__overlay__/lcds/lcd_nt35532_truly_mipi_fhd";
		nt35532_truly_timing0 = "/fragment/__overlay__/lcds/lcd_nt35532_truly_mipi_fhd/display-timings/timing0";
		lcd_nt35596_boe_mipi_fhd = "/fragment/__overlay__/lcds/lcd_nt35596_boe_mipi_fhd";
		nt35596_boe_timing0 = "/fragment/__overlay__/lcds/lcd_nt35596_boe_mipi_fhd/display-timings/timing0";
		lcd_dummy_mipi_hd = "/fragment/__overlay__/lcds/lcd_dummy_mipi_hd";
		dummy_timing0 = "/fragment/__overlay__/lcds/lcd_dummy_mipi_hd/display-timings/timing0";
		pwm_backlight = "/fragment/__overlay__/sprd_backlight";
		tboard_thermistor = "/fragment/__overlay__/thermal-sensor";
		bat = "/fragment/__overlay__/battery";
		usb_noti = "/fragment@1/__overlay__/usb-notifier";
		sprd_imem = "/fragment@1/__overlay__/imem@177E0";
		sec_debug_region = "/fragment@2/__overlay__/sec_debug_region@8F000000";
		sensor_main = "/fragment@8/__overlay__/sensor-main@20";
		sensor_sub = "/fragment@9/__overlay__/sensor-sub@6e";
		bq2560x_chg = "/fragment@11/__overlay__/charger@6b";
		vddvbus = "/fragment@11/__overlay__/charger@6b/otg-vbus";
		fan53555_dcdc = "/fragment@12/__overlay__/regulator@60";
		hwdvfs_cluster0 = "/fragment@16/__overlay__/cluster@0";
		hwdvfs_cluster1 = "/fragment@16/__overlay__/cluster@1";
		hwdvfs_dsu = "/fragment@16/__overlay__/dsu@0";
		dcdc_ctrl0 = "/fragment@16/__overlay__/dcdc-controller@0";
		dcdc_ctrl1 = "/fragment@16/__overlay__/dcdc-controller@1";
		gpio_121 = "/fragment@17/__overlay__/keyout0";
		gpio_122 = "/fragment@17/__overlay__/keyout1";
		gpio_123 = "/fragment@17/__overlay__/keyout2";
		gpio_124 = "/fragment@17/__overlay__/keyin0";
		gpio_125 = "/fragment@17/__overlay__/keyin1";
		gpio_126 = "/fragment@17/__overlay__/keyin2";
		gpio_144 = "/fragment@17/__overlay__/extint0";
		gpio_144_slp = "/fragment@17/__overlay__/ges_int";
		gpio_145 = "/fragment@17/__overlay__/extint1";
		gpio_146 = "/fragment@17/__overlay__/scl3";
		gpio_147 = "/fragment@17/__overlay__/sda3";
		shutdown0 = "/fragment@17/__overlay__/rfsen0";
		shutdown1 = "/fragment@17/__overlay__/rfsck0";
		shutdown2 = "/fragment@17/__overlay__/rfsda0";
		shutdown3 = "/fragment@17/__overlay__/rfsen1";
		shutdown4 = "/fragment@17/__overlay__/rfsck1";
		shutdown5 = "/fragment@17/__overlay__/rfsda1";
		bd_thmzone = "/fragment@19/__overlay__/board-thmzone";
		logo_reserved = "/fragment@25/__overlay__/logobuffer@9e000000";
		fb_reserved = "/fragment@25/__overlay__/framebuffer@ff4ee000";
	};

	__fixups__ {
		ap_gpio = "/fragment/__overlay__/fingerprint@0:fpint-gpios:0\0/fragment/__overlay__/ant_check_div:ant_check_div_gpio:0\0/fragment/__overlay__/flash-gpios:flash-en-gpios:0\0/fragment/__overlay__/flash-gpios:torch-en-gpios:0\0/fragment@0/__overlay__/touchpanel@0:ts,rst-gpio:0\0/fragment@0/__overlay__/touchpanel@0:ts,irq-gpio:0\0/fragment@7/__overlay__:avdd-gpio:0\0/fragment@7/__overlay__:avee-gpio:0\0/fragment@7/__overlay__:reset-gpio:0\0/fragment@8/__overlay__/sensor-main@20:reset-gpios:0\0/fragment@9/__overlay__/sensor-sub@6e:reset-gpios:0\0/fragment@14/__overlay__:avdd-gpio:0\0/fragment@14/__overlay__:avee-gpio:0\0/fragment@14/__overlay__:reset-gpio:0\0/fragment@27/__overlay__:sprd,spk-ext-pa-gpio:0\0/fragment@27/__overlay__:sprd,spk-ext-pa-type-gpio:0";
		pwms = "/fragment/__overlay__/sprd_backlight:pwms:0";
		pmic_adc = "/fragment/__overlay__/thermal-sensor:io-channels:0";
		extcon_gpio = "/fragment/__overlay__/charger-manager/regulator@0/cable@0:extcon:0\0/fragment@3:target:0\0/fragment@6/__overlay__:extcon:0\0/fragment@11/__overlay__/charger@6b:extcon:0";
		pmic_eic = "/fragment/__overlay__/gpio-keys/key-volumedown:gpios:0\0/fragment/__overlay__/gpio-keys/key-power:gpios:0";
		eic_debounce = "/fragment/__overlay__/gpio-keys/key-volumeup:gpios:0\0/fragment@0/__overlay__/touchpanel@0:ges,irq-gpio:0\0/fragment@3/__overlay__:id-gpio:0";
		spi1 = "/fragment@0:target:0";
		soc = "/fragment@1:target:0";
		reserved_memory = "/fragment@2:target:0\0/fragment@25:target:0";
		chosen = "/fragment@4:target:0";
		vbmeta = "/fragment@5:target:0";
		usb = "/fragment@6:target:0";
		panel = "/fragment@7:target:0\0/fragment@14:target:0";
		i2c0 = "/fragment@8:target:0";
		aon_clk = "/fragment@8/__overlay__/sensor-main@20:clocks:0\0/fragment@9/__overlay__/sensor-sub@6e:clocks:0";
		mm_gate = "/fragment@8/__overlay__/sensor-main@20:clocks:8\0/fragment@9/__overlay__/sensor-sub@6e:clocks:8";
		pll = "/fragment@8/__overlay__/sensor-main@20:clocks:16\0/fragment@8/__overlay__/sensor-main@20:clocks:24\0/fragment@8/__overlay__/sensor-main@20:clocks:32\0/fragment@9/__overlay__/sensor-sub@6e:clocks:16\0/fragment@9/__overlay__/sensor-sub@6e:clocks:24\0/fragment@9/__overlay__/sensor-sub@6e:clocks:32";
		ext_26m = "/fragment@8/__overlay__/sensor-main@20:clocks:40\0/fragment@9/__overlay__/sensor-sub@6e:clocks:40";
		vddcamio = "/fragment@8/__overlay__/sensor-main@20:vddio-supply:0\0/fragment@9/__overlay__/sensor-sub@6e:vddio-supply:0";
		vddcama = "/fragment@8/__overlay__/sensor-main@20:vddcama-supply:0\0/fragment@9/__overlay__/sensor-sub@6e:vddcama-supply:0";
		vddcamd = "/fragment@8/__overlay__/sensor-main@20:vddcamd-supply:0\0/fragment@9/__overlay__/sensor-sub@6e:vddcamd-supply:0";
		vddcammot = "/fragment@8/__overlay__/sensor-main@20:vddcammot-supply:0";
		csi0 = "/fragment@8/__overlay__/sensor-main@20:csi:0\0/fragment@9/__overlay__/sensor-sub@6e:csi:0";
		i2c1 = "/fragment@9:target:0";
		i2c3 = "/fragment@10:target:0";
		i2c4 = "/fragment@11:target:0";
		hsphy = "/fragment@11/__overlay__/charger@6b:phys:0\0/fragment@13/__overlay__:phys:0";
		i2c7 = "/fragment@12:target:0";
		pmic_fgu = "/fragment@13:target:0";
		ddr_dfs = "/fragment@15:target:0";
		sprd_hwdvfs = "/fragment@16:target:0";
		pin_controller = "/fragment@17:target:0";
		sdio0 = "/fragment@18:target:0";
		eic_async = "/fragment@18/__overlay__:cd-gpios:0";
		thm_zone = "/fragment@19:target:0";
		vdd18 = "/fragment@20:target:0";
		vddrf18 = "/fragment@21:target:0";
		vddrf125 = "/fragment@22:target:0";
		vddldomem = "/fragment@23:target:0";
		vddsim2 = "/fragment@24:target:0";
		sprd_headset = "/fragment@26:target:0";
		sound_vbc_r1p0v3_sprd_codec = "/fragment@27:target:0";
		ion = "/fragment@28:target:0";
		dpu = "/fragment@29:target:0";
	};

	__local_fixups__ {

		fragment {

			__overlay__ {

				lcds {

					lcd_nt36525b_txd_mipi_hdp {

						display-timings {
							native-mode = < 0x00 >;
						};
					};

					lcd_icnl9911c_truly_mipi_hdp {

						display-timings {
							native-mode = < 0x00 >;
						};
					};

					lcd_gc7202_hlt_mipi_hdp {

						display-timings {
							native-mode = < 0x00 >;
						};
					};

					lcd_ili9882q_truly_mipi_hdp {

						display-timings {
							native-mode = < 0x00 >;
						};
					};

					lcd_ili9882q_huarui_mipi_hdp {

						display-timings {
							native-mode = < 0x00 >;
						};
					};

					lcd_gc7202h_hlt_mipi_hdp {

						display-timings {
							native-mode = < 0x00 >;
						};
					};

					lcd_icnl9911c_txd_mipi_hdp {

						display-timings {
							native-mode = < 0x00 >;
						};
					};

					lcd_nt35695_truly_mipi_fhd {

						display-timings {
							native-mode = < 0x00 >;
						};
					};

					lcd_nt35532_truly_mipi_fhd {

						display-timings {
							native-mode = < 0x00 >;
						};
					};

					lcd_nt35596_boe_mipi_fhd {

						display-timings {
							native-mode = < 0x00 >;
						};
					};

					lcd_dummy_mipi_hd {

						display-timings {
							native-mode = < 0x00 >;
						};
					};
				};

				charger-manager {
					monitored-battery = < 0x00 >;
				};
			};
		};

		fragment@0 {

			__overlay__ {

				touchpanel@0 {
					pinctrl-0 = < 0x00 >;
					pinctrl-1 = < 0x00 >;
				};
			};
		};

		fragment@6 {

			__overlay__ {
				vbus-supply = < 0x00 >;
			};
		};

		fragment@11 {

			__overlay__ {

				charger@6b {
					monitored-battery = < 0x00 >;
				};
			};
		};

		fragment@13 {

			__overlay__ {
				monitored-battery = < 0x00 >;
			};
		};

		fragment@16 {

			__overlay__ {
				hwdvfs_dev = < 0x00 0x04 0x08 >;

				cluster@0 {
					dcdc-ctrl = < 0x00 >;
				};

				cluster@1 {
					dcdc-ctrl = < 0x00 >;
				};

				dsu@0 {
					dcdc-ctrl = < 0x00 >;
				};
			};
		};

		fragment@17 {

			__overlay__ {
				pinctrl-0 = < 0x00 >;
				pinctrl-1 = < 0x00 >;
				pinctrl-2 = < 0x00 >;
				pinctrl-3 = < 0x00 >;
				pinctrl-4 = < 0x00 >;
				pinctrl-5 = < 0x00 >;
				pinctrl-6 = < 0x00 >;
				pinctrl-7 = < 0x00 >;
				pinctrl-8 = < 0x00 >;
				pinctrl-9 = < 0x00 >;
				pinctrl-10 = < 0x00 0x04 0x08 0x0c 0x10 0x14 >;
			};
		};

		fragment@19 {

			__overlay__ {

				board-thmzone {
					thermal-sensors = < 0x00 >;
				};
			};
		};

		fragment@28 {

			__overlay__ {

				heap@3 {
					memory-region = < 0x00 >;
				};
			};
		};

		fragment@29 {

			__overlay__ {
				sprd,logo-memory = < 0x00 >;
			};
		};
	};
};
